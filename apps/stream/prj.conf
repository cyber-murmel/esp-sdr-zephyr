## CMakeLists.txt
```
# SPDX-License-Identifier: GPL-3.0-or-later

cmake_minimum_required(VERSION 3.20.0)

find_package(Zephyr REQUIRED HINTS $ENV{ZEPHYR_BASE})
project(esp_stream)

include(${CMAKE_CURRENT_LIST_DIR}/../common/common.cmake)

target_sources(app PRIVATE
  src/main.c
  src/vrt_rx.c
  src/iq_pack.c
  src/transport_udp.c
  src/vrt_tx.c)
target_sources_ifdef(CONFIG_SHELL app PRIVATE src/shell.c)
# Per-sample loops on the stream's critical path.
set_source_files_properties(src/iq_pack.c PROPERTIES COMPILE_OPTIONS -O3)
```

## Kconfig
```
# SPDX-License-Identifier: GPL-3.0-or-later

mainmenu "ESP-SDR stream"

config APP_FREQ_MHZ
	int "LO frequency in MHz at boot (shared by RX and TX)"
	range 100 6000
	default 2412

config APP_RX_RATE
	int "Capture rate (enum esp_sdr_rate index)"
	range 0 6
	default 6
	help
	  0: 80 MS/s, 1: 40 MS/s, 6: 16 MS/s. A VITA command can switch to
	  this rate divided by an integer (decimated stream).

config APP_RX_BURST_SAMPLES
	int "Complex samples per burst"
	range 256 16380
	default 1404
	help
	  Raw bursts at the capture rate, and the most a decimated burst may
	  hold. 1404 fills whole signal data packets at every item size: 3 at
	  12 bit (468 each), 2 at 8 bit (704), 4 at 16 bit (352). USB moves a
	  limited number of datagrams per second, so a part-filled packet costs
	  as much as a full one.

config APP_RX_BURSTS
	int "Burst buffers between the capture and process cores"
	default 3
	help
	  Each holds APP_RX_BURST_SAMPLES * 4 bytes, in the internal SRAM
	  above the capture bank (ESP_SDR_HIGH_RAM).

config APP_NET_CPU
	int "CPU for the network and USB threads (-1: not pinned)"
	range -1 1
	default 0
	help
	  Pins the cooperative and high priority system threads (net TX/RX
	  queues, net_mgmt, usbd, UDC, system work queue, Wi-Fi events) to
	  this CPU, the capture CPU, so they never delay the process thread or
	  the DAC leader on the other one.

config APP_RX_BURST_INTERVAL_MS
	int "Pause between bursts in ms (0: back to back)"
	default 0

config APP_RX_STREAM_ID
	hex "VITA 49 stream identifier of the receive stream"
	help
	  Command packets to this stream ID set the receiver; any other
	  stream ID addresses the transmitter.
	default 0x5d5d0001

config APP_RX_SAMPLES_PER_PACKET
	int "Complex samples per IF data packet"
	range 1 1000
	default 352
	help
	  352 samples plus six header and trailer words fit a 1500 byte
	  IPv6 UDP datagram.

config APP_RX_UDP_PEER
	string "IPv6 destination of the receive stream"
	default "ff02::1"
	help
	  The default link-local all-nodes group reaches the host without
	  any address setup on either side.

config APP_RX_UDP_PORT
	int "UDP destination port of the receive stream"
	default 4991

config APP_TX
	bool "Transmit VITA 49.2 signal data from the host"
	default y
	depends on ESP_SDR_TX
	help
	  Signal data and the transmitter's command packets on UDP; samples
	  go to the esp_sdr_tx stream, which plays them through the DAC
	  (CONFIG_ESP_SDR_TX: PSRAM and the RF test library). The receiver's
	  command packets are served without it.

config APP_TX_UDP_PORT
	int "UDP port for command and transmit packets"
	default 4992

config APP_TX_RATE
	int "Transmit sample rate until a command sets one"
	default 100000
	depends on APP_TX

rsource "../common/Kconfig"

# USB device helpers shared with the in-tree USB samples.
source "samples/subsys/usb/common/Kconfig.sample_usbd"

source "Kconfig.zephyr"
```

## sample.yaml
```
sample:
  name: ESP-SDR stream
  description: >-
    Burst I/Q capture on both cores, VITA 49.2 packets as UDP over IPv6 on a
    USB CDC-NCM link, USB DFU through MCUboot, Zephyr shell on USB CDC-ACM
common:
  tags: esp-sdr
  sysbuild: true
  platform_allow:
    - xiao_esp32s3/esp32s3/procpu
    - communicator_badge/esp32s3/procpu
  integration_platforms:
    - xiao_esp32s3/esp32s3/procpu
tests:
  # The console is on USB CDC-ACM, which twister cannot reach over
  # USB-Serial-JTAG: run it with tools/vrt_rx.py instead (see README).
  sample.esp_sdr.stream:
    build_only: true
```

## prj.conf
```kconfig
# The Wi-Fi driver brings the radio up at boot; nothing may scan or connect.
CONFIG_NETWORKING=y
CONFIG_WIFI=y
CONFIG_ESP32_WIFI_STA_POWER_SAVE_NONE=y

CONFIG_ESP_SDR=y
# Deferred logging: immediate mode formats on the caller's stack, which
# overflows the small USB driver thread stacks.
CONFIG_LOG=y
CONFIG_LOG_MODE_DEFERRED=y

# Float statistics on the process thread.
CONFIG_FPU=y
CONFIG_FPU_SHARING=y
CONFIG_PICOLIBC_IO_FLOAT=y
CONFIG_MAIN_STACK_SIZE=2048

# Capture on CPU 0 next to the Wi-Fi task, process on CPU 1.
CONFIG_SMP=y

CONFIG_LIBVRT=y

# USB device on the OTG port (DFU with sysbuild/MCUboot).
CONFIG_USB_DEVICE_STACK_NEXT=y
CONFIG_SAMPLE_USBD_PRODUCT="ESP-SDR"
CONFIG_SAMPLE_USBD_PID=0x0005
CONFIG_USBD_LOG_LEVEL_WRN=y
CONFIG_UDC_DRIVER_LOG_LEVEL_WRN=y
CONFIG_USBD_THREAD_STACK_SIZE=2048
CONFIG_UDC_DWC2_STACK_SIZE=1280

# USB network (CDC-NCM) carrying the VRT stream as UDP over IPv6.
CONFIG_USBD_CDC_NCM_CLASS=y
# Room for 5 full datagrams per OUT NTB: the host aggregates them into one
# transfer (USB full speed moves a limited number of transfers per second).
CONFIG_USBD_CDC_NCM_RECV_NTB_MAX_SIZE=8192
CONFIG_USBD_CDC_NCM_MAX_DGRAM_PER_NTB=5
# Uplink: up to 3 datagrams per IN NTB, collected while one is in flight.
CONFIG_USBD_CDC_NCM_SEND_NTB_MAX_SIZE=4608
CONFIG_USBD_CDC_NCM_SEND_MAX_DGRAM_PER_NTB=3
CONFIG_NET_IPV6=y
CONFIG_NET_IPV4=n
CONFIG_NET_UDP=y
CONFIG_NET_SOCKETS=y
# Receive timeout for the transmit socket (idle stop).
CONFIG_NET_CONTEXT_RCVTIMEO=y
CONFIG_NET_IF_MAX_IPV6_COUNT=2
CONFIG_NET_BUF_DATA_SIZE=256
CONFIG_NET_PKT_TX_COUNT=24
CONFIG_NET_BUF_TX_COUNT=32
# Receive buffers for the host's transmit stream (1500 byte datagrams).
CONFIG_NET_PKT_RX_COUNT=16
CONFIG_NET_BUF_RX_COUNT=48
# "net stats" in the shell.
CONFIG_NET_STATISTICS=y
CONFIG_NET_STATISTICS_PER_INTERFACE=y

# Console and Zephyr shell on a USB CDC-ACM port; the shell log backend
# carries the logs, so the UART backend would only duplicate them.
CONFIG_USBD_CDC_ACM_CLASS=y
# CDC-ACM carries the console and the shell: its own logging must stay off (it would log to
# itself), which usbd_cdc_acm.c otherwise enforces with a #warning that -Werror makes fatal.
CONFIG_USBD_CDC_ACM_LOG_LEVEL_OFF=y
CONFIG_CDC_ACM_SERIAL_INITIALIZE_AT_BOOT=n
CONFIG_SHELL=y
CONFIG_KERNEL_SHELL=y
CONFIG_NET_SHELL=y
CONFIG_LOG_BACKEND_UART=n
# Lean shell: net, kernel and mcuboot commands only.
CONFIG_SHELL_STACK_SIZE=3072
CONFIG_SHELL_CMD_BUFF_SIZE=128
CONFIG_SHELL_HISTORY=n
CONFIG_SHELL_WILDCARD=n
CONFIG_SHELL_BACKEND_SERIAL_LOG_MESSAGE_QUEUE_SIZE=256
CONFIG_DEVICE_SHELL=n
CONFIG_DATE_SHELL=n
CONFIG_DEVMEM_SHELL=n
# Wi-Fi management commands would also retune the radio under the receiver.
CONFIG_NET_L2_WIFI_SHELL=n

# 8 MB octal PSRAM: transmit waveform ring (EXT_RAM_BSS_ATTR).
CONFIG_ESP_SPIRAM=y
CONFIG_SPIRAM_MODE_OCT=y
# Transmit: the DAC stream, its input ring in PSRAM.
CONFIG_ESP_SDR_TX=y

# Heap statistics for `sdr mem` (sizing internal RAM).
CONFIG_SYS_HEAP_RUNTIME_STATS=y

# Internal RAM diet: two 64 KiB dump banks must fit (capture and DAC ping-pong).
# Sizes from `sdr mem` and `kernel thread stacks` after a TX and RX run.
CONFIG_ESP_WIFI_HEAP_SPIRAM=y
CONFIG_ESP32_WIFI_STATIC_RX_BUFFER_NUM=4
CONFIG_ESP32_WIFI_MGMT_SBUF_NUM=8
CONFIG_ESP32_WIFI_EVENT_TASK_STACK_SIZE=1024
CONFIG_NET_MGMT_EVENT_STACK_SIZE=1024
CONFIG_APP_RX_BURSTS=2
CONFIG_ESP_SDR_TX_DAC_STACK_SIZE=1024
# Internal system heap: peak 15.5 KB measured with the Wi-Fi heap in PSRAM.
CONFIG_HEAP_MEM_POOL_IGNORE_MIN=y
CONFIG_HEAP_MEM_POOL_SIZE=20480
```

## socs/esp32s3_procpu.overlay
```dts
/*
 * SPDX-License-Identifier: GPL-3.0-or-later
 */

#define APP_SHELL_LABEL "ESP-SDR shell"
#include "../../common/boards/s3_cdc_shell.dtsi"

/ {
	/* USB network function; the host side of the link gets MAC 00:00:5e:00:53:01. */
	cdc_ncm_eth0: cdc_ncm_eth0 {
		compatible = "zephyr,cdc-ncm-ethernet";
		remote-mac-address = "00005E005301";
	};
};
```

## src/main.c
```c
/*
 * SPDX-License-Identifier: GPL-3.0-or-later
 *
 * Burst I/Q pipeline across both cores: CPU 0 captures, CPU 1 processes.
 */

#include <math.h>
#include <string.h>

#include <zephyr/app_version.h>
#include <zephyr/kernel.h>
#include <zephyr/logging/log.h>
#include <zephyr/sys/util.h>

#include <esp_sdr/esp_sdr.h>

#include "vrt_rx.h"
#include "vrt_tx.h"
#include "app_cpu.h"
#include "app_usb.h"

LOG_MODULE_REGISTER(stream, LOG_LEVEL_INF);

#define CAPTURE_CPU 0
#define PROCESS_CPU 1
#define CAPTURE_STACK_SIZE 2048
#define PROCESS_STACK_SIZE 3072

/* Bursts live above the capture bank: frees low DRAM for the USB buffers. */
K_MEM_SLAB_DEFINE_IN_SECT(burst_slab, Z_GENERIC_SECTION(.esp_sdr_high), sizeof(struct vrt_rx_burst),
			  CONFIG_APP_RX_BURSTS, 4);
K_MSGQ_DEFINE(burst_q, sizeof(struct vrt_rx_burst *), CONFIG_APP_RX_BURSTS, 4);

K_THREAD_STACK_DEFINE(capture_stack, CAPTURE_STACK_SIZE);
K_THREAD_STACK_DEFINE(process_stack, PROCESS_STACK_SIZE);
static struct k_thread capture_thread, process_thread;

static atomic_t capture_cpu = ATOMIC_INIT(-1), process_cpu = ATOMIC_INIT(-1);
static atomic_t stalls;
/* Decimation factor, 1 = raw bursts at the capture rate. */
static atomic_t rx_decim = ATOMIC_INIT(1);
/* Algorithm used when rx_decim > 1. */
static atomic_t rx_mode = ATOMIC_INIT(VRT_RX_DECIM_CIC);

/* Decimated bursts must fit the burst buffer. */
BUILD_ASSERT(ESP_SDR_SAMPLES_MAX / VRT_RX_DECIM_MIN <= CONFIG_APP_RX_BURST_SAMPLES + 3U);
BUILD_ASSERT(sizeof(struct esp_sdr_iq16) == sizeof(struct esp_sdr_iq16));

int vrt_rx_set_rate(uint32_t hz)
{
	uint32_t fs = esp_sdr_rx_rate_hz(CONFIG_APP_RX_RATE), m;

	if (hz == 0U || fs % hz != 0U) {
		return -EINVAL;
	}
	m = fs / hz;
	if (m != 1U && (m < VRT_RX_DECIM_MIN || m > ESP_SDR_RX_DECIM_MAX)) {
		return -EINVAL;
	}
	atomic_set(&rx_decim, (atomic_val_t)m);
	return 0;
}

uint32_t vrt_rx_get_rate(void)
{
	return esp_sdr_rx_rate_hz(CONFIG_APP_RX_RATE) / (uint32_t)atomic_get(&rx_decim);
}

int vrt_rx_set_decim(enum vrt_rx_decim mode)
{
	if (mode != VRT_RX_DECIM_CIC && mode != VRT_RX_DECIM_FOLD) {
		return -EINVAL;
	}
	atomic_set(&rx_mode, (atomic_val_t)mode);
	return 0;
}

enum vrt_rx_decim vrt_rx_get_decim(void)
{
	return (enum vrt_rx_decim)atomic_get(&rx_mode);
}

static void capture(void *p1, void *p2, void *p3)
{
	enum esp_sdr_rate rate = CONFIG_APP_RX_RATE;
	uint32_t seq = 0;
	int ret;

	ARG_UNUSED(p1);
	ARG_UNUSED(p2);
	ARG_UNUSED(p3);

	ret = esp_sdr_init();
	if (ret == 0) {
		ret = esp_sdr_set_freq(CONFIG_APP_FREQ_MHZ);
	}
	if (ret != 0) {
		LOG_ERR("radio setup failed (%d)", ret);
		return;
	}

	for (;;) {
		struct vrt_rx_burst *b;

		if (k_mem_slab_alloc(&burst_slab, (void **)&b, K_NO_WAIT) != 0) {
			/* Process side is behind: wait, which also lets it run on one CPU. */
			atomic_inc(&stalls);
			(void)k_mem_slab_alloc(&burst_slab, (void **)&b, K_FOREVER);
		}
		uint32_t m = (uint32_t)atomic_get(&rx_decim);

		if (m > 1U) {
			/* Whole bank, decimated on the capture core while it still holds the bank. */
			enum vrt_rx_decim mode = (enum vrt_rx_decim)atomic_get(&rx_mode);
			size_t n;
			uint64_t first;

			if (mode == VRT_RX_DECIM_FOLD) {
				ret = esp_sdr_rx_capture_folded(rate, ESP_SDR_SAMPLES_MAX / m * m,
								 m, (struct esp_sdr_iq16 *)b->iq,
								 ARRAY_SIZE(b->iq), &n, &first);
				b->full_scale = 512;
			} else {
				ret = esp_sdr_rx_capture_decimated(rate, ESP_SDR_SAMPLES_MAX / m * m,
								    m, (struct esp_sdr_iq16 *)b->iq,
								    ARRAY_SIZE(b->iq), &n, &first);
				b->full_scale = 32768;
			}
			b->count = n;
			b->timestamp_ns = first;
			b->rate_hz = esp_sdr_rx_rate_hz(rate) / m;
		} else {
			uint64_t first;

			/* Converted under the radio lock: a TX session reuses the bank. */
			ret = esp_sdr_rx_capture_iq(rate, CONFIG_APP_RX_BURST_SAMPLES,
						    (struct esp_sdr_iq16 *)b->iq, &first);
			if (ret == 0) {
				b->count = CONFIG_APP_RX_BURST_SAMPLES;
				/* The engine starts on the trigger: arming time is the first sample. */
				b->timestamp_ns = first;
				b->rate_hz = esp_sdr_rx_rate_hz(rate);
				b->full_scale = 512;
			}
		}
		if (ret != 0) {
			LOG_WRN("capture failed (%d)", ret);
			k_mem_slab_free(&burst_slab, b);
			k_sleep(K_MSEC(100));
			continue;
		}
		b->seq = seq++;
		b->freq_mhz = esp_sdr_get_freq();
		b->gain = esp_sdr_rx_get_gain();
		atomic_set(&capture_cpu, arch_curr_cpu()->id);
		k_msgq_put(&burst_q, &b, K_FOREVER);

		if (CONFIG_APP_RX_BURST_INTERVAL_MS > 0) {
			k_sleep(K_MSEC(CONFIG_APP_RX_BURST_INTERVAL_MS));
		}
	}
}


static void process(void *p1, void *p2, void *p3)
{
	uint32_t bursts = 0, samples = 0;
	int64_t window_start = k_uptime_get();
	float power = 0.0f;

	ARG_UNUSED(p1);
	ARG_UNUSED(p2);
	ARG_UNUSED(p3);

	for (;;) {
		struct vrt_rx_burst *b;
		uint64_t sum = 0;
		int64_t now;

		k_msgq_get(&burst_q, &b, K_FOREVER);
		atomic_set(&process_cpu, arch_curr_cpu()->id);

		/* Integer energy: at most 2 * 32768^2 per sample, fits 32 bits unsigned. */
		for (size_t j = 0; j < b->count; j++) {
			int32_t i = b->iq[j].i, q = b->iq[j].q;

			sum += (uint32_t)(i * i) + (uint32_t)(q * q);
		}
		power = (float)sum / (float)b->count /
			((float)b->full_scale * (float)b->full_scale);
		vrt_rx_burst(b);
		bursts++;
		samples += b->count;
		k_mem_slab_free(&burst_slab, b);

		now = k_uptime_get();
		if (now - window_start >= 1000) {
			float secs = (float)(now - window_start) / 1000.0f;

			LOG_DBG("capture cpu %ld, process cpu %ld, %u bursts/s, "
				"%.2f MS/s, %.1f dBFS, stalls %ld",
				atomic_get(&capture_cpu), atomic_get(&process_cpu),
				(unsigned int)((float)bursts / secs),
				(double)((float)samples / secs / 1e6f),
				(double)(10.0f * log10f(MAX(power, 1e-12f))), atomic_get(&stalls));
			vrt_rx_report();
			bursts = 0;
			samples = 0;
			window_start = now;
		}
	}
}

int main(void)
{
	printk("stream %s\n", APP_VERSION_STRING);
	LOG_INF("cpus %u, %u MHz, %u-sample bursts", arch_num_cpus(), CONFIG_APP_FREQ_MHZ,
		CONFIG_APP_RX_BURST_SAMPLES);

#if defined(CONFIG_SCHED_CPU_MASK) && CONFIG_APP_NET_CPU >= 0
	/*
	 * Before USB starts: its bring-up runs on the system work queue, and
	 * the controller interrupt lands on the CPU that allocates it.
	 */
	if (arch_num_cpus() > 1) {
		app_cpu_pin_system_threads(CONFIG_APP_NET_CPU);
	}
#endif
	if (app_usb_init() != 0) {
		LOG_ERR("usb init failed");
	}
	if (vrt_rx_init() != 0) {
		LOG_ERR("stream init failed");
		return 0;
	}
	if (vrt_tx_init() != 0) {
		LOG_ERR("tx init failed");
	}

	k_thread_create(&capture_thread, capture_stack, K_THREAD_STACK_SIZEOF(capture_stack),
			capture, NULL, NULL, NULL, K_PRIO_PREEMPT(5), 0, K_FOREVER);
	k_thread_create(&process_thread, process_stack, K_THREAD_STACK_SIZEOF(process_stack),
			process, NULL, NULL, NULL, K_PRIO_PREEMPT(6), 0, K_FOREVER);
	k_thread_name_set(&capture_thread, "rx_capture");
	k_thread_name_set(&process_thread, "rx_process");
#if defined(CONFIG_SCHED_CPU_MASK)
	if (arch_num_cpus() > 1) {
		k_thread_cpu_pin(&capture_thread, CAPTURE_CPU);
		k_thread_cpu_pin(&process_thread, PROCESS_CPU);
#if CONFIG_APP_NET_CPU >= 0
		/* Again for the threads started since (usbd, UDC). */
		app_cpu_pin_system_threads(CONFIG_APP_NET_CPU);
#endif
	}
#endif
	k_thread_start(&capture_thread);
	k_thread_start(&process_thread);
	return 0;
}
```

## src/shell.c
```c
/*
 * SPDX-License-Identifier: GPL-3.0-or-later
 *
 * The "sdr" shell command: receiver and transmitter controls and tests. The
 * receive stream picks changes up per burst.
 */

#include <math.h>
#include <stdlib.h>
#include <string.h>

#include <zephyr/kernel.h>
#include <zephyr/shell/shell.h>
#include <zephyr/sys/sys_heap.h>

#include <esp_attr.h>

#include <esp_sdr/esp_sdr.h>
#include <esp_sdr/esp_sdr_dsp.h>

#include "app_shell.h"
#include "vrt_rx.h"

#if defined(CONFIG_APP_TX)
#include <esp_sdr/esp_sdr_tx.h>

#include "vrt_tx.h"
#endif

extern struct k_heap _system_heap;

static int cmd_mem(const struct shell *sh, size_t argc, char **argv)
{
	struct sys_memory_stats st;

	ARG_UNUSED(argc);
	ARG_UNUSED(argv);
	if (sys_heap_runtime_stats_get(&_system_heap.heap, &st) != 0) {
		shell_error(sh, "no heap stats");
		return -EIO;
	}
	shell_print(sh, "system heap: %u allocated, %u free, %u peak",
		    (unsigned int)st.allocated_bytes, (unsigned int)st.free_bytes,
		    (unsigned int)st.max_allocated_bytes);
	return 0;
}

#if defined(CONFIG_APP_TX)

/*
 * Transmit synthesis. The DAC runs at its own rate (40 or 80 MS/s, never the
 * 16 MS/s the receiver uses), so every generator works in Hz and seconds and
 * converts with esp_sdr_tx_rate_hz(). One buffer serves all of them.
 */
#define TX_RATE        ESP_SDR_RATE_40MSPS
#define TX_BUF_SAMPLES 2048U /* 51 us at 40 MS/s; RAM below the capture bank is tight */
/* PSRAM: only CPU copies read it, the DAC plays from the bank. */
static EXT_RAM_BSS_ATTR uint32_t tx_buf[TX_BUF_SAMPLES];

static enum esp_sdr_rate tx_rate_arg(size_t argc, char **argv, size_t idx)
{
	return argc > idx ? (enum esp_sdr_rate)strtol(argv[idx], NULL, 0) : TX_RATE;
}

/*
 * Quick link check: a steady tone (no modulation), to confirm TX actually
 * reaches the other board at a sane level and offset.
 */
static int cmd_tonetx(const struct shell *sh, size_t argc, char **argv)
{
	double req = argc > 1 ? strtod(argv[1], NULL) : 1000000.0;
	uint32_t ms = argc > 2 ? (uint32_t)strtoul(argv[2], NULL, 0) : 0U;
	long amp = argc > 3 ? strtol(argv[3], NULL, 0) : 511;
	enum esp_sdr_rate rate = tx_rate_arg(argc, argv, 4);
	double fs = (double)esp_sdr_tx_rate_hz(rate);
	uint32_t bursts = 0;
	long cycles = 0;
	size_t n;
	int ret;

	if (fs == 0.0) {
		shell_error(sh, "transmit rate index must be 0 (80 MS/s) or 1 (40 MS/s)");
		return -EINVAL;
	}
	if (amp <= 0 || amp > 511 || fabs(req) >= fs / 2.0) {
		shell_error(sh, "amplitude must be 1..511 and |hz| below %.0f", fs / 2.0);
		return -EINVAL;
	}
	n = esp_sdr_tone_period(req, fs, ESP_SDR_SAMPLES_MIN, TX_BUF_SAMPLES, &cycles);
	for (size_t k = 0; k < n; k++) {
		double phase = esp_sdr_tone_phase(cycles, k, n);

		tx_buf[k] = esp_sdr_tx_word((int16_t)lround((double)amp * cos(phase)),
					    (int16_t)lround((double)amp * sin(phase)));
	}
	ret = esp_sdr_tx_play_for(rate, tx_buf, n, ms, &bursts);
	if (ret != 0) {
		shell_error(sh, "play: %d", ret);
		return ret;
	}
	shell_print(sh,
		    "tonetx: %u MHz %+.0f Hz, %u MS/s, period %u, amp %ld, txgain %d, %u bursts in %u ms",
		    esp_sdr_get_freq(), (double)cycles * fs / (double)n, (unsigned int)(fs / 1e6),
		    (unsigned int)n, amp, esp_sdr_tx_get_gain(), bursts, ms);
	return 0;
}

static int cmd_sweep(const struct shell *sh, size_t argc, char **argv)
{
	float f0 = strtof(argv[1], NULL), f1 = strtof(argv[2], NULL);
	uint32_t ms = (uint32_t)strtoul(argv[3], NULL, 0);
	int amp = argc > 4 ? (int)strtol(argv[4], NULL, 0) : 256;
	enum esp_sdr_rate rate = tx_rate_arg(argc, argv, 5);
	struct esp_sdr_tx_sweep_stats st;
	int ret = esp_sdr_tx_sweep(rate, f0, f1, ms, amp, &st);
	double fs = (double)esp_sdr_tx_rate_hz(rate);

	if (ret != 0) {
		shell_error(sh, "sweep: %d (|hz| below rate/2, ms 1..%u, amp 1..511)", ret,
			    ESP_SDR_TX_PLAY_MAX_MS);
		return ret;
	}
	shell_print(sh,
		    "sweep: %+.0f -> %+.0f Hz in %u ms at %u MS/s, txgain %d, amp %d: %u segments, "
		    "%u samples, duty %.0f %%",
		    (double)f0, (double)f1, st.elapsed_ms, (unsigned int)(fs / 1e6),
		    esp_sdr_tx_get_gain(), amp, st.segments, st.samples,
		    100.0 * st.samples / fs / (st.elapsed_ms / 1e3));
	return 0;
}

#define SDR_TX_CMD                                                                                \
	SHELL_CMD_ARG(tonetx, NULL, "[hz] [ms] [amp] [rate 0|1] tone at 80|40 MS/s, default +1 MHz",\
		      cmd_tonetx, 1, 4),                                                          \
	SHELL_CMD_ARG(sweep, NULL, "<f0_hz> <f1_hz> <ms> [amp] [rate 0|1] linear frequency sweep",\
		      cmd_sweep, 4, 2),
#else
#define SDR_TX_CMD
#endif

static int set_freq(const struct shell *sh, const char *value)
{
	long mhz;

	if (app_shell_long(sh, value, ESP_SDR_FREQ_MIN_MHZ, ESP_SDR_FREQ_MAX_MHZ, &mhz) != 0) {
		return -EINVAL;
	}
	return esp_sdr_set_freq((uint32_t)mhz);
}

static int set_rxgain(const struct shell *sh, const char *value)
{
	long g = ESP_SDR_RX_GAIN_AUTO;

	if (strcmp(value, "auto") != 0 &&
	    app_shell_long(sh, value, ESP_SDR_RX_GAIN_AUTO, esp_sdr_rx_gain_max(), &g) != 0) {
		return -EINVAL;
	}
	return esp_sdr_rx_set_gain((int)g);
}

static int set_decim(const struct shell *sh, const char *value)
{
	if (strcmp(value, "cic") == 0) {
		return vrt_rx_set_decim(VRT_RX_DECIM_CIC);
	}
	if (strcmp(value, "fold") == 0) {
		return vrt_rx_set_decim(VRT_RX_DECIM_FOLD);
	}
	shell_error(sh, "decim: cic or fold");
	return -EINVAL;
}

#if defined(CONFIG_APP_TX)
static int set_txgain(const struct shell *sh, const char *value)
{
	long step;

	if (app_shell_long(sh, value, 0, esp_sdr_tx_gain_max(), &step) != 0) {
		return -EINVAL;
	}
	return esp_sdr_tx_set_gain((int)step);
}

static void print_tx_status(const struct shell *sh)
{
	struct esp_sdr_tx_stats bs;
	struct esp_sdr_tx_dac_stats ds;
	struct vrt_tx_stats st;
	uint64_t freq;
	uint32_t rate;

	vrt_tx_get_stats(&st);
	vrt_tx_get_settings(&freq, &rate);
	esp_sdr_tx_get_stats(&bs);
	esp_sdr_tx_dac_get_stats(&ds);
	shell_print(sh, "tx %s, %llu Hz, %u S/s", esp_sdr_tx_active() ? "active" : "idle",
		    (unsigned long long)freq, rate);
	shell_print(sh,
		    "packets %u data, %u commands, %u acks, %u gaps, %u bad, %u errors; "
		    "samples %u hole-filled, %u late",
		    st.data, st.commands, st.acks, st.gaps, st.bad, st.errors, st.holes, st.late);
	shell_print(sh, "backend %llu samples in %u writes, %u errors",
		    (unsigned long long)bs.samples, bs.writes, bs.errors);
	shell_print(sh,
		    "dac x%u: %llu played, %llu dropped (%.0f %% on air), %u switches, %u underruns, "
		    "%u overruns, %u errors, %u ms",
		    ds.interp, (unsigned long long)ds.played, (unsigned long long)ds.dropped,
		    ds.played + ds.dropped ? 100.0 * ds.played / (ds.played + ds.dropped) : 0.0,
		    ds.switches, ds.underruns, ds.overruns, ds.errors, ds.elapsed_us / 1000U);
	shell_print(sh, "dac interpolator: %s", ds.simd ? "vector (PIE)" : "C");
	shell_print(sh, "dac loop: %u switches, %u us mean apart, %u us max; slack min %d us, "
		    "%u restarts",
		    ds.switches, ds.switches > 1U ? ds.switch_us_sum / (ds.switches - 1U) : 0U,
		    ds.switch_us_max, ds.slack_us_min, ds.restarts);
	shell_print(sh, "dac leader: fill max %u us, woke late max %u us, switch-to-fill max %u us",
		    ds.fill_us_max, ds.wake_late_us_max, ds.idle_us_max);
	for (int f = 0; f < 2; f++) {
		shell_print(sh, "dac filler %d: %u blocks, %u ms filling, cpu %u", f,
			    ds.fill_blocks[f], ds.fill_us[f] / 1000U, ds.fill_cpu[f]);
	}
}

#endif

static const struct setting {
	const char *key, *help;
	int (*set)(const struct shell *sh, const char *value);
} settings[] = {
	{"freq", "<MHz>: LO, shared by receive and transmit", set_freq},
	{"rxgain", "auto|<index>: hardware AGC or a fixed gain index", set_rxgain},
	{"decim", "cic|fold: decimation below the capture rate (fold: full-band power)", set_decim},
#if defined(CONFIG_APP_TX)
	{"txgain", "<step>: transmit power step, 0 weakest", set_txgain},
#endif
};

/* set [<key> <value> ...]: settings, applied in order; without arguments the keys. */
static int cmd_set(const struct shell *sh, size_t argc, char **argv)
{
	if (argc == 1) {
		ARRAY_FOR_EACH(settings, k) {
			shell_print(sh, "  %-7s %s", settings[k].key, settings[k].help);
		}
		return 0;
	}
	if ((argc - 1U) % 2U != 0U) {
		shell_error(sh, "usage: set <key> <value> [<key> <value> ...]");
		return -EINVAL;
	}
	for (size_t a = 1; a + 1U < argc; a += 2U) {
		const struct setting *st = NULL;
		int ret;

		ARRAY_FOR_EACH(settings, k) {
			if (strcmp(argv[a], settings[k].key) == 0) {
				st = &settings[k];
			}
		}
		if (st == NULL) {
			shell_error(sh, "unknown key %s (sdr set lists them)", argv[a]);
			return -EINVAL;
		}
		ret = st->set(sh, argv[a + 1U]);
		shell_print(sh, "%s %s: %d", argv[a], argv[a + 1U], ret);
		if (ret != 0) {
			return ret;
		}
	}
	return 0;
}

/* status: receive settings, and the transmit path's state and counters. */
static int cmd_status(const struct shell *sh, size_t argc, char **argv)
{
	int gain = esp_sdr_rx_get_gain();
	const char *decim = vrt_rx_get_decim() == VRT_RX_DECIM_FOLD ? "fold" : "cic";

	ARG_UNUSED(argc);
	ARG_UNUSED(argv);
	if (gain < 0) {
		shell_print(sh, "rx: freq %u MHz, rxgain auto (max %d), decim %s, %u S/s, %u bit",
			    esp_sdr_get_freq(), esp_sdr_rx_gain_max(), decim, vrt_rx_get_rate(),
			    vrt_rx_get_bits());
	} else {
		shell_print(sh, "rx: freq %u MHz, rxgain %d (max %d), decim %s, %u S/s, %u bit",
			    esp_sdr_get_freq(), gain, esp_sdr_rx_gain_max(), decim, vrt_rx_get_rate(),
			    vrt_rx_get_bits());
	}
#if defined(CONFIG_APP_TX)
	shell_print(sh, "txgain %d (max %d, vendor target power %d)", esp_sdr_tx_get_gain(),
		    esp_sdr_tx_gain_max(), esp_sdr_tx_gain_power(esp_sdr_tx_get_gain()));
	print_tx_status(sh);
#endif
	return 0;
}

SHELL_STATIC_SUBCMD_SET_CREATE(sdr_cmds,
			       SHELL_CMD(status, NULL, "settings, transmit path state and counters",
					 cmd_status),
			       SHELL_CMD_ARG(set, NULL,
					     "[<key> <value> ...]: settings (without arguments: the keys)",
					     cmd_set, 1, 8),
			       SHELL_CMD(mem, NULL, "system heap use", cmd_mem),
			       SDR_TX_CMD SHELL_SUBCMD_SET_END);

SHELL_CMD_REGISTER(sdr, &sdr_cmds, "ESP-SDR radio", NULL);
```

## src/vrt_tx.c
```c
/*
 * SPDX-License-Identifier: GPL-3.0-or-later
 *
 * VITA 49.2 from the host over UDP: signal data placed by timestamp into the
 * esp_sdr_tx stream, and command packets that set the transmitter
 * or (by stream ID) the receiver, answered with acknowledges. Without
 * CONFIG_APP_TX only the receiver's commands are served.
 */

#include <errno.h>
#include <math.h>
#include <string.h>

#include <zephyr/kernel.h>
#include <zephyr/logging/log.h>
#include <zephyr/net/socket.h>
#include <zephyr/sys/util.h>

#include <esp_sdr/esp_sdr.h>
#include <esp_sdr/esp_sdr_tx.h>

#include <vrt/vrt_init.h>
#include <vrt/vrt_read.h>
#include <vrt/vrt_types.h>
#include <vrt/vrt_util.h>
#include <vrt/vrt_words.h>
#include <vrt/vrt_write.h>

#include "iq_pack.h"
#include "vrt_rx.h"
#include "vrt_tx.h"

LOG_MODULE_DECLARE(stream, LOG_LEVEL_INF);

/* A 1500 byte datagram. */
#define RX_WORDS       375
#define ACK_WORDS      32
#define IDLE_STOP_MS   500
#define TX_DAC_HZ      40000000.0
#define TX_RATE_MAX_HZ (TX_DAC_HZ / 2)
#define STACK_SIZE     2048

static ESP_SDR_HIGH_RAM uint32_t rx_buf[RX_WORDS];
static uint32_t ack_buf[ACK_WORDS];
/* Room for a full datagram of 8-bit items, two samples per word. */
static ESP_SDR_HIGH_RAM struct esp_sdr_iq16 samples[2 * RX_WORDS];
/* Item size the host sends, 8, 12 or 16 bits; set by a VITA command. */
static unsigned int tx_bits = 16;
static struct vrt_packet pkt, ack;
static struct vrt_command cmd, ack_cmd;

static int sock = -1;
static uint64_t tx_freq_hz = (uint64_t)CONFIG_APP_FREQ_MHZ * 1000000U;
#if defined(CONFIG_APP_TX)
static uint32_t tx_rate_hz = CONFIG_APP_TX_RATE;
#else
static uint32_t tx_rate_hz;
#endif
static uint8_t next_count;
static bool counted;
/* Next expected sample index from the packet timestamps, once one arrived. */
static uint64_t next_index;
static bool indexed;
static int64_t last_data_ms;
static struct vrt_tx_stats stats;

static K_THREAD_STACK_DEFINE(vrt_tx_stack, STACK_SIZE);
static struct k_thread tx_thread;

static void restart(void)
{
	(void)esp_sdr_tx_stop();
	counted = false;
	indexed = false;
}

/* Write zeros for count samples that never arrived. */
static void fill_hole(uint64_t count)
{
	stats.holes += (uint32_t)count;
	memset(samples, 0, sizeof(samples));
	while (count > 0U) {
		size_t n = (size_t)MIN(count, (uint64_t)ARRAY_SIZE(samples));

		if (esp_sdr_tx_write(samples, n) < 0) {
			stats.errors++;
		}
		count -= n;
	}
}

/*
 * Place the packet by its timestamp (sample time since the stream start):
 * missing packets become zero-filled holes, late or repeated samples are
 * dropped. Returns how many leading samples of the packet to skip.
 */
static size_t align_to_timestamp(size_t n)
{
	uint64_t index, ns;

	if (pkt.header.tsi == VRT_TSI_UNDEFINED || pkt.header.tsf != VRT_TSF_REAL_TIME) {
		return 0;
	}
	/* Seconds and fraction apart (ns is far finer than a sample) to stay in 64 bits. */
	ns = pkt.fields.fractional_seconds_timestamp / 1000U;
	index = (uint64_t)pkt.fields.integer_seconds_timestamp * tx_rate_hz +
		(ns * tx_rate_hz + NSEC_PER_SEC / 2U) / NSEC_PER_SEC;
	if (!indexed) {
		indexed = true;
		next_index = index;
	}
	if (index > next_index) {
		uint64_t gap = index - next_index;

		if (gap <= tx_rate_hz / 10U) {
			fill_hole(gap);
		}
		/* A longer jump restarts the schedule rather than sending silence. */
		next_index = index;
	} else if (index < next_index) {
		size_t skip = (size_t)MIN(next_index - index, (uint64_t)n);

		stats.late += (uint32_t)skip;
		next_index += n - skip;
		return skip;
	}
	next_index += n;
	return 0;
}

/* Link efficient complex, tx_bits per item, I first (see iq_unpack()). */
static void handle_data(void)
{
	size_t n;
	size_t skip;

	if (counted && pkt.header.packet_count != next_count) {
		stats.gaps++;
	}
	next_count = (pkt.header.packet_count + 1U) & 0xfU;
	counted = true;
	stats.data++;
	last_data_ms = k_uptime_get();
	if (!IS_ENABLED(CONFIG_APP_TX)) {
		/* No transmitter: the samples have nowhere to go. */
		stats.errors++;
		return;
	}

	if (!esp_sdr_tx_active()) {
		if (esp_sdr_tx_start(tx_freq_hz, tx_rate_hz) != 0) {
			stats.errors++;
			return;
		}
	}

	BUILD_ASSERT(sizeof(struct esp_sdr_iq16) == 2 * sizeof(int16_t));
	n = iq_unpack(pkt.body, (size_t)pkt.words_body, tx_bits, (int16_t *)samples,
		      ARRAY_SIZE(samples));
	skip = align_to_timestamp(n);
	if (n > skip && esp_sdr_tx_write(samples + skip, n - skip) < 0) {
		stats.errors++;
	}
}

/* Item size from a payload format field: link efficient complex signed fixed point only. */
static int payload_bits(const struct vrt_data_packet_payload_format *f)
{
	unsigned int bits = (unsigned int)f->data_item_size + 1U;

	if (f->packing_method != VRT_PM_LINK_EFFICIENT ||
	    f->real_or_complex != VRT_ROC_COMPLEX_CARTESIAN ||
	    f->data_item_format != VRT_DIF_SIGNED_FIXED_POINT ||
	    f->item_packing_field_size != f->data_item_size || !iq_bits_valid(bits)) {
		return -EINVAL;
	}
	return (int)bits;
}

static void report_payload(struct vrt_if_context *c, unsigned int bits)
{
	struct vrt_data_packet_payload_format *f = &c->data_packet_payload_format;

	c->has.data_packet_payload_format = true;
	f->packing_method = VRT_PM_LINK_EFFICIENT;
	f->real_or_complex = VRT_ROC_COMPLEX_CARTESIAN;
	f->data_item_format = VRT_DIF_SIGNED_FIXED_POINT;
	f->item_packing_field_size = (uint8_t)(bits - 1U);
	f->data_item_size = (uint8_t)(bits - 1U);
}

static void send_ack(const struct sockaddr *to, socklen_t to_len, bool query,
		     const struct vrt_ack_responses *errors, bool executed, bool rx)
{
	int32_t words;

	vrt_init_packet(&ack);
	vrt_init_command(&ack_cmd);
	ack.command = &ack_cmd;
	ack.header.packet_type = VRT_PT_COMMAND;
	ack.header.acknowledge = true;
	ack.fields.stream_id = pkt.fields.stream_id;
	ack_cmd.message_id = cmd.message_id;
	ack_cmd.cam.controllee_enable = cmd.cam.controllee_enable;
	ack_cmd.cam.controllee_format = cmd.cam.controllee_format;
	ack_cmd.controllee_id = cmd.controllee_id;
	memcpy(ack_cmd.controllee_uuid, cmd.controllee_uuid, sizeof(cmd.controllee_uuid));
	ack_cmd.cam.controller_enable = cmd.cam.controller_enable;
	ack_cmd.cam.controller_format = cmd.cam.controller_format;
	ack_cmd.controller_id = cmd.controller_id;
	memcpy(ack_cmd.controller_uuid, cmd.controller_uuid, sizeof(cmd.controller_uuid));

	if (query) {
		/* Query-state acknowledge: the current TX settings as context fields. */
		ack_cmd.cam.query_state = true;
		ack.if_context.has.rf_reference_frequency = true;
		ack.if_context.has.sample_rate = true;
		if (rx) {
			int gain = esp_sdr_rx_get_gain();

			ack.if_context.rf_reference_frequency = esp_sdr_get_freq() * 1e6;
			ack.if_context.sample_rate = vrt_rx_get_rate();
			/* Uncalibrated: stage 1 carries the PHY gain table index, not dB. */
			ack.if_context.has.gain = gain >= 0;
			ack.if_context.gain.stage1 = (float)gain;
			report_payload(&ack.if_context, vrt_rx_get_bits());
		} else {
			ack.if_context.rf_reference_frequency = (double)tx_freq_hz;
			ack.if_context.sample_rate = (double)tx_rate_hz;
			/* Stage 1 carries the transmit power step, see esp_sdr_tx_set_gain(). */
			ack.if_context.has.gain = true;
			ack.if_context.gain.stage1 = (float)esp_sdr_tx_get_gain();
			report_payload(&ack.if_context, tx_bits);
		}
	} else {
		ack_cmd.cam.execution = true;
		ack_cmd.cam.scheduled_or_executed = executed;
		ack_cmd.cam.errors = cmd.cam.errors && errors != NULL;
		if (ack_cmd.cam.errors) {
			ack_cmd.errors = *errors;
		}
	}

	ack.header.packet_size = (uint16_t)vrt_words_packet(&ack);
	words = vrt_write_packet(&ack, ack_buf, ARRAY_SIZE(ack_buf), true);
	if (words < 0) {
		stats.errors++;
		return;
	}
	vrt_to_big_endian(ack_buf, words);
	if (zsock_sendto(sock, ack_buf, (size_t)words * sizeof(uint32_t), 0, to, to_len) < 0) {
		stats.errors++;
		return;
	}
	stats.acks++;
}

/*
 * Commands addressed to the receive stream (CONFIG_APP_RX_STREAM_ID) steer
 * the receiver: RF reference frequency in whole MHz, and gain, where stage 1
 * is the PHY gain table index (uncalibrated, not dB) and stage 2 must be 0.
 * A sample rate is only accepted if it is the stream's.
 */
static void handle_rx_command(const struct sockaddr *from, socklen_t from_len)
{
	struct vrt_ack_responses errors = {0};
	const struct vrt_if_context *c = &pkt.if_context;
	uint32_t mhz = esp_sdr_get_freq();
	uint32_t rate = vrt_rx_get_rate();
	int gain = esp_sdr_rx_get_gain();
	int bits = 0;
	bool any_error = false, executed = false;

	if (c->has.rf_reference_frequency) {
		double f = c->rf_reference_frequency / 1e6;

		if (f < ESP_SDR_FREQ_MIN_MHZ || f > ESP_SDR_FREQ_MAX_MHZ || f != floor(f)) {
			errors.has.rf_reference_frequency = true;
			errors.rf_reference_frequency = VRT_WEF_PARAMETER_OUT_OF_RANGE;
			any_error = true;
		} else {
			mhz = (uint32_t)f;
		}
	}
	if (c->has.gain) {
		float g = c->gain.stage1;

		if (c->gain.stage2 != 0.0f || g < 0.0f || g > (float)esp_sdr_rx_gain_max() ||
		    g != floorf(g)) {
			errors.has.gain = true;
			errors.gain = VRT_WEF_PARAMETER_OUT_OF_RANGE;
			any_error = true;
		} else {
			gain = (int)g;
		}
	}
	if (c->has.data_packet_payload_format) {
		bits = payload_bits(&c->data_packet_payload_format);
		if (bits < 0) {
			errors.has.data_packet_payload_format = true;
			errors.data_packet_payload_format = VRT_WEF_PARAMETER_OUT_OF_RANGE;
			any_error = true;
		}
	}
	if (c->has.sample_rate) {
		/* Capture rate (raw bursts) or capture rate / m, decimated on the board. */
		double r = c->sample_rate;
		uint32_t fs = esp_sdr_rx_rate_hz(CONFIG_APP_RX_RATE);

		if (r < 1.0 || r > fs || r != floor(r) || fs % (uint32_t)r != 0U ||
		    (fs / (uint32_t)r != 1U && (fs / (uint32_t)r < VRT_RX_DECIM_MIN ||
						 fs / (uint32_t)r > ESP_SDR_RX_DECIM_MAX))) {
			errors.has.sample_rate = true;
			errors.sample_rate = VRT_WEF_PARAMETER_OUT_OF_RANGE;
			any_error = true;
		} else {
			rate = (uint32_t)r;
		}
	}

	if (cmd.cam.action_mode == VRT_AM_EXECUTE && (!any_error || cmd.cam.permit_errors)) {
		if (mhz != esp_sdr_get_freq() && esp_sdr_set_freq(mhz) != 0) {
			stats.errors++;
		}
		if (c->has.gain && !errors.has.gain && esp_sdr_rx_set_gain(gain) != 0) {
			stats.errors++;
		}
		if (rate != vrt_rx_get_rate() && vrt_rx_set_rate(rate) != 0) {
			stats.errors++;
		}
		if (bits > 0 && vrt_rx_set_bits((unsigned int)bits) != 0) {
			stats.errors++;
		}
		executed = true;
	}

	if (cmd.cam.execution && (!cmd.cam.nack_only || any_error)) {
		send_ack(from, from_len, false, any_error ? &errors : NULL, executed, true);
	}
	if (cmd.cam.query_state) {
		send_ack(from, from_len, true, NULL, false, true);
	}
}

static void handle_tx_command(const struct sockaddr *from, socklen_t from_len)
{
	struct vrt_ack_responses errors = {0};
	const struct vrt_if_context *c = &pkt.if_context;
	uint64_t freq = tx_freq_hz;
	uint32_t rate = tx_rate_hz;
	int gain = esp_sdr_tx_get_gain();
	int bits = 0;
	bool any_error = false, executed = false;

	if (c->has.rf_reference_frequency) {
		double f = c->rf_reference_frequency;

		/* Whole MHz: the transmit LO is the receiver's and tunes in MHz. */
		if (f < ESP_SDR_FREQ_MIN_MHZ * 1e6 || f > ESP_SDR_FREQ_MAX_MHZ * 1e6 ||
		    fmod(f, 1e6) != 0.0) {
			errors.has.rf_reference_frequency = true;
			errors.rf_reference_frequency = VRT_WEF_PARAMETER_OUT_OF_RANGE;
			any_error = true;
		} else {
			freq = (uint64_t)f;
		}
	}
	if (c->has.gain) {
		float g = c->gain.stage1;

		if (c->gain.stage2 != 0.0f || g < 0.0f || g > (float)esp_sdr_tx_gain_max() ||
		    g != floorf(g)) {
			errors.has.gain = true;
			errors.gain = VRT_WEF_PARAMETER_OUT_OF_RANGE;
			any_error = true;
		} else {
			gain = (int)g;
		}
	}
	if (c->has.data_packet_payload_format) {
		bits = payload_bits(&c->data_packet_payload_format);
		if (bits < 0) {
			errors.has.data_packet_payload_format = true;
			errors.data_packet_payload_format = VRT_WEF_PARAMETER_OUT_OF_RANGE;
			any_error = true;
		}
	}
	if (c->has.sample_rate) {
		double r = c->sample_rate;

		/* The DAC stream interpolates by an integer factor of at least 2. */
		if (r < 1.0 || r > TX_RATE_MAX_HZ || fmod(TX_DAC_HZ, r) != 0.0) {
			errors.has.sample_rate = true;
			errors.sample_rate = VRT_WEF_PARAMETER_OUT_OF_RANGE;
			any_error = true;
		} else {
			rate = (uint32_t)r;
		}
	}

	if (cmd.cam.action_mode == VRT_AM_EXECUTE && (!any_error || cmd.cam.permit_errors)) {
		bool changed = freq != tx_freq_hz || rate != tx_rate_hz ||
			       gain != esp_sdr_tx_get_gain();

		tx_freq_hz = freq;
		tx_rate_hz = rate;
		/* Applied when the next transmission switches the front end. */
		if (esp_sdr_tx_set_gain(gain) != 0) {
			stats.errors++;
		}
		if (bits > 0) {
			tx_bits = (unsigned int)bits;
		}
		if (changed && esp_sdr_tx_active()) {
			restart();
		}
		executed = true;
	}

	if (cmd.cam.execution && (!cmd.cam.nack_only || any_error)) {
		send_ack(from, from_len, false, any_error ? &errors : NULL, executed, false);
	}
	if (cmd.cam.query_state) {
		send_ack(from, from_len, true, NULL, false, false);
	}
}

static void handle_command(const struct sockaddr *from, socklen_t from_len)
{
	stats.commands++;
	if (pkt.header.acknowledge || pkt.header.cancellation) {
		return;
	}
	if (pkt.fields.stream_id == CONFIG_APP_RX_STREAM_ID) {
		handle_rx_command(from, from_len);
	} else if (IS_ENABLED(CONFIG_APP_TX)) {
		handle_tx_command(from, from_len);
	} else {
		/* No transmitter: its commands go unanswered. */
		stats.errors++;
	}
}

static void tx_loop(void *p1, void *p2, void *p3)
{
	struct sockaddr_in6 from;

	ARG_UNUSED(p1);
	ARG_UNUSED(p2);
	ARG_UNUSED(p3);

	for (;;) {
		socklen_t from_len = sizeof(from);
		ssize_t len = zsock_recvfrom(sock, rx_buf, sizeof(rx_buf), 0,
					     (struct sockaddr *)&from, &from_len);
		int32_t words, rv;

		if (len < 0) {
			/* Receive timeout: stop after a pause in the sample stream. */
			if (IS_ENABLED(CONFIG_APP_TX) && esp_sdr_tx_active() &&
			    k_uptime_get() - last_data_ms > IDLE_STOP_MS) {
				restart();
			}
			continue;
		}
		if (len % sizeof(uint32_t) != 0) {
			stats.bad++;
			continue;
		}
		words = (int32_t)(len / sizeof(uint32_t));
		vrt_from_big_endian(rx_buf, words);
		vrt_init_packet(&pkt);
		vrt_init_command(&cmd);
		pkt.command = &cmd;
		rv = vrt_read_packet(rx_buf, words, &pkt, true);
		if (rv < 0) {
			stats.bad++;
			continue;
		}
		if (vrt_is_data(&pkt.header)) {
			handle_data();
		} else if (vrt_is_command(&pkt.header)) {
			handle_command((struct sockaddr *)&from, from_len);
		} else {
			stats.bad++;
		}
	}
}

int vrt_tx_init(void)
{
	struct sockaddr_in6 addr = {
		.sin6_family = AF_INET6,
		.sin6_port = htons(CONFIG_APP_TX_UDP_PORT),
		.sin6_addr = IN6ADDR_ANY_INIT,
	};
	struct zsock_timeval timeout = {.tv_usec = 100000};

	sock = zsock_socket(AF_INET6, SOCK_DGRAM, IPPROTO_UDP);
	if (sock < 0) {
		return -errno;
	}
	if (zsock_bind(sock, (struct sockaddr *)&addr, sizeof(addr)) < 0 ||
	    zsock_setsockopt(sock, SOL_SOCKET, SO_RCVTIMEO, &timeout, sizeof(timeout)) < 0) {
		return -errno;
	}
	k_thread_create(&tx_thread, vrt_tx_stack, K_THREAD_STACK_SIZEOF(vrt_tx_stack), tx_loop,
			NULL, NULL, NULL, K_PRIO_PREEMPT(7), 0, K_NO_WAIT);
	k_thread_name_set(&tx_thread, "vrt_tx");
	LOG_INF("tx: VITA 49.2 on UDP port %d", CONFIG_APP_TX_UDP_PORT);
	return 0;
}

void vrt_tx_get_stats(struct vrt_tx_stats *out)
{
	*out = stats;
}

void vrt_tx_get_settings(uint64_t *freq_hz, uint32_t *rate_hz)
{
	*freq_hz = tx_freq_hz;
	*rate_hz = tx_rate_hz;
}
```

## src/vrt_tx.h
```c
/*
 * SPDX-License-Identifier: GPL-3.0-or-later
 */

#ifndef STREAM_VRT_TX_H_
#define STREAM_VRT_TX_H_

#include <stdint.h>

struct vrt_tx_stats {
	uint32_t data;      /* signal data packets */
	uint32_t commands;  /* command packets */
	uint32_t acks;      /* acknowledges sent */
	uint32_t gaps;      /* packet counter discontinuities */
	uint32_t holes;     /* samples zero-filled where packets were missing (timestamps) */
	uint32_t late;      /* samples dropped as already passed (timestamps) */
	uint32_t bad;       /* undecodable datagrams */
	uint32_t errors;    /* transmit or socket failures */
};

/* Open the UDP port and start the receive thread. */
int vrt_tx_init(void);
/* Packet and sample counters. */
void vrt_tx_get_stats(struct vrt_tx_stats *stats);
/* The transmit frequency and sample rate in use. */
void vrt_tx_get_settings(uint64_t *freq_hz, uint32_t *rate_hz);

#endif /* STREAM_VRT_TX_H_ */
```
