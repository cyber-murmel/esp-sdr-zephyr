## CMakeLists.txt
```
# SPDX-License-Identifier: GPL-3.0-or-later

cmake_minimum_required(VERSION 3.20.0)

find_package(Zephyr REQUIRED HINTS $ENV{ZEPHYR_BASE})
project(esp_sdr_chancap)

include(${CMAKE_CURRENT_LIST_DIR}/../common/common.cmake)

target_sources(app PRIVATE
  src/main.c
  src/vrt_cc.c
  src/shell.c
  src/usb_cc.c)
```

## Kconfig
```
# SPDX-License-Identifier: GPL-3.0-or-later

mainmenu "ESP-SDR chancap"

config APP_FIRST_FREQ_HZ
	int "Centre of channel 0 in Hz at boot"
	default 2402000000

config APP_SPACING_HZ
	int "Channel spacing in Hz at boot"
	default 2000000

config APP_CHANNELS
	int "Channels at boot"
	range 1 16
	default 8

config APP_CHANNEL_RATE_HZ
	int "Per-channel sample rate in Hz at boot"
	default 2000000
	help
	  The spacing or twice it for a grid that divides 16 MHz (the filter
	  bank); 16 MHz divided by an integer for other grids (a decimator
	  per channel, 4 MS/s for IEEE 802.15.4).

config APP_WB_THRESHOLD_DB
	int "Wideband gate threshold in dB above its noise floor"
	default 8

config APP_CH_THRESHOLD_DB
	int "Per-channel threshold in dB above the channel's noise floor"
	default 10

config APP_LOOKBACK_US
	int "Samples before a trigger kept in a capture, us"
	default 64

config APP_HANG_US
	int "Hold after the power drops, us"
	default 250

config APP_MAX_CAPTURE_US
	int "Longest capture (and the chunk length with the per-channel gate off), us"
	default 2400

config APP_AUTOSTART
	bool "Start capturing at boot"
	default y

config APP_RX_BW_MHZ
	int "Receive filter bandwidth in MHz at boot (0: widest, -1: the PHY's setting)"
	range -1 69
	default 18
	help
	  Two-sided. The grid fills up to 16 MHz around the LO; the widest
	  setting lets more of what lies beyond alias in, the narrowest
	  (13 MHz) cuts the edge channels.

config APP_RX_GAIN
	int "Receive gain index at boot (-1: hardware AGC)"
	range -1 82
	default -1

config APP_USB_BLOCKS
	int "4 KiB blocks between the VRT encoder and USB"
	default 3
	help
	  Internal RAM above the capture bank (USB DMA). Each holds two
	  signal data packets.

config APP_SAMPLES_PER_PACKET
	int "Complex samples per signal data packet"
	range 1 1000
	default 500
	help
	  16-bit items: 500 samples plus the header and trailer words make
	  2024 bytes, two per block.

config APP_STREAM_ID_BASE
	hex "VITA 49 stream identifier of channel 0; channel c uses base + c"
	default 0x5d5d0200

rsource "../common/Kconfig"

source "samples/subsys/usb/common/Kconfig.sample_usbd"

source "Kconfig.zephyr"
```

## sample.yaml
```
sample:
  name: ESP-SDR chancap
  description: >-
    Channelized burst capture: one VITA 49.2 stream per channel of a uniform
    grid over a vendor bulk endpoint, one capture per packet
common:
  tags:
    - esp-sdr
    - chancap
  sysbuild: true
  platform_allow:
    - xiao_esp32s3/esp32s3/procpu
    - communicator_badge/esp32s3/procpu
  integration_platforms:
    - xiao_esp32s3/esp32s3/procpu
tests:
  # Needs a host: run tools/chancap_bridge.py (see README).
  sample.esp_sdr.chancap:
    build_only: true
```

## prj.conf
```kconfig
# The Wi-Fi driver brings the radio up at boot; nothing may scan or connect.
CONFIG_NETWORKING=y
CONFIG_WIFI=y
CONFIG_ESP32_WIFI_STA_POWER_SAVE_NONE=y
# No IP traffic: the network stack only carries the Wi-Fi driver, minimal.
CONFIG_NET_IPV6=n
CONFIG_NET_IPV4=y
CONFIG_NET_PKT_RX_COUNT=4
CONFIG_NET_PKT_TX_COUNT=4
CONFIG_NET_BUF_RX_COUNT=8
CONFIG_NET_BUF_TX_COUNT=8
CONFIG_NET_RX_STACK_SIZE=1024

CONFIG_ESP_SDR=y
# Continuous receive: the ring's banks, so the DRAM image ends below 0x3fcb0000.
CONFIG_ESP_SDR_RING=y
# Raw only: the decimating FIR stays out of IRAM.
CONFIG_ESP_SDR_RING_FIR=n
CONFIG_ESP_SDR_CHANCAP=y
CONFIG_ESP_SDR_RX_DECIM=n

# VITA 49.2 packets (libvrt).
CONFIG_LIBVRT=y

CONFIG_LOG=y
CONFIG_LOG_MODE_DEFERRED=y
CONFIG_LOG_BUFFER_SIZE=512

# Filter design at run start, dB in the shell.
CONFIG_FPU=y
CONFIG_FPU_SHARING=y
CONFIG_PICOLIBC_IO_FLOAT=y
CONFIG_MAIN_STACK_SIZE=1536
CONFIG_ISR_STACK_SIZE=1024

CONFIG_SMP=y
CONFIG_SCHED_CPU_MASK=y

# USB device on the OTG port: the capture function, shell on CDC-ACM, DFU
# with sysbuild/MCUboot.
CONFIG_USB_DEVICE_STACK_NEXT=y
CONFIG_SAMPLE_USBD_PRODUCT="ESP-SDR chancap"
# Same PID as the other apps (host udev rules); told apart by the product string.
CONFIG_SAMPLE_USBD_PID=0x0005
CONFIG_USBD_LOG_LEVEL_WRN=y
CONFIG_UDC_DRIVER_LOG_LEVEL_WRN=y
CONFIG_USBD_THREAD_STACK_SIZE=2048
CONFIG_UDC_DWC2_STACK_SIZE=1280
CONFIG_USBD_CDC_ACM_CLASS=y
CONFIG_USBD_CDC_ACM_LOG_LEVEL_OFF=y
CONFIG_CDC_ACM_SERIAL_INITIALIZE_AT_BOOT=n

CONFIG_SHELL=y
CONFIG_KERNEL_SHELL=y
CONFIG_LOG_BACKEND_UART=n
CONFIG_SHELL_STACK_SIZE=3072
CONFIG_SHELL_CMD_BUFF_SIZE=128
CONFIG_SHELL_HISTORY=n
CONFIG_SHELL_BACKEND_SERIAL_LOG_MESSAGE_QUEUE_SIZE=256
CONFIG_DEVICE_SHELL=n
CONFIG_DATE_SHELL=n
CONFIG_DEVMEM_SHELL=y
# Wi-Fi management commands would retune the radio under the run.
CONFIG_NET_L2_WIFI_SHELL=n

# Internal RAM: three 64 KiB dump banks must fit. The Wi-Fi heap and the
# capture slab go to the 8 MB octal PSRAM.
CONFIG_ESP_SPIRAM=y
CONFIG_SPIRAM_MODE_OCT=y
CONFIG_ESP_WIFI_HEAP_SPIRAM=y
CONFIG_ESP32_WIFI_STATIC_RX_BUFFER_NUM=4
CONFIG_ESP32_WIFI_MGMT_SBUF_NUM=8
CONFIG_ESP32_WIFI_EVENT_TASK_STACK_SIZE=1024
CONFIG_NET_MGMT_EVENT_STACK_SIZE=1024
CONFIG_HEAP_MEM_POOL_IGNORE_MIN=y
CONFIG_HEAP_MEM_POOL_SIZE=17408
CONFIG_SYS_HEAP_RUNTIME_STATS=y

# The system work queue and the CDC-ACM class's work queue (the shell's console output) run
# at this priority: preemptible, below the channelizer, which else waits for a work item to
# finish (hundreds of us per USB packet of console output).
CONFIG_SYSTEM_WORKQUEUE_PRIORITY=11
# The channelizer sleeps a tick when it has caught up: 50 us ticks halve what that costs of
# the hand-over ring's slack.
CONFIG_SYS_CLOCK_TICKS_PER_SEC=20000
# The USB device stack's thread and the DWC2 driver's are cooperative by default and run
# hundreds of microseconds per transfer burst: preemptible here, for the same reason.
CONFIG_USBD_THREAD_PREEMPTIBLE=y
CONFIG_UDC_DWC2_THREAD_PREEMPTIBLE=y

CONFIG_RESET_ON_FATAL_ERROR=y
CONFIG_APP_LIVENESS_WATCHDOG=y
```

## boards/communicator_badge_procpu.overlay
```dts
/*
 * SPDX-License-Identifier: GPL-3.0-or-later
 */

/ {
	chosen {
		zephyr,console = &cdc_acm_uart0;
		zephyr,shell-uart = &cdc_acm_uart0;
	};
};

zephyr_udc0: &usb_otg {
	status = "okay";

	/* Console, shell and logs while OTG owns the USB port. */
	cdc_acm_uart0: cdc_acm_uart0 {
		compatible = "zephyr,cdc-acm-uart";
		label = "ESP-SDR chancap shell";
	};
};
```

## socs/esp32s3_procpu.overlay
```dts
/*
 * SPDX-License-Identifier: GPL-3.0-or-later
 */

#define APP_SHELL_LABEL "ESP-SDR chancap shell"
#include "../../common/boards/s3_cdc_shell.dtsi"
```

## src/main.c
```c
/*
 * SPDX-License-Identifier: GPL-3.0-or-later
 *
 * Channelized burst capture over USB: the library's capture pipeline (esp_sdr_chancap.h),
 * every capture as VITA 49.2 on its channel's stream over a vendor bulk endpoint, next to
 * the CDC-ACM shell and DFU. The ring owns CPU 1; the channelizer, USB and the shell share
 * CPU 0.
 */

#include <zephyr/app_version.h>
#include <zephyr/kernel.h>
#include <zephyr/logging/log.h>

#include <esp_sdr/esp_sdr.h>
#include <esp_sdr/esp_sdr_rx.h>

#include "app.h"
#include "app_cpu.h"
#include "app_usb.h"

LOG_MODULE_REGISTER(chancap, LOG_LEVEL_INF);

static struct cc_settings settings = {
	.cfg = {
		.first_freq_hz = CONFIG_APP_FIRST_FREQ_HZ,
		.spacing_hz = CONFIG_APP_SPACING_HZ,
		.n_channels = CONFIG_APP_CHANNELS,
		.channel_rate_hz = CONFIG_APP_CHANNEL_RATE_HZ,
		.wb_gate = true,
		.ch_gate = true,
		.wb_threshold_db = CONFIG_APP_WB_THRESHOLD_DB,
		.ch_threshold_db = CONFIG_APP_CH_THRESHOLD_DB,
		.lookback_us = CONFIG_APP_LOOKBACK_US,
		.hang_us = CONFIG_APP_HANG_US,
		.max_capture_us = CONFIG_APP_MAX_CAPTURE_US,
		.cb = vrt_cc_capture,
	},
	.rx_gain = CONFIG_APP_RX_GAIN,
	.rx_bw_mhz = CONFIG_APP_RX_BW_MHZ,
};

struct cc_settings *cc_settings(void)
{
	return &settings;
}

int cc_start(void)
{
	int ret;

	if (esp_sdr_chancap_active()) {
		return -EBUSY;
	}
	ret = esp_sdr_rx_set_gain(settings.rx_gain < 0 ? ESP_SDR_RX_GAIN_AUTO : settings.rx_gain);
	if (ret != 0) {
		LOG_WRN("rx gain %d: %d", settings.rx_gain, ret);
	}
	if (settings.rx_bw_mhz >= 0) {
		uint32_t bw_min, bw_max;

		esp_sdr_rx_bandwidth_range(&bw_min, &bw_max);
		ret = esp_sdr_rx_set_bandwidth(settings.rx_bw_mhz == 0 ? bw_max
								      : (uint32_t)settings.rx_bw_mhz);
	} else {
		ret = esp_sdr_rx_set_lpf(ESP_SDR_RX_LPF_AUTO);
	}
	if (ret != 0) {
		LOG_WRN("rx bandwidth %d MHz: %d", settings.rx_bw_mhz, ret);
	}
	return esp_sdr_chancap_start(&settings.cfg);
}

void cc_stop(void)
{
	esp_sdr_chancap_stop();
}

/* Before a DFU download: the ring would keep CPU 1 from taking the flash stall request. */
void app_usb_dfu_prepare(void)
{
	cc_stop();
}

int main(void)
{
	int ret;

	printk("chancap %s\n", APP_VERSION_STRING);
	/* Before USB starts: its controller interrupt lands on the CPU that allocates it. */
	app_cpu_pin_system_threads(0);
	if (app_usb_init() != 0) {
		LOG_ERR("usb init failed");
	}
	(void)vrt_cc_init();
	ret = esp_sdr_init();
	if (ret != 0) {
		LOG_ERR("radio init: %d", ret);
		return 0;
	}
	/* Again for the threads started since (usbd, UDC). */
	k_sleep(K_MSEC(500));
	app_cpu_pin_system_threads(0);
	if (IS_ENABLED(CONFIG_APP_AUTOSTART)) {
		ret = cc_start();
		if (ret != 0) {
			LOG_ERR("start: %d", ret);
		}
	}
	return 0;
}
```

## src/app.h
```c
/*
 * SPDX-License-Identifier: GPL-3.0-or-later
 *
 * Shared between main, the shell and the encoder: the settings and the run control.
 */

#ifndef CHANCAP_APP_H_
#define CHANCAP_APP_H_

#include <stdbool.h>
#include <stdint.h>

#include <esp_sdr/esp_sdr_chancap.h>

struct cc_settings {
	struct esp_sdr_chancap_cfg cfg;
	/* ESP_SDR_RX_GAIN_AUTO or a gain index; bandwidth in MHz (0 widest, -1 the PHY's). */
	int rx_gain;
	int rx_bw_mhz;
};

struct cc_settings *cc_settings(void);
/* Apply the settings to the radio and start; stop. */
int cc_start(void);
void cc_stop(void);

struct vrt_cc_stats {
	uint32_t captures, packets, context, blocks, bytes;
	/* Captures dropped for want of a USB block, and USB errors. */
	uint32_t dropped, errors;
	/* Blocks free right now. */
	uint32_t blocks_free;
};

int vrt_cc_init(void);
/* The capture callback (esp_sdr_chancap_cb_t). */
void vrt_cc_capture(void *user, const struct esp_sdr_chancap *cap);
void vrt_cc_get_stats(struct vrt_cc_stats *st);

#endif /* CHANCAP_APP_H_ */
```

## src/shell.c
```c
/*
 * SPDX-License-Identifier: GPL-3.0-or-later
 *
 * The "chancap" shell command: the grid and detector settings, start and stop, status,
 * the plan and the bench. Settings apply at the next start; gates and thresholds also to
 * the running capture.
 */

#include <stdlib.h>
#include <string.h>

#include <zephyr/kernel.h>
#include <zephyr/shell/shell.h>
#include <zephyr/sys/sys_heap.h>

#include <esp_sdr/esp_sdr.h>
#include <esp_sdr/esp_sdr_rx.h>
#include <esp_sdr/esp_sdr_chancap.h>

#include "app.h"
#include "app_shell.h"

extern struct k_heap _system_heap;

static int parse_onoff(const struct shell *sh, const char *s, bool *out)
{
	if (strcmp(s, "on") == 0 || strcmp(s, "1") == 0) {
		*out = true;
		return 0;
	}
	if (strcmp(s, "off") == 0 || strcmp(s, "0") == 0) {
		*out = false;
		return 0;
	}
	shell_error(sh, "%s: on or off", s);
	return -EINVAL;
}

static int cmd_start(const struct shell *sh, size_t argc, char **argv)
{
	int ret = cc_start();

	ARG_UNUSED(argc);
	ARG_UNUSED(argv);
	if (ret != 0) {
		shell_error(sh, "start: %d", ret);
		return ret;
	}
	shell_print(sh, "started");
	return 0;
}

static int cmd_stop(const struct shell *sh, size_t argc, char **argv)
{
	ARG_UNUSED(argc);
	ARG_UNUSED(argv);
	cc_stop();
	shell_print(sh, "stopped");
	return 0;
}

static int cmd_status(const struct shell *sh, size_t argc, char **argv)
{
	struct cc_settings *s = cc_settings();
	struct esp_sdr_chancap_stats st;
	struct esp_sdr_chancap_plan p;
	struct vrt_cc_stats vs;
	struct sys_memory_stats hs;

	ARG_UNUSED(argc);
	ARG_UNUSED(argv);
	esp_sdr_chancap_get_stats(&st);
	esp_sdr_chancap_get_plan(&p);
	vrt_cc_get_stats(&vs);
	shell_print(sh, "%s: %u channels from %u Hz every %u Hz at %u S/s; gates wb %s ch %s, "
		    "thresholds %d / %d dB, lookback %u hang %u max %u us; rxgain %d, bw %d MHz",
		    esp_sdr_chancap_active() ? "running" : "stopped", s->cfg.n_channels,
		    s->cfg.first_freq_hz, s->cfg.spacing_hz, s->cfg.channel_rate_hz,
		    s->cfg.wb_gate ? "on" : "off", s->cfg.ch_gate ? "on" : "off",
		    s->cfg.wb_threshold_db, s->cfg.ch_threshold_db, s->cfg.lookback_us,
		    s->cfg.hang_us, s->cfg.max_capture_us, s->rx_gain, s->rx_bw_mhz);
	shell_print(sh, "plan: %s m %u d %u, %u taps, LO %llu Hz", p.pfb ? "pfb" : "ddc", p.m, p.d,
		    p.taps, (unsigned long long)p.lo_hz);
	shell_print(sh, "pairs %llu, channelized %llu, captures %u (%u truncated, %u dropped), "
		    "overruns %u, gaps %u, %u.%02u cycles per pair, block max %u, lag max %u, "
		    "buffers %u (peak %u)",
		    (unsigned long long)st.pairs, (unsigned long long)st.pairs_run, st.captures,
		    st.truncated, st.dropped, st.overruns, st.gaps, st.cycles_x100 / 100U,
		    st.cycles_x100 % 100U, st.block_max, st.lag_max, st.bufs_used, st.bufs_peak);
	shell_print(sh, "ring: status %d detail 0x%08x, %u units, %u abandoned, %u lost pairs, "
		    "late max %u, %u.%02u cycles per pair",
		    st.ring.status, st.ring.detail, st.ring.units, st.ring.abandoned,
		    st.ring.lost_pairs, st.ring.late_max, st.ring.cycles_x100 / 100U,
		    st.ring.cycles_x100 % 100U);
	{
		struct esp_sdr_stats rx;

		esp_sdr_get_stats(&rx);
		shell_print(sh, "ring detail: %llu pairs, %u irq windows (lines 0x%08x), %u stalls, "
			    "slice max %u; gain re-forced %u in the ring, %u in all (last %u us)",
			    (unsigned long long)st.ring.pairs, st.ring.irq_windows,
			    st.ring.irq_lines, st.ring.stalls, st.ring.slice_max,
			    st.ring.gain_refreshed, rx.gain_refreshed, rx.gain_apply_us);
	}
	shell_print(sh, "vrt: %u captures, %u data, %u context packets, %u blocks, %u kB, "
		    "%u dropped, %u errors, %u blocks free",
		    vs.captures, vs.packets, vs.context, vs.blocks, vs.bytes / 1024U, vs.dropped,
		    vs.errors, vs.blocks_free);
	if (sys_heap_runtime_stats_get(&_system_heap.heap, &hs) == 0) {
		shell_print(sh, "system heap: %u allocated, %u free, %u peak",
			    (unsigned int)hs.allocated_bytes, (unsigned int)hs.free_bytes,
			    (unsigned int)hs.max_allocated_bytes);
	}
	return 0;
}

static int cmd_bench(const struct shell *sh, size_t argc, char **argv)
{
	struct esp_sdr_chancap_bench_result r;
	long pairs = 8192;
	int ret;

	if (argc > 1 && app_shell_long(sh, argv[1], 512, 1 << 20, &pairs) != 0) {
		return -EINVAL;
	}
	ret = esp_sdr_chancap_bench(&cc_settings()->cfg, (uint32_t)(pairs & ~511L), &r);
	if (ret != 0) {
		shell_error(sh, "bench: %d", ret);
		return ret;
	}
	shell_print(sh, "bench%s: ring CPU %u.%02u, channelizer CPU %u.%02u cycles per input pair "
		    "(15 available each); C engines alone: pfb frame %u.%02u, ddc channel %u.%02u",
		    r.fast ? " (both CPUs)" : "", r.ring_x100 / 100U, r.ring_x100 % 100U,
		    r.block_x100 / 100U, r.block_x100 % 100U, r.pfb_x100 / 100U, r.pfb_x100 % 100U,
		    r.ddc_x100 / 100U, r.ddc_x100 % 100U);
	if (r.fast) {
		shell_print(sh, "kernels per call: sums %u (a frame), post %u (8 frames), power %u; "
			    "%s (%u mismatches)",
			    r.sums_cyc, r.post_cyc, r.power_cyc,
			    r.kernels_match ? "match the C reference" : "MISMATCH", r.mismatches);
	}
	return 0;
}

static int set_first(const struct shell *sh, const char *v)
{
	char *end;
	/* Beyond a 32-bit long; the field is 32 bits, so 4 GHz at most. */
	unsigned long long x = strtoull(v, &end, 0);

	if (*v == '\0' || *end != '\0' || x < 100000000ULL || x > 4000000000ULL) {
		shell_error(sh, "bad value: %s (100 MHz to 4 GHz)", v);
		return -EINVAL;
	}
	cc_settings()->cfg.first_freq_hz = (uint32_t)x;
	return 0;
}

static int set_spacing(const struct shell *sh, const char *v)
{
	long x;

	if (app_shell_long(sh, v, 1000, 16000000, &x) != 0) {
		return -EINVAL;
	}
	cc_settings()->cfg.spacing_hz = (uint32_t)x;
	return 0;
}

static int set_channels(const struct shell *sh, const char *v)
{
	long x;

	if (app_shell_long(sh, v, 1, ESP_SDR_CHANCAP_CHANNELS_MAX, &x) != 0) {
		return -EINVAL;
	}
	cc_settings()->cfg.n_channels = (uint16_t)x;
	return 0;
}

static int set_rate(const struct shell *sh, const char *v)
{
	long x;

	if (app_shell_long(sh, v, 1000, 16000000, &x) != 0) {
		return -EINVAL;
	}
	cc_settings()->cfg.channel_rate_hz = (uint32_t)x;
	return 0;
}

static int set_db(const struct shell *sh, const char *v, int16_t *out)
{
	long x;

	if (app_shell_long(sh, v, 0, 60, &x) != 0) {
		return -EINVAL;
	}
	*out = (int16_t)x;
	return 0;
}

static int set_wb(const struct shell *sh, const char *v)
{
	struct cc_settings *s = cc_settings();
	int ret = set_db(sh, v, &s->cfg.wb_threshold_db);

	if (ret == 0 && esp_sdr_chancap_active()) {
		ret = esp_sdr_chancap_set_thresholds(s->cfg.wb_threshold_db, s->cfg.ch_threshold_db);
	}
	return ret;
}

static int set_ch(const struct shell *sh, const char *v)
{
	struct cc_settings *s = cc_settings();
	int ret = set_db(sh, v, &s->cfg.ch_threshold_db);

	if (ret == 0 && esp_sdr_chancap_active()) {
		ret = esp_sdr_chancap_set_thresholds(s->cfg.wb_threshold_db, s->cfg.ch_threshold_db);
	}
	return ret;
}

static int set_us(const struct shell *sh, const char *v, uint32_t *out, long max)
{
	long x;

	if (app_shell_long(sh, v, 0, max, &x) != 0) {
		return -EINVAL;
	}
	*out = (uint32_t)x;
	return 0;
}

static int set_lookback(const struct shell *sh, const char *v)
{
	return set_us(sh, v, &cc_settings()->cfg.lookback_us, 200);
}

static int set_hang(const struct shell *sh, const char *v)
{
	return set_us(sh, v, &cc_settings()->cfg.hang_us, 10000);
}

static int set_max(const struct shell *sh, const char *v)
{
	return set_us(sh, v, &cc_settings()->cfg.max_capture_us, 20000);
}

static int set_gate(const struct shell *sh, const char *v, bool *out)
{
	struct cc_settings *s = cc_settings();
	int ret = parse_onoff(sh, v, out);

	if (ret == 0 && esp_sdr_chancap_active()) {
		ret = esp_sdr_chancap_set_gates(s->cfg.wb_gate, s->cfg.ch_gate);
	}
	return ret;
}

static int set_wbgate(const struct shell *sh, const char *v)
{
	return set_gate(sh, v, &cc_settings()->cfg.wb_gate);
}

static int set_chgate(const struct shell *sh, const char *v)
{
	return set_gate(sh, v, &cc_settings()->cfg.ch_gate);
}

static int set_rxgain(const struct shell *sh, const char *v)
{
	long g = -1;

	if (strcmp(v, "auto") != 0 && app_shell_long(sh, v, 0, esp_sdr_rx_gain_max(), &g) != 0) {
		return -EINVAL;
	}
	cc_settings()->rx_gain = (int)g;
	return 0;
}

static int set_bw(const struct shell *sh, const char *v)
{
	long x;

	if (app_shell_long(sh, v, -1, 69, &x) != 0) {
		return -EINVAL;
	}
	cc_settings()->rx_bw_mhz = (int)x;
	return 0;
}

static const struct setting {
	const char *key, *help;
	int (*set)(const struct shell *sh, const char *value);
} settings[] = {
	{"first", "<Hz>: centre of channel 0", set_first},
	{"spacing", "<Hz>: channel spacing", set_spacing},
	{"channels", "<n>: channels", set_channels},
	{"rate", "<Hz>: per-channel sample rate", set_rate},
	{"wb", "<dB>: wideband gate threshold above the noise floor (live)", set_wb},
	{"ch", "<dB>: per-channel threshold above the noise floor (live)", set_ch},
	{"lookback", "<us>: samples before a trigger kept", set_lookback},
	{"hang", "<us>: hold after the power drops", set_hang},
	{"max", "<us>: longest capture / chunk length", set_max},
	{"wbgate", "on|off: wideband gate (live)", set_wbgate},
	{"chgate", "on|off: per-channel gate, off streams chunks (live)", set_chgate},
	{"rxgain", "auto|<index>: hardware AGC or a fixed gain index", set_rxgain},
	{"bw", "<MHz>: receive filter bandwidth, 0 widest, -1 the PHY's", set_bw},
};

/* set [<key> <value> ...]: settings, applied in order; without arguments the keys. */
static int cmd_set(const struct shell *sh, size_t argc, char **argv)
{
	if (argc == 1) {
		ARRAY_FOR_EACH(settings, k) {
			shell_print(sh, "  %-9s %s", settings[k].key, settings[k].help);
		}
		return 0;
	}
	if ((argc - 1U) % 2U != 0U) {
		shell_error(sh, "usage: set <key> <value> [<key> <value> ...]");
		return -EINVAL;
	}
	for (size_t a = 1; a + 1U < argc; a += 2U) {
		const struct setting *st = NULL;
		int ret;

		ARRAY_FOR_EACH(settings, k) {
			if (strcmp(argv[a], settings[k].key) == 0) {
				st = &settings[k];
			}
		}
		if (st == NULL) {
			shell_error(sh, "unknown key %s (chancap set lists them)", argv[a]);
			return -EINVAL;
		}
		ret = st->set(sh, argv[a + 1U]);
		shell_print(sh, "%s %s: %d", argv[a], argv[a + 1U], ret);
		if (ret != 0) {
			return ret;
		}
	}
	return 0;
}

SHELL_STATIC_SUBCMD_SET_CREATE(chancap_cmds,
			       SHELL_CMD(start, NULL, "tune to the grid and capture", cmd_start),
			       SHELL_CMD(stop, NULL, "stop capturing", cmd_stop),
			       SHELL_CMD(status, NULL, "settings, plan and counters", cmd_status),
			       SHELL_CMD_ARG(bench, NULL, "[pairs]: time the channelizer (stopped)",
					     cmd_bench, 1, 1),
			       SHELL_CMD_ARG(set, NULL,
					     "[<key> <value> ...]: settings (without arguments: the keys)",
					     cmd_set, 1, 16),
			       SHELL_SUBCMD_SET_END);

SHELL_CMD_REGISTER(chancap, &chancap_cmds, "channelized burst capture", NULL);
```

## src/usb_cc.c
```c
/*
 * SPDX-License-Identifier: GPL-3.0-or-later
 *
 * Vendor USB function of the capture stream (usb_cc.h): one interface, bulk IN. Transfers
 * point at the app's own blocks (net_buf_alloc_with_data), so nothing is copied here. After
 * apps/osmosdr/src/usb_sdr.c, without its OUT endpoint and control requests: the shell sets
 * the radio.
 */

#include <errno.h>
#include <string.h>

#include <zephyr/drivers/usb/udc.h>
#include <zephyr/kernel.h>
#include <zephyr/logging/log.h>
#include <zephyr/sys/atomic.h>
#include <zephyr/usb/usbd.h>

#include "usb_cc.h"

LOG_MODULE_REGISTER(usb_cc, LOG_LEVEL_INF);

/* Bulk transfers in flight at most. */
#define CC_XFERS 8

UDC_BUF_POOL_DEFINE(cc_ep_pool, CC_XFERS, 0, sizeof(struct udc_buf_info), NULL);

struct cc_desc {
	struct usb_if_descriptor if0;
	struct usb_ep_descriptor in_ep;
	struct usb_desc_header nil_desc;
};

static struct cc_desc cc_desc = {
	.if0 = {
		.bLength = sizeof(struct usb_if_descriptor),
		.bDescriptorType = USB_DESC_INTERFACE,
		.bInterfaceNumber = 0,
		.bAlternateSetting = 0,
		.bNumEndpoints = 1,
		.bInterfaceClass = USB_BCC_VENDOR,
		.bInterfaceSubClass = 0,
		.bInterfaceProtocol = 0,
		.iInterface = 0,
	},
	.in_ep = {
		.bLength = sizeof(struct usb_ep_descriptor),
		.bDescriptorType = USB_DESC_ENDPOINT,
		.bEndpointAddress = 0x81,
		.bmAttributes = USB_EP_TYPE_BULK,
		.wMaxPacketSize = sys_cpu_to_le16(64U),
		.bInterval = 0,
	},
	.nil_desc = {
		.bLength = 0,
		.bDescriptorType = 0,
	},
};

static const struct usb_desc_header *const cc_fs_desc[] = {
	(struct usb_desc_header *)&cc_desc.if0,
	(struct usb_desc_header *)&cc_desc.in_ep,
	(struct usb_desc_header *)&cc_desc.nil_desc,
};

static struct usbd_class_data *cc_c_data;
static atomic_t cc_up;

bool usb_cc_enabled(void)
{
	return atomic_get(&cc_up) != 0;
}

int usb_cc_submit_in(uint8_t *data, size_t len)
{
	struct net_buf *buf;
	struct udc_buf_info *bi;
	int err;

	if (!usb_cc_enabled()) {
		return -ENOTCONN;
	}
	buf = net_buf_alloc_with_data(&cc_ep_pool, data, len, K_NO_WAIT);
	if (buf == NULL) {
		return -ENOMEM;
	}
	bi = udc_get_buf_info(buf);
	memset(bi, 0, sizeof(*bi));
	bi->ep = cc_desc.in_ep.bEndpointAddress;
	/* A whole number of 64-byte packets: end it with a zero-length packet. */
	bi->zlp = (len % 64U) == 0U;
	err = usbd_ep_enqueue(cc_c_data, buf);
	if (err != 0) {
		net_buf_unref(buf);
	}
	return err;
}

void usb_cc_cancel(void)
{
	if (cc_c_data == NULL) {
		return;
	}
	(void)usbd_ep_dequeue(usbd_class_get_ctx(cc_c_data), cc_desc.in_ep.bEndpointAddress);
}

static int cc_request(struct usbd_class_data *const c_data, struct net_buf *buf, int err)
{
	struct udc_buf_info *bi = udc_get_buf_info(buf);
	uint8_t *data = buf->__buf;
	size_t len = buf->len;
	uint8_t ep = bi->ep;

	ARG_UNUSED(c_data);
	net_buf_unref(buf);
	if (ep == cc_desc.in_ep.bEndpointAddress) {
		usb_cc_in_done(data, len, err);
	}
	return 0;
}

static const void *cc_get_desc(struct usbd_class_data *const c_data, const enum usbd_speed speed)
{
	ARG_UNUSED(c_data);
	ARG_UNUSED(speed);
	return cc_fs_desc;
}

static void cc_enable(struct usbd_class_data *const c_data)
{
	cc_c_data = c_data;
	atomic_set(&cc_up, 1);
	LOG_INF("interface enabled (in 0x%02x)", cc_desc.in_ep.bEndpointAddress);
	usb_cc_link(true);
}

static void cc_disable(struct usbd_class_data *const c_data)
{
	ARG_UNUSED(c_data);
	atomic_set(&cc_up, 0);
	LOG_INF("interface disabled");
	usb_cc_link(false);
}

static int cc_init(struct usbd_class_data *c_data)
{
	cc_c_data = c_data;
	return 0;
}

static const struct usbd_class_api cc_api = {
	.request = cc_request,
	.get_desc = cc_get_desc,
	.enable = cc_enable,
	.disable = cc_disable,
	.init = cc_init,
};

USBD_DEFINE_CLASS(esp_sdr_cc, &cc_api, NULL, NULL);
```

## src/usb_cc.h
```c
/*
 * SPDX-License-Identifier: GPL-3.0-or-later
 *
 * The capture stream's USB function: one vendor interface with a bulk IN endpoint carrying
 * VITA 49.2 packets in blocks (whole packets per block, so a host reads block by block).
 */

#ifndef USB_CC_H_
#define USB_CC_H_

#include <stdbool.h>
#include <stddef.h>
#include <stdint.h>

/* Whether the host has configured the interface (bulk transfers possible). */
bool usb_cc_enabled(void);

/*
 * Queue @p len bytes at @p data (internal RAM, untouched until done) on bulk IN. Completion
 * calls usb_cc_in_done() from the USB stack thread, in order.
 */
int usb_cc_submit_in(uint8_t *data, size_t len);
/* Cancel everything queued (completions report -ECONNABORTED). */
void usb_cc_cancel(void);

/* Provided by the app. */
void usb_cc_in_done(uint8_t *data, size_t len, int err);
/* Interface enabled (alternate setting 0 selected) or gone. */
void usb_cc_link(bool up);

#endif /* USB_CC_H_ */
```

## src/vrt_cc.c
```c
/*
 * SPDX-License-Identifier: GPL-3.0-or-later
 *
 * Captures as VITA 49.2: one stream per channel (stream ID base + channel), a context packet
 * per stream when it first appears and once a second, then signal data packets of 16-bit
 * link-efficient items. Timestamps come from the ring pair index (TSI "other": seconds since
 * the run started, TSF real time in picoseconds). The trailer marks the capture's first packet
 * (sample loss: the stream is not contiguous), its last (user bit 8), a cut at max_capture
 * (user bit 9) and a chunk of a continuous stream (user bit 10). A context packet before each
 * capture carries the channel's noise floor as the reference level (dBFS) and the burst's
 * peak above it as gain stage 1 (dB).
 *
 * Packets go to USB in 4 KiB blocks (whole packets per block): the encoder fills the current
 * block on the callback thread and submits it when the next packet does not fit, or 50 ms
 * after the first packet in it.
 */

#include <errno.h>
#include <string.h>

#include <zephyr/kernel.h>
#include <zephyr/logging/log.h>
#include <zephyr/sys/util.h>

#include <esp_sdr/esp_sdr.h>
#include <esp_sdr/esp_sdr_chancap.h>
#include <esp_sdr/esp_sdr_ring.h>

#include <vrt/vrt_init.h>
#include <vrt/vrt_string.h>
#include <vrt/vrt_types.h>
#include <vrt/vrt_util.h>
#include <vrt/vrt_words.h>
#include <vrt/vrt_write.h>

#include "app.h"
#include "usb_cc.h"

LOG_MODULE_DECLARE(chancap, LOG_LEVEL_INF);

#define SAMPLES_PER_PACKET CONFIG_APP_SAMPLES_PER_PACKET
/* Header, stream ID, TSI, two TSF words, trailer. */
#define DATA_OVERHEAD      6
#define PACKET_WORDS       (SAMPLES_PER_PACKET + DATA_OVERHEAD)
#define BLOCK_BYTES        4096U
#define CONTEXT_PERIOD_MS  1000
#define FLUSH_MS           50
#define CHANNELS           ESP_SDR_CHANCAP_CHANNELS_MAX
#define PS_PER_PAIR        62500U /* 1 / 16 MHz */

BUILD_ASSERT(PACKET_WORDS * 4U <= BLOCK_BYTES, "a packet must fit a block");

struct block {
	uint8_t data[BLOCK_BYTES];
	size_t len;
};

/* USB DMA needs internal RAM. */
ESP_SDR_HIGH_BUF_DEFINE(struct block, blocks, [CONFIG_APP_USB_BLOCKS], 16);
K_MSGQ_DEFINE(free_q, sizeof(struct block *), CONFIG_APP_USB_BLOCKS, 4);
static struct block *cur;
static K_MUTEX_DEFINE(cur_lock);
static struct k_work_delayable flush_work;

static struct {
	uint8_t data_count, context_count;
	int64_t context_ms;
	bool seen;
} stream[CHANNELS];
static struct vrt_cc_stats stats;
/* Above the capture bank: the DRAM image below the ring banks has no room. */
static struct vrt_packet pkt ESP_SDR_HIGH_RAM;
static uint32_t body[SAMPLES_PER_PACKET] ESP_SDR_HIGH_RAM;

static void pair_time(uint64_t pair, struct vrt_fields *f)
{
	f->integer_seconds_timestamp = (uint32_t)(pair / ESP_SDR_RING_RATE_HZ);
	f->fractional_seconds_timestamp = (pair % ESP_SDR_RING_RATE_HZ) * PS_PER_PAIR;
}

static void init_header(struct vrt_packet *p, enum vrt_packet_type type, unsigned int ch,
			uint8_t count)
{
	vrt_init_packet(p);
	p->header.packet_type = type;
	p->header.packet_count = count & 0xfU;
	p->header.tsi = VRT_TSI_OTHER;
	p->header.tsf = VRT_TSF_REAL_TIME;
	p->fields.stream_id = CONFIG_APP_STREAM_ID_BASE + ch;
}

/* ---- blocks ---- */

static void submit_cur_locked(void)
{
	struct block *b = cur;

	if (b == NULL || b->len == 0U) {
		return;
	}
	cur = NULL;
	if (usb_cc_submit_in(b->data, b->len) != 0) {
		stats.errors++;
		b->len = 0;
		(void)k_msgq_put(&free_q, &b, K_NO_WAIT);
		return;
	}
	stats.blocks++;
	stats.bytes += b->len;
}

static void flush_fn(struct k_work *work)
{
	ARG_UNUSED(work);
	k_mutex_lock(&cur_lock, K_FOREVER);
	submit_cur_locked();
	k_mutex_unlock(&cur_lock);
}

/* Room for @p bytes in the current block, submitting a full one; NULL if no block is free. */
static uint8_t *block_room(size_t bytes)
{
	if (cur != NULL && cur->len + bytes > BLOCK_BYTES) {
		submit_cur_locked();
	}
	if (cur == NULL) {
		if (k_msgq_get(&free_q, &cur, K_NO_WAIT) != 0) {
			return NULL;
		}
		cur->len = 0;
		k_work_schedule(&flush_work, K_MSEC(FLUSH_MS));
	}
	return cur->data + cur->len;
}

void usb_cc_in_done(uint8_t *data, size_t len, int err)
{
	struct block *b = CONTAINER_OF(data, struct block, data[0]);

	ARG_UNUSED(len);
	if (err != 0 && err != -ECONNABORTED) {
		stats.errors++;
	}
	b->len = 0;
	(void)k_msgq_put(&free_q, &b, K_NO_WAIT);
}

void usb_cc_link(bool up)
{
	if (!up) {
		usb_cc_cancel();
	}
	for (unsigned int c = 0; c < CHANNELS; c++) {
		stream[c].seen = false;
	}
}

/* Write the packet into the block; false if no block was free. */
static bool emit(struct vrt_packet *p)
{
	int32_t words = vrt_words_packet(p);
	uint8_t *at;
	int32_t rv;

	if (words < 0) {
		stats.errors++;
		return true;
	}
	p->header.packet_size = (uint16_t)words;
	at = block_room((size_t)words * 4U);
	if (at == NULL) {
		return false;
	}
	rv = vrt_write_packet(p, at, words, true);
	if (rv < 0) {
		LOG_ERR("vrt write: %s", vrt_string_error(rv));
		stats.errors++;
		return true;
	}
	vrt_to_big_endian((uint32_t *)at, rv);
	cur->len += (size_t)rv * 4U;
	return true;
}

static bool send_context(const struct esp_sdr_chancap *cap, bool changed)
{
	struct esp_sdr_chancap_cfg *cfg = &cc_settings()->cfg;
	unsigned int ch = cap->channel;
	struct vrt_data_packet_payload_format *fmt = &pkt.if_context.data_packet_payload_format;

	init_header(&pkt, VRT_PT_IF_CONTEXT, ch, stream[ch].context_count++);
	pkt.header.nd0 = true;
	pkt.if_context.has.v49_spec_compliance = true;
	pkt.if_context.v49_spec_compliance = VRT_V49_2;
	pair_time(cap->index, &pkt.fields);
	pkt.if_context.context_field_change_indicator = changed;
	pkt.if_context.has.rf_reference_frequency = true;
	pkt.if_context.rf_reference_frequency =
		(double)cfg->first_freq_hz + (double)ch * (double)cfg->spacing_hz;
	pkt.if_context.has.sample_rate = true;
	pkt.if_context.sample_rate = (double)cap->sample_rate;
	pkt.if_context.has.bandwidth = true;
	pkt.if_context.bandwidth = (double)cap->sample_rate;
	pkt.if_context.has.reference_level = true;
	pkt.if_context.reference_level = (float)cap->noise_db;
	pkt.if_context.has.gain = true;
	pkt.if_context.gain.stage1 = (float)(cap->peak_db - cap->noise_db);
	pkt.if_context.gain.stage2 = 0.0f;
	pkt.if_context.has.data_packet_payload_format = true;
	fmt->packing_method = VRT_PM_LINK_EFFICIENT;
	fmt->real_or_complex = VRT_ROC_COMPLEX_CARTESIAN;
	fmt->data_item_format = VRT_DIF_SIGNED_FIXED_POINT;
	fmt->item_packing_field_size = 15;
	fmt->data_item_size = 15;
	if (!emit(&pkt)) {
		return false;
	}
	stats.context++;
	stream[ch].context_ms = k_uptime_get();
	stream[ch].seen = true;
	return true;
}

void vrt_cc_capture(void *user, const struct esp_sdr_chancap *cap)
{
	unsigned int ch = cap->channel;
	uint64_t pairs_per_sample = ESP_SDR_RING_RATE_HZ / cap->sample_rate;
	bool ok;

	ARG_UNUSED(user);
	if (ch >= CHANNELS || !usb_cc_enabled()) {
		esp_sdr_chancap_release(cap);
		return;
	}
	k_mutex_lock(&cur_lock, K_FOREVER);
	stats.captures++;
	ok = send_context(cap, !stream[ch].seen ||
				     k_uptime_get() - stream[ch].context_ms >= CONTEXT_PERIOD_MS);
	for (size_t off = 0; ok && off < cap->n; off += SAMPLES_PER_PACKET) {
		size_t n = MIN((size_t)SAMPLES_PER_PACKET, cap->n - off);
		bool last = off + n >= cap->n, clipped = false;

		for (size_t j = 0; j < n; j++) {
			int16_t i = cap->iq[2U * (off + j)], q = cap->iq[2U * (off + j) + 1U];

			clipped |= i == INT16_MAX || i == INT16_MIN || q == INT16_MAX ||
				   q == INT16_MIN;
			/* Link efficient 16 bit: I in the upper half word. */
			body[j] = ((uint32_t)(uint16_t)i << 16) | (uint16_t)q;
		}
		init_header(&pkt, VRT_PT_IF_DATA_WITH_STREAM_ID, ch, stream[ch].data_count++);
		pair_time(cap->index + off * pairs_per_sample, &pkt.fields);
		pkt.header.has.trailer = true;
		pkt.body = body;
		pkt.words_body = (int32_t)n;
		pkt.trailer.has.valid_data = true;
		pkt.trailer.valid_data = true;
		pkt.trailer.has.over_range = true;
		pkt.trailer.over_range = clipped;
		pkt.trailer.has.detected_signal = true;
		pkt.trailer.detected_signal = !cap->chunk;
		pkt.trailer.has.sample_loss = true;
		pkt.trailer.sample_loss = off == 0U;
		pkt.trailer.has.user_defined8 = true;
		pkt.trailer.user_defined8 = last;
		pkt.trailer.has.user_defined9 = true;
		pkt.trailer.user_defined9 = cap->truncated;
		pkt.trailer.has.user_defined10 = true;
		pkt.trailer.user_defined10 = cap->chunk;
		ok = emit(&pkt);
		if (ok) {
			stats.packets++;
		}
	}
	if (!ok) {
		stats.dropped++;
	}
	/*
	 * The block goes out when full or FLUSH_MS after its first packet: short captures share
	 * blocks, since USB full speed moves a limited number of transfers per second.
	 */
	k_mutex_unlock(&cur_lock);
	esp_sdr_chancap_release(cap);
}

int vrt_cc_init(void)
{
	k_work_init_delayable(&flush_work, flush_fn);
	for (unsigned int k = 0; k < CONFIG_APP_USB_BLOCKS; k++) {
		struct block *b = &blocks[k];

		b->len = 0;
		(void)k_msgq_put(&free_q, &b, K_NO_WAIT);
	}
	return 0;
}

void vrt_cc_get_stats(struct vrt_cc_stats *st)
{
	*st = stats;
	st->blocks_free = k_msgq_num_used_get(&free_q);
}
```
