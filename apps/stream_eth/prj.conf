## CMakeLists.txt
```
# SPDX-License-Identifier: GPL-3.0-or-later

cmake_minimum_required(VERSION 3.20.0)

find_package(Zephyr REQUIRED HINTS $ENV{ZEPHYR_BASE})
project(esp_sdr_stream_eth)

include(${CMAKE_CURRENT_LIST_DIR}/../../lib/esp_sdr/place.cmake)

target_sources(app PRIVATE
  src/main.c
  src/radio.c
  src/txpath.c
  src/ctl.c
  src/shell.c
  src/vrt_pkt.c
  src/vrt_cells.c
  src/ctlproto.c
  src/netframe.c)
target_compile_options(app PRIVATE -O2)
```

## Kconfig
```
# SPDX-License-Identifier: GPL-3.0-or-later

mainmenu "ESP-SDR stream over Ethernet"

config APP_VRT_STREAM_ID
	hex "VITA 49 stream identifier of the receive stream"
	default 0x5d5d0001

config APP_VRT_PORT
	int "UDP port for commands, and the source port of every packet the board sends"
	default 4992

config APP_VRT_RATE_HZ
	int "Sample rate at boot, S/s (160 MHz over an even number)"
	default 20000000

config APP_VRT_MTU_CAP
	int "Largest IP packet the stream makes, in bytes"
	range 576 1500
	default 1492
	help
	  The packets fill the interface's MTU or this, whichever is smaller. 1492 is what the
	  router of the lab LAN announces; "stream mtu 1500" raises it on a direct cable.

config APP_VRT_CELLS
	int "Packets of staging between the ring and the MAC"
	range 8 256
	default 32
	help
	  One cell is 1472 bytes of internal RAM, of which the image has some 250 KiB below the
	  diag16 ring for everything. The consumer drops whole nodes when the MAC is this far
	  behind: 32 cells are 0.6 ms at 40 MS/s.

config APP_VRT_BATCH
	int "Frames the sender hands to the MAC at once"
	range 1 32
	default 8

config APP_VRT_CLIP_STRIDE
	int "Over-range check: one 32-bit word in this many"
	range 1 64
	default 4
	help
	  1 looks at every sample byte (about 3 cycles a byte), 4 at a quarter of them. A clipped
	  run shorter than 8 samples can slip by.

config APP_VRT_RAMFUNC
	bool "Run the sender from internal RAM"
	depends on SOC_FAMILY_ESPRESSIF_ESP32

config APP_VRT_SENDER_CPU
	int "CPU of the sender thread with SMP (-1: not pinned)"
	default 1
	range -1 1

config APP_VRT_RX_CPU
	int "CPU of the ring consumer thread with SMP (-1: not pinned)"
	default 0
	range -1 1

config APP_VRT_SILENT_S
	int "Seconds without a renewal after which the subscriber is dropped"
	default 5

config APP_VRT_V6_ZERO_CSUM
	bool "Zero UDP checksum over IPv6 for a host that asks for it"
	help
	  A subscriber that sets bit 0 of the byte after its cookie (and UDP_NO_CHECK6_RX on its
	  socket) gets IPv6 packets with the UDP checksum 0 (RFC 6935/6936, on-link only), which
	  saves the checksum's cycles. Risk: nothing then checks the payload end to end; the
	  Ethernet FCS covers each hop. Off by default.

config APP_VRT_ALLOW_OFFLINK
	bool "Take subscriptions from hosts beyond the connected prefixes"
	help
	  By default only unicast hosts on a connected prefix or link-local may subscribe or ask.
	  There is no authentication: do not expose the port.

source "Kconfig.zephyr"
```

## sample.yaml
```
sample:
  name: ESP-SDR stream over Ethernet
  description: >-
    Gapless I/Q from the ESP32-S31's diag16 ring as VITA 49.2 signal data over UDP on the
    CoreBoard's gigabit Ethernet, up to 40 MS/s, unicast to whoever asks on port 4992
common:
  tags: esp-sdr
  platform_allow:
    - esp32s31_function_coreboard/esp32s31/hpcore
  integration_platforms:
    - esp32s31_function_coreboard/esp32s31/hpcore
tests:
  sample.esp_sdr.stream_eth:
    build_only: true
  sample.esp_sdr.stream_eth.onecore:
    build_only: true
    extra_args: EXTRA_CONF_FILE=onecore.conf
  sample.esp_sdr.stream_eth.product:
    build_only: true
    extra_args: EXTRA_CONF_FILE="ramfunc.conf;coalesce.conf;product.conf"
```

## prj.conf
```kconfig
# The radio: no Wi-Fi driver, the ring through the diagnostic bus.
CONFIG_ESP_SDR=y
CONFIG_ESP_SDR_PHY_ONLY=y
CONFIG_ESP_SDR_DIAG16=y
CONFIG_ESP_SDR_RX_DECIM=n
CONFIG_LIBVRT=y

CONFIG_LOG=y
CONFIG_LOG_MODE_DEFERRED=y
CONFIG_LOG_BUFFER_SIZE=2048
# main only starts the threads (the radio's own thread has the 4096 the radio start needs)
CONFIG_MAIN_STACK_SIZE=2048
CONFIG_PRINTK=y
CONFIG_SHELL=y
CONFIG_SHELL_STACK_SIZE=4096
CONFIG_KERNEL_SHELL=y
CONFIG_THREAD_NAME=y

# Ethernet: YT8531 on RGMII, the driver is the fork's DWC MAC. Gigabit, 125 MHz reference clock.
CONFIG_NETWORKING=y
CONFIG_NET_L2_ETHERNET=y
CONFIG_ETH_DRIVER=y
CONFIG_ETHERNET_LOG_LEVEL_WRN=y
CONFIG_PHY_LOG_LEVEL_WRN=y
CONFIG_MDIO_LOG_LEVEL_WRN=y
CONFIG_MDIO=y
CONFIG_ETH_DWMAC_TX_FAST=y
# the DMA needs cache line sized and aligned buffers (64 byte lines)
CONFIG_NET_BUF_DATA_SIZE=1536
CONFIG_NET_BUF_ALIGNMENT=64
CONFIG_NET_PKT_RX_COUNT=8
CONFIG_NET_PKT_TX_COUNT=8
CONFIG_NET_BUF_RX_COUNT=12
CONFIG_NET_BUF_TX_COUNT=8
CONFIG_DWMAC_NB_TX_DESCS=64
CONFIG_DWMAC_NB_RX_DESCS=8

# Addresses: DHCPv4, IPv6 link-local and autoconfiguration. The control path of the stack is
# only that; the data packets do not go through it.
CONFIG_NET_IPV4=y
CONFIG_NET_IPV6=y
CONFIG_NET_UDP=y
CONFIG_NET_DHCPV4=y
CONFIG_NET_DHCPV4_INITIAL_DELAY_MAX=2
CONFIG_NET_IPV6_ND=y
# the ULA prefix as well as the link-local and the GUA: the default is 2
CONFIG_NET_IF_UNICAST_IPV6_ADDR_COUNT=5

# The ring consumer (main, priority 0) and the sender (1) must not wait for a cooperative thread: the
# system work queue (PHY link monitor, every 500 ms) and the network threads run preemptible below them.
CONFIG_SYSTEM_WORKQUEUE_PRIORITY=7
CONFIG_NET_TC_THREAD_PREEMPTIVE=y
# the network threads below the sender (1) and the ring consumer (0)
CONFIG_NET_TC_THREAD_PRIO_CUSTOM=y
CONFIG_NET_TC_TX_THREAD_BASE_PRIO=8
CONFIG_NET_TC_RX_THREAD_BASE_PRIO=8
CONFIG_NET_IF_IPV6_PREFIX_COUNT=3
CONFIG_NET_CONFIG_SETTINGS=y
CONFIG_NET_CONFIG_NEED_IPV4=y
CONFIG_NET_CONFIG_NEED_IPV6=y
CONFIG_NET_CONFIG_MY_IPV4_ADDR=""
CONFIG_NET_CONFIG_PEER_IPV4_ADDR=""
CONFIG_NET_CONFIG_INIT_TIMEOUT=10
CONFIG_NET_SHELL=y
# net stats: the MMC counters with CONFIG_NET_STATISTICS_ETHERNET_VENDOR
CONFIG_NET_STATISTICS=y
CONFIG_NET_STATISTICS_ETHERNET=y
CONFIG_NET_STATISTICS_ETHERNET_VENDOR=y

# Stacks (the 800 byte default of the event thread overflowed with immediate logging)
CONFIG_NET_MGMT_EVENT_STACK_SIZE=3072
CONFIG_NET_RX_STACK_SIZE=4096
CONFIG_NET_TX_STACK_SIZE=4096
CONFIG_HEAP_MEM_POOL_SIZE=8192

# SMP is on below (onecore.conf turns it off).

# SMP, the ring consumer on CPU 0 and the sender on CPU 1: 20 times fewer losses than one core at
# 40 MS/s IPv4 on the board (4 against 85 to 92 packets in 30 s). onecore.conf is the old build.
CONFIG_SMP=y
CONFIG_MP_MAX_NUM_CPUS=2
CONFIG_SCHED_CPU_MASK=y

# Several threads use float (gain and frequency in commands and contexts) and preempt each other.
CONFIG_FPU_SHARING=y
```

## coalesce.conf
```kconfig
# One transmit interrupt in 8 frames (reaped by the next one or the 1 ms timer).
CONFIG_ETH_DWMAC_TX_IRQ_EVERY=8
```

## onecore.conf
```kconfig
# One core: the ring consumer and the sender share CPU 0.
CONFIG_SMP=n
CONFIG_MP_MAX_NUM_CPUS=1
CONFIG_SCHED_CPU_MASK=n
```

## product.conf
```kconfig
# What the image needs and no more: no statistics, no net shell.
CONFIG_NET_STATISTICS=n
CONFIG_NET_STATISTICS_ETHERNET=n
CONFIG_NET_STATISTICS_ETHERNET_VENDOR=n
CONFIG_NET_SHELL=n
CONFIG_NET_TC_TX_COUNT=0
CONFIG_ETH_DWMAC_TX_IRQ_EVERY=8
CONFIG_APP_VRT_RAMFUNC=y
CONFIG_ETH_DWMAC_TX_RAMFUNC=y
```

## ramfunc.conf
```kconfig
# The sender and the MAC's transmit path and interrupt run from internal RAM.
CONFIG_APP_VRT_RAMFUNC=y
CONFIG_ETH_DWMAC_TX_RAMFUNC=y
```

## smp.conf
```kconfig
# SMP is the default now (prj.conf); this file is kept for the old command lines.
CONFIG_SMP=y
```

## src/main.c
```c
/*
 * SPDX-License-Identifier: GPL-3.0-or-later
 *
 * Gapless I/Q from the diag16 ring as VITA 49.2 over UDP on the CoreBoard's Ethernet. See
 * ../README.rst.
 */

#include <zephyr/app_version.h>
#include <zephyr/kernel.h>
#include <zephyr/logging/log.h>
#include <zephyr/net/net_if.h>
#include <zephyr/net/net_mgmt.h>

#include "stream_eth.h"

LOG_MODULE_REGISTER(stream_eth, LOG_LEVEL_INF);

void shell_spin_start(void);
void shell_app_ready(void);

/* The ring consumer: 4096 bytes as the main thread had for it (esp_sdr_init() and the ring), the
 * control thread 4096 too. Check both with "kernel stacks" on the board.
 */
static K_THREAD_STACK_DEFINE(radio_stack, 4096);
static struct k_thread radio_thread;
static K_THREAD_STACK_DEFINE(ctl_stack, 4096);
static struct k_thread ctl_thread;

static void ctl_entry(void *a, void *b, void *c)
{
	ARG_UNUSED(a);
	ARG_UNUSED(b);
	ARG_UNUSED(c);
	ctl_run();
}

static void radio_entry(void *a, void *b, void *c)
{
	ARG_UNUSED(a);
	ARG_UNUSED(b);
	ARG_UNUSED(c);
	if (radio_init() != 0) {
		return;
	}
	k_thread_create(&ctl_thread, ctl_stack, K_THREAD_STACK_SIZEOF(ctl_stack), ctl_entry, NULL, NULL,
			NULL, K_PRIO_PREEMPT(6), 0, K_NO_WAIT);
	k_thread_name_set(&ctl_thread, "vrt_ctl");
	/* the shell's commands wait for this: the radio and the control thread are there */
	shell_app_ready();
	radio_run();
}

static struct net_mgmt_event_callback addr_cb;

static void addr_event(struct net_mgmt_event_callback *cb, uint64_t event, struct net_if *iface)
{
	ARG_UNUSED(cb);
	if (event == NET_EVENT_IPV4_ADDR_ADD) {
		char s[NET_IPV4_ADDR_LEN];

		for (int k = 0; k < NET_IF_MAX_IPV4_ADDR; k++) {
			struct net_if_addr *a = &iface->config.ip.ipv4->unicast[k].ipv4;

			if (a->is_used && net_addr_ntop(NET_AF_INET, &a->address.in_addr, s, sizeof(s))) {
				LOG_INF("IPv4 address %s", s);
			}
		}
	} else if (event == NET_EVENT_IPV6_ADDR_ADD) {
		char s[NET_IPV6_ADDR_LEN];

		for (int k = 0; k < NET_IF_MAX_IPV6_ADDR; k++) {
			struct net_if_addr *a = &iface->config.ip.ipv6->unicast[k];

			if (a->is_used && net_addr_ntop(NET_AF_INET6, &a->address.in6_addr, s, sizeof(s))) {
				LOG_INF("IPv6 address %s", s);
			}
		}
	}
}

int main(void)
{
	struct net_if *iface = net_if_get_first_by_type(&NET_L2_GET_NAME(ETHERNET));

	LOG_INF("stream_eth %s", APP_VERSION_STRING);
	if (iface == NULL) {
		LOG_ERR("no Ethernet interface");
		return 0;
	}
	net_mgmt_init_event_callback(&addr_cb, addr_event,
				     NET_EVENT_IPV4_ADDR_ADD | NET_EVENT_IPV6_ADDR_ADD);
	net_mgmt_add_event_callback(&addr_cb);
	shell_spin_start();
	if (txpath_init(iface) != 0 || ctl_init(iface) != 0) {
		return 0;
	}
	/*
	 * The radio gets a thread of its own, created stopped, pinned, then started: a running thread
	 * (this one) cannot be pinned (k_thread_cpu_pin() refuses with -EINVAL), and an unpinned ring
	 * consumer may take the sender's CPU. It also takes the big stack the radio's start needs, so
	 * that this one can be small. The control thread starts once the radio is up.
	 */
	k_thread_create(&radio_thread, radio_stack, K_THREAD_STACK_SIZEOF(radio_stack), radio_entry,
			NULL, NULL, NULL, K_PRIO_PREEMPT(0), 0, K_FOREVER);
	k_thread_name_set(&radio_thread, "vrt_radio");
#if defined(CONFIG_SMP) && defined(CONFIG_SCHED_CPU_MASK)
	if (CONFIG_APP_VRT_RX_CPU >= 0 && arch_num_cpus() > 1) {
		int ret = k_thread_cpu_pin(&radio_thread, CONFIG_APP_VRT_RX_CPU);

		if (ret != 0) {
			LOG_ERR("pinning the ring consumer to CPU %d: %d", CONFIG_APP_VRT_RX_CPU, ret);
		}
	}
#endif
	k_thread_start(&radio_thread);
	return 0;
}
```

## src/ctl.c
```c
/*
 * SPDX-License-Identifier: GPL-3.0-or-later
 *
 * Commands and the subscriber, see ctlproto.h for the subscription messages ("VRTS", "VRTC"
 * and cookie, "VRTK", "VRTB", "VRTT", "VRTX") and README.rst. Settings come as VITA 49.2 command
 * packets to the stream ID (frequency in Hz, gain stage 1 as the PHY's gain index or -1 for
 * automatic, sample rate, 8 bit payload format), acknowledged as in apps/stream, and only from the
 * live subscriber. Any other host may ask for the state, ten answers a second in all.
 *
 * NO AUTHENTICATION: the cookie shows that a host can receive at its address, nothing more. For a
 * LAN; do not expose the port. Datagrams are taken from unicast hosts on a connected prefix or
 * link-local, to a unicast address of the interface (CONFIG_APP_VRT_ALLOW_OFFLINK lifts the first).
 *
 * The datagrams come through net_context rather than sockets: the Ethernet header of each says
 * where the host's MAC is, and nothing then has to be resolved.
 */

#include <errno.h>
#include <math.h>
#include <string.h>

#include <zephyr/kernel.h>
#include <zephyr/logging/log.h>
#include <zephyr/net/net_context.h>
#include <zephyr/net/net_pkt.h>

#include <vrt/vrt_init.h>
#include <vrt/vrt_read.h>
#include <vrt/vrt_types.h>
#include <vrt/vrt_util.h>
#include <vrt/vrt_words.h>
#include <vrt/vrt_write.h>

#include <zephyr/random/random.h>

#include "ctlproto.h"
#include "stream_eth.h"

LOG_MODULE_DECLARE(stream_eth, LOG_LEVEL_INF);

#define MSG_MAX   256
#define ACK_WORDS 48

struct ctlmsg {
	struct peer p;
	uint16_t len;
	uint8_t data[MSG_MAX];
};
K_MSGQ_DEFINE(ctl_q, sizeof(struct ctlmsg), 8, 4);

static uint32_t rx_words[MSG_MAX / 4] __aligned(4);
static uint32_t ack_buf[ACK_WORDS];
static struct vrt_packet pkt, ack;
static struct vrt_command cmd, ack_cmd;
static struct {
	uint32_t commands, subscribes, bad, errors, dropped, rejected;
} stats;
static struct ctl_proto proto;
static bool ack_owed;
static struct peer ack_owed_peer;
static K_MUTEX_DEFINE(proto_lock);
static struct net_if *ctl_iface;

/* A datagram worth an answer: a unicast host on the link, to an address of ours. */
static bool addr_local_ok(const struct peer *p)
{
	struct net_if *i = NULL;

	if (p->v6) {
		return net_if_ipv6_addr_lookup((struct net_in6_addr *)p->local, &i) != NULL && i == ctl_iface;
	}
	return net_if_ipv4_addr_lookup((struct net_in_addr *)p->local, &i) != NULL && i == ctl_iface;
}

static bool peer_valid(const struct peer *p)
{
	static const uint8_t zero[16];
	bool all_zero_mac = true;

	for (int k = 0; k < 6; k++) {
		all_zero_mac &= p->mac[k] == 0U;
	}
	if ((p->mac[0] & 1U) != 0U || all_zero_mac || p->port == 0U) {
		return false;
	}
	if (p->v6) {
		struct net_in6_addr *a = (struct net_in6_addr *)p->addr;

		if (net_ipv6_is_addr_mcast(a) || net_ipv6_is_addr_unspecified(a)) {
			return false;
		}
		if (!IS_ENABLED(CONFIG_APP_VRT_ALLOW_OFFLINK) && !net_ipv6_is_ll_addr(a) &&
		    net_if_ipv6_prefix_lookup(ctl_iface, a, 64) == NULL) {
			return false;
		}
	} else {
		struct net_in_addr *a = (struct net_in_addr *)p->addr;

		if (net_ipv4_is_addr_mcast(a) || net_ipv4_is_addr_bcast(ctl_iface, a) ||
		    net_ipv4_is_addr_unspecified(a)) {
			return false;
		}
		if (!IS_ENABLED(CONFIG_APP_VRT_ALLOW_OFFLINK) && !net_ipv4_is_ll_addr(a) &&
		    !net_if_ipv4_addr_mask_cmp(ctl_iface, a)) {
			return false;
		}
	}
	(void)zero;
	return addr_local_ok(p);
}

/* Called by the RX thread: copy out what is needed, give the packet back. */
static void recv_cb(struct net_context *ctx, struct net_pkt *p, union net_ip_header *ip,
		    union net_proto_header *proto_hdr, int status, void *user)
{
	struct ctlmsg m;
	struct net_linkaddr *ll;
	size_t len;

	ARG_UNUSED(ctx);
	ARG_UNUSED(user);
	if (p == NULL) {
		return;
	}
	if (status != 0) {
		goto out;
	}
	memset(&m.p, 0, sizeof(m.p));
	m.p.v6 = net_pkt_family(p) == NET_AF_INET6;
	if (m.p.v6) {
		memcpy(m.p.addr, ip->ipv6->src, 16);
		memcpy(m.p.local, ip->ipv6->dst, 16);
	} else {
		memcpy(m.p.addr, ip->ipv4->src, 4);
		memcpy(m.p.local, ip->ipv4->dst, 4);
	}
	m.p.port = net_ntohs(proto_hdr->udp->src_port);
	ll = net_pkt_lladdr_src(p);
	if (ll->len != 6U) {
		goto out;
	}
	memcpy(m.p.mac, ll->addr, 6);
	if (!peer_valid(&m.p)) {
		stats.rejected++;
		goto out;
	}
	/* what is not worth queueing is dropped here: a source over its budget, a runt */
	{
		bool ok;

		k_mutex_lock(&proto_lock, K_FOREVER);
		ok = ctl_proto_admit(&proto, &m.p, k_uptime_get());
		k_mutex_unlock(&proto_lock);
		if (!ok || net_pkt_remaining_data(p) < 4U) {
			stats.dropped++;
			goto out;
		}
	}
	len = net_pkt_remaining_data(p);
	if (len == 0U || len > MSG_MAX || net_pkt_read(p, m.data, len) != 0) {
		stats.dropped++;
		goto out;
	}
	m.len = (uint16_t)len;
	/* a multicast or broadcast destination is nobody's address to answer from */
	if (k_msgq_put(&ctl_q, &m, K_NO_WAIT) != 0) {
		stats.dropped++;
	}
out:
	net_pkt_unref(p);
}

static int open_ctx(net_sa_family_t family)
{
	struct net_context *ctx;
	int ret = net_context_get(family, NET_SOCK_DGRAM, NET_IPPROTO_UDP, &ctx);

	if (ret != 0) {
		return ret;
	}
	if (family == NET_AF_INET6) {
		struct net_sockaddr_in6 a = {.sin6_family = NET_AF_INET6,
					     .sin6_port = net_htons(CONFIG_APP_VRT_PORT)};

		ret = net_context_bind(ctx, (struct net_sockaddr *)&a, sizeof(a));
	} else {
		struct net_sockaddr_in a = {.sin_family = NET_AF_INET,
					    .sin_port = net_htons(CONFIG_APP_VRT_PORT)};

		ret = net_context_bind(ctx, (struct net_sockaddr *)&a, sizeof(a));
	}
	if (ret == 0) {
		ret = net_context_recv(ctx, recv_cb, K_NO_WAIT, NULL);
	}
	return ret;
}

int ctl_init(struct net_if *iface)
{
	uint8_t key[16];
	int ret;

	ctl_iface = iface;
	sys_rand_get(key, sizeof(key));
	ctl_proto_init(&proto, key, (uint32_t)net_if_get_by_iface(iface),
		       (int64_t)CONFIG_APP_VRT_SILENT_S * 1000);
	ret = open_ctx(NET_AF_INET);
	if (ret != 0) {
		LOG_ERR("IPv4 control port: %d", ret);
	}
	ret = open_ctx(NET_AF_INET6);
	if (ret != 0) {
		LOG_ERR("IPv6 control port: %d", ret);
	}
	LOG_INF("VITA 49.2 commands on UDP port %d, stream ID 0x%08x", CONFIG_APP_VRT_PORT,
		CONFIG_APP_VRT_STREAM_ID);
	return 0;
}

static void log_peer(const char *what, const struct peer *p)
{
	char s[NET_INET6_ADDRSTRLEN];

	(void)net_addr_ntop(p->v6 ? NET_AF_INET6 : NET_AF_INET, p->addr, s, sizeof(s));
	LOG_INF("%s %s port %u", what, s, p->port);
}

/* The protocol decided: apply it to the stream. */
static void apply_event(const struct ctl_out *o, const struct peer *p)
{
	struct peer sp;

	switch (o->evt) {
	case CTL_EVT_SUBSCRIBED:
	case CTL_EVT_TAKEOVER:
		stats.subscribes++;
		sp = *p;
		sp.nocsum = IS_ENABLED(CONFIG_APP_VRT_V6_ZERO_CSUM) && p->v6 && o->nocsum;
		if (txpath_subscribe(&sp)) {
			log_peer(o->evt == CTL_EVT_TAKEOVER ? "subscriber replaced by" : "subscriber", p);
		}
		radio_enable(true);
		/* the packets fill the MTU of this kind of address: a different size restarts the ring */
		if (cells.pl != 0U && (txpath_payload_bytes() != cells.pl ||
				       cells.sum_on != (txpath_v6() && !txpath_zero_csum()))) {
			radio_replan();
		}
		break;
	case CTL_EVT_RENEWED:
		/* the cookie covers the MAC and the addresses, so only the flag can differ */
		sp = *p;
		sp.nocsum = IS_ENABLED(CONFIG_APP_VRT_V6_ZERO_CSUM) && p->v6 && o->nocsum;
		(void)txpath_subscribe(&sp);
		break;
	case CTL_EVT_STOPPED:
		log_peer("stop from", p);
		txpath_unsubscribe();
		radio_enable(false);
		break;
	default:
		break;
	}
}

/* The shell's stop: the stream ends and nobody may subscribe until ctl_unblock(). */
void ctl_block(void)
{
	k_mutex_lock(&proto_lock, K_FOREVER);
	proto.blocked = true;
	proto.live = false;
	txpath_unsubscribe();
	radio_enable(false);
	k_mutex_unlock(&proto_lock);
}

void ctl_unblock(void)
{
	k_mutex_lock(&proto_lock, K_FOREVER);
	proto.blocked = false;
	k_mutex_unlock(&proto_lock);
}

void ctl_resume(uint32_t gen)
{
	k_mutex_lock(&proto_lock, K_FOREVER);
	if (proto.live && !proto.blocked && txpath_sub_gen() == gen) {
		radio_enable(true);
	}
	k_mutex_unlock(&proto_lock);
}

bool ctl_blocked(void)
{
	return proto.blocked;
}

int ctl_build_context(uint32_t *buf, size_t words, uint32_t rate, uint64_t freq_hz, int gain,
		      uint8_t epoch, uint32_t sec, uint64_t ps, bool changed, uint8_t count)
{
	struct vrt_packet p;
	struct vrt_data_packet_payload_format *fmt = &p.if_context.data_packet_payload_format;
	int32_t w;

	vrt_init_packet(&p);
	p.header.packet_type = VRT_PT_IF_CONTEXT;
	p.header.packet_count = count & 0xfU;
	p.fields.stream_id = CONFIG_APP_VRT_STREAM_ID;
	p.header.tsi = VRT_TSI_OTHER;
	p.header.tsf = VRT_TSF_REAL_TIME;
	p.fields.integer_seconds_timestamp = sec;
	p.fields.fractional_seconds_timestamp = ps;
	/* CIF1 is a 49.2 feature: declare compliance and mark the packet not 49.0. */
	p.header.nd0 = true;
	p.if_context.has.v49_spec_compliance = true;
	p.if_context.v49_spec_compliance = VRT_V49_2;
	p.if_context.context_field_change_indicator = changed;
	p.if_context.has.rf_reference_frequency = true;
	p.if_context.rf_reference_frequency = (double)freq_hz;
	p.if_context.has.sample_rate = true;
	p.if_context.sample_rate = (double)rate;
	/* complex sampling: the band is one sample rate wide */
	p.if_context.has.bandwidth = true;
	p.if_context.bandwidth = (double)rate;
	p.if_context.has.gain = true;
	p.if_context.gain.stage1 = (float)gain;
	/* CIF0 bit 16: the settings epoch of the run whose data follows, in user bits 7..0 */
	p.if_context.has.state_and_event_indicators = true;
	p.if_context.state_and_event_indicators.user_defined = epoch;
	p.if_context.has.data_packet_payload_format = true;
	fmt->packing_method = VRT_PM_LINK_EFFICIENT;
	fmt->real_or_complex = VRT_ROC_COMPLEX_CARTESIAN;
	fmt->data_item_format = VRT_DIF_SIGNED_FIXED_POINT;
	fmt->item_packing_field_size = 7;
	fmt->data_item_size = 7;
	p.header.packet_size = (uint16_t)vrt_words_packet(&p);
	w = vrt_write_packet(&p, buf, words, true);
	if (w < 0) {
		return w;
	}
	vrt_to_big_endian(buf, w);
	return w;
}

static void send_ack(const struct peer *to, bool query, const struct vrt_ack_responses *errors,
		     bool executed)
{
	int32_t words;

	vrt_init_packet(&ack);
	vrt_init_command(&ack_cmd);
	ack.command = &ack_cmd;
	ack.header.packet_type = VRT_PT_COMMAND;
	ack.header.acknowledge = true;
	ack.fields.stream_id = pkt.fields.stream_id;
	ack_cmd.message_id = cmd.message_id;
	ack_cmd.cam.controllee_enable = cmd.cam.controllee_enable;
	ack_cmd.cam.controllee_format = cmd.cam.controllee_format;
	ack_cmd.controllee_id = cmd.controllee_id;
	memcpy(ack_cmd.controllee_uuid, cmd.controllee_uuid, sizeof(cmd.controllee_uuid));
	ack_cmd.cam.controller_enable = cmd.cam.controller_enable;
	ack_cmd.cam.controller_format = cmd.cam.controller_format;
	ack_cmd.controller_id = cmd.controller_id;
	memcpy(ack_cmd.controller_uuid, cmd.controller_uuid, sizeof(cmd.controller_uuid));

	if (query) {
		/* Query-state acknowledge: the settings as context fields. */
		struct radio_state rs;
		uint64_t center;
		struct vrt_data_packet_payload_format *f = &ack.if_context.data_packet_payload_format;

		radio_get(&rs);
		center = radio_center_hz(rs.freq_hz);
		ack_cmd.cam.query_state = true;
		ack.if_context.has.rf_reference_frequency = true;
		ack.if_context.rf_reference_frequency = (double)(center != 0U ? center : rs.freq_hz);
		ack.if_context.has.sample_rate = true;
		ack.if_context.sample_rate = (double)rs.rate_hz;
		ack.if_context.has.gain = true;
		ack.if_context.gain.stage1 = (float)rs.gain;
		/* the epoch of the settings as they are after this command */
		ack.if_context.has.state_and_event_indicators = true;
		ack.if_context.state_and_event_indicators.user_defined = rs.epoch;
		ack.if_context.has.data_packet_payload_format = true;
		f->packing_method = VRT_PM_LINK_EFFICIENT;
		f->real_or_complex = VRT_ROC_COMPLEX_CARTESIAN;
		f->data_item_format = VRT_DIF_SIGNED_FIXED_POINT;
		f->item_packing_field_size = 7;
		f->data_item_size = 7;
	} else {
		ack_cmd.cam.execution = true;
		ack_cmd.cam.scheduled_or_executed = executed;
		ack_cmd.cam.errors = cmd.cam.errors && errors != NULL;
		if (ack_cmd.cam.errors) {
			ack_cmd.errors = *errors;
		}
	}
	ack.header.packet_size = (uint16_t)vrt_words_packet(&ack);
	words = vrt_write_packet(&ack, ack_buf, ARRAY_SIZE(ack_buf), true);
	if (words < 0) {
		stats.errors++;
		return;
	}
	vrt_to_big_endian(ack_buf, words);
	if (txpath_send_ctl(to, ack_buf, (size_t)words * 4U) != 0) {
		stats.errors++;
	}
}

static void handle_command(const struct peer *from, bool is_sub)
{
	struct vrt_ack_responses errors = {0};
	const struct vrt_if_context *c = &pkt.if_context;
	struct radio_state rs;
	uint64_t hz;
	int gain;
	uint32_t rate;
	bool any_error = false, executed = false;
	bool settings = c->has.rf_reference_frequency || c->has.gain || c->has.sample_rate ||
			c->has.data_packet_payload_format;

	radio_get(&rs);
	hz = rs.freq_hz;
	gain = rs.gain;
	rate = rs.rate_hz;
	stats.commands++;
	if (pkt.header.acknowledge) {
		return;
	}
	if (pkt.header.cancellation) {
		/* a cancellation does not stop the stream: VRTX with a cookie does */
		return;
	}
	if (pkt.fields.stream_id != CONFIG_APP_VRT_STREAM_ID) {
		stats.bad++;
		return;
	}
	if (!is_sub) {
		/* a host that is not the subscriber may only ask for the state */
		if (cmd.cam.query_state && !settings && !cmd.cam.execution &&
		    ctl_proto_query_ok(&proto, from, k_uptime_get())) {
			send_ack(from, true, NULL, false);
		} else {
			stats.rejected++;
		}
		return;
	}
	if (c->has.rf_reference_frequency) {
		double f = c->rf_reference_frequency;

		if (f < 0.0 || f != floor(f) || f > 6e9 || !radio_freq_ok((uint64_t)f)) {
			errors.has.rf_reference_frequency = true;
			errors.rf_reference_frequency = VRT_WEF_PARAMETER_OUT_OF_RANGE;
			any_error = true;
		} else {
			hz = (uint64_t)f;
		}
	}
	if (c->has.gain) {
		float g = c->gain.stage1;

		if (c->gain.stage2 != 0.0f || g != floorf(g) ||
		    (g != -1.0f && (g < 0.0f || g > (float)radio_gain_max()))) {
			errors.has.gain = true;
			errors.gain = VRT_WEF_PARAMETER_OUT_OF_RANGE;
			any_error = true;
		} else {
			gain = (int)g;
		}
	}
	if (c->has.data_packet_payload_format) {
		const struct vrt_data_packet_payload_format *f = &c->data_packet_payload_format;

		if (f->packing_method != VRT_PM_LINK_EFFICIENT ||
		    f->real_or_complex != VRT_ROC_COMPLEX_CARTESIAN ||
		    f->data_item_format != VRT_DIF_SIGNED_FIXED_POINT || f->data_item_size != 7 ||
		    f->item_packing_field_size != 7) {
			errors.has.data_packet_payload_format = true;
			errors.data_packet_payload_format = VRT_WEF_PARAMETER_OUT_OF_RANGE;
			any_error = true;
		}
	}
	if (c->has.sample_rate) {
		double r = c->sample_rate;

		if (r != floor(r) || r < 1.0 || r > 1e9 || !radio_rate_ok((uint32_t)r)) {
			errors.has.sample_rate = true;
			errors.sample_rate = VRT_WEF_PARAMETER_OUT_OF_RANGE;
			any_error = true;
		} else {
			rate = (uint32_t)r;
		}
	}
	if (cmd.cam.action_mode == VRT_AM_EXECUTE && (!any_error || cmd.cam.permit_errors)) {
		if (c->has.rf_reference_frequency && !errors.has.rf_reference_frequency &&
		    radio_set_freq(hz) != 0) {
			errors.has.rf_reference_frequency = true;
			errors.rf_reference_frequency = VRT_WEF_PARAMETER_OUT_OF_RANGE;
			any_error = true;
		}
		if (c->has.gain && !errors.has.gain && radio_set_gain(gain) != 0) {
			stats.errors++;
		}
		if (c->has.sample_rate && !errors.has.sample_rate && radio_set_rate(rate) != 0) {
			stats.errors++;
		}
		executed = true;
	}
	if (cmd.cam.execution && (!cmd.cam.nack_only || any_error)) {
		send_ack(from, false, any_error ? &errors : NULL, executed);
	}
	if (cmd.cam.query_state) {
		send_ack(from, true, NULL, false);
	}
}

static void handle(const struct ctlmsg *m)
{
	struct ctl_out o;
	int32_t words, rv;
	bool sub;

	/* the decision and its effect under one lock: a stop on the shell cannot fall between them */
	k_mutex_lock(&proto_lock, K_FOREVER);
	ctl_proto_dgram(&proto, &m->p, m->data, m->len, k_uptime_get(), &o);
	apply_event(&o, &m->p);
	k_mutex_unlock(&proto_lock);
	if (o.act == CTL_REPLY) {
		/* a VRTK that could not go (no descriptor, no slot) is owed: the next renewal brings it */
		if (txpath_send_ctl(&m->p, o.reply, o.reply_len) != 0 && o.reply_len == 4U &&
		    o.reply[3] == 'K') {
			ack_owed = true;
			ack_owed_peer = m->p;
		}
		return;
	}
	if (o.evt == CTL_EVT_RENEWED && ack_owed && ctl_peer_same(&ack_owed_peer, &m->p) &&
	    txpath_send_ctl(&m->p, "VRTK", 4) == 0) {
		ack_owed = false;
	}
	if (o.act != CTL_CMD) {
		stats.bad += o.evt == CTL_EVT_NONE;
		return;
	}
	sub = o.is_sub;
	memcpy(rx_words, m->data, m->len);
	words = (int32_t)(m->len / 4U);
	vrt_from_big_endian(rx_words, words);
	vrt_init_packet(&pkt);
	vrt_init_command(&cmd);
	pkt.command = &cmd;
	rv = vrt_read_packet(rx_words, words, &pkt, true);
	if (rv < 0 || !vrt_is_command(&pkt.header)) {
		stats.bad++;
		return;
	}
	handle_command(&m->p, sub);
}

void ctl_run(void)
{
	struct ctlmsg m;

	for (;;) {
		bool gone;
		struct peer cur;

		if (k_msgq_get(&ctl_q, &m, K_MSEC(500)) == 0) {
			handle(&m);
		}
		k_mutex_lock(&proto_lock, K_FOREVER);
		gone = ctl_proto_expire(&proto, k_uptime_get());
		if (proto.live && !addr_local_ok(&proto.sub)) {
			/* the address it was sent to is gone (a new DHCP lease): the stream cannot go on */
			LOG_WRN("the address of the stream is gone: stopped");
			proto.live = false;
			gone = true;
		}
		if (gone && txpath_peer(&cur)) {
			LOG_INF("no renewal for %d s (or its address went): stream stopped",
				CONFIG_APP_VRT_SILENT_S);
			txpath_unsubscribe();
			radio_enable(false);
		}
		k_mutex_unlock(&proto_lock);
	}
}

void ctl_get_stats(struct ctl_stats *o)
{
	o->commands = stats.commands;
	o->subscribes = stats.subscribes;
	o->bad = stats.bad;
	o->errors = stats.errors;
	o->dropped = stats.dropped;
	o->rejected = stats.rejected;
}
```

## src/ctlproto.c
```c
/*
 * SPDX-License-Identifier: GPL-3.0-or-later
 */
#include <string.h>

#include "ctlproto.h"

#define ROTL(x, b) (uint64_t)(((x) << (b)) | ((x) >> (64 - (b))))
#define SIPROUND                                                                                   \
	do {                                                                                       \
		v0 += v1; v1 = ROTL(v1, 13); v1 ^= v0; v0 = ROTL(v0, 32);                          \
		v2 += v3; v3 = ROTL(v3, 16); v3 ^= v2;                                             \
		v0 += v3; v3 = ROTL(v3, 21); v3 ^= v0;                                             \
		v2 += v1; v1 = ROTL(v1, 17); v1 ^= v2; v2 = ROTL(v2, 32);                          \
	} while (0)

static uint64_t le64(const uint8_t *p)
{
	uint64_t v = 0;

	for (int k = 7; k >= 0; k--) {
		v = (v << 8) | p[k];
	}
	return v;
}

uint64_t siphash24(const uint8_t key[16], const uint8_t *in, size_t len)
{
	uint64_t k0 = le64(key), k1 = le64(key + 8);
	uint64_t v0 = 0x736f6d6570736575ULL ^ k0, v1 = 0x646f72616e646f6dULL ^ k1;
	uint64_t v2 = 0x6c7967656e657261ULL ^ k0, v3 = 0x7465646279746573ULL ^ k1;
	uint64_t b = (uint64_t)len << 56;
	size_t n = len & ~(size_t)7;

	for (size_t i = 0; i < n; i += 8) {
		uint64_t m = le64(in + i);

		v3 ^= m;
		SIPROUND;
		SIPROUND;
		v0 ^= m;
	}
	for (size_t i = 0; i < (len & 7U); i++) {
		b |= (uint64_t)in[n + i] << (8U * i);
	}
	v3 ^= b;
	SIPROUND;
	SIPROUND;
	v0 ^= b;
	v2 ^= 0xff;
	SIPROUND;
	SIPROUND;
	SIPROUND;
	SIPROUND;
	return v0 ^ v1 ^ v2 ^ v3;
}

void ctl_proto_init(struct ctl_proto *c, const uint8_t key[16], uint32_t ifindex, int64_t silent_ms)
{
	memset(c, 0, sizeof(*c));
	memcpy(c->key, key, 16);
	c->ifindex = ifindex;
	c->silent_ms = silent_ms;
}

void ctl_proto_cookie(const struct ctl_proto *c, const struct peer *p, uint32_t epoch, uint8_t out[8])
{
	uint8_t in[49] = {0};
	uint64_t h;

	in[0] = p->v6 ? 6 : 4;
	memcpy(in + 1, p->addr, p->v6 ? 16 : 4);
	in[17] = (uint8_t)(p->port >> 8);
	in[18] = (uint8_t)p->port;
	for (int k = 0; k < 4; k++) {
		in[19 + k] = (uint8_t)(c->ifindex >> (8 * k));
		in[23 + k] = (uint8_t)(epoch >> (8 * k));
	}
	/* the MAC the stream will go to and the address it will come from: the cookie that proves
	 * a host can receive is for these, so a renewal from another MAC is a stranger's
	 */
	memcpy(in + 27, p->mac, 6);
	memcpy(in + 33, p->local, 16);
	h = siphash24(c->key, in, sizeof(in));
	for (int k = 0; k < 8; k++) {
		out[k] = (uint8_t)(h >> (8 * k));
	}
}

bool ctl_peer_same(const struct peer *a, const struct peer *b)
{
	/* the MAC and the board address are part of who a subscriber is: two hosts may claim one IP, and
	 * a renewal to another address of the board is not the same stream
	 */
	return a->v6 == b->v6 && a->port == b->port && memcmp(a->mac, b->mac, 6) == 0 &&
	       memcmp(a->addr, b->addr, a->v6 ? 16 : 4) == 0 &&
	       memcmp(a->local, b->local, a->v6 ? 16 : 4) == 0;
}

static bool limit(int64_t *win, uint32_t *cnt, int64_t now, uint32_t max)
{
	if (now - *win >= 1000) {
		*win = now;
		*cnt = 0;
	}
	return ++*cnt <= max;
}

static struct ctl_src *src_get(struct ctl_proto *c, const struct peer *p, int64_t now)
{
	struct ctl_src *lru = &c->src[0];

	for (int k = 0; k < CTL_NSRC; k++) {
		struct ctl_src *s = &c->src[k];

		if (s->used && s->v6 == p->v6 && memcmp(s->addr, p->addr, p->v6 ? 16 : 4) == 0) {
			s->seen = now;
			return s;
		}
		if (!s->used || s->seen < lru->seen) {
			lru = s;
		}
	}
	memset(lru, 0, sizeof(*lru));
	lru->used = true;
	lru->v6 = p->v6;
	memcpy(lru->addr, p->addr, p->v6 ? 16 : 4);
	lru->win = lru->seen = now;
	return lru;
}

static bool src_limit(struct ctl_src *s, int64_t now, uint32_t *cnt, uint32_t max)
{
	if (now - s->win >= 1000) {
		s->win = now;
		s->n_adm = s->n_c = s->n_q = 0;
	}
	return ++*cnt <= max;
}

static bool is_sub(const struct ctl_proto *c, const struct peer *p)
{
	return c->live && ctl_peer_same(&c->sub, p);
}

/* The counters of this source: the subscriber's own for the full match, else the table's (by IP). */
static struct ctl_src *budget(struct ctl_proto *c, const struct peer *p, int64_t now)
{
	if (is_sub(c, p)) {
		if (!c->subs.used) {
			c->subs.used = true;
			c->subs.win = now;
		}
		return &c->subs;
	}
	return src_get(c, p, now);
}

bool ctl_proto_admit(struct ctl_proto *c, const struct peer *p, int64_t now)
{
	struct ctl_src *s = budget(c, p, now);
	bool sub = is_sub(c, p);

	if (!src_limit(s, now, &s->n_adm, sub ? 60U : 20U)) {
		return false;
	}
	return sub || limit(&c->awin, &c->acnt, now, 300U);
}

static bool cookie_ok(const struct ctl_proto *c, const struct peer *p, const uint8_t *ck, int64_t now)
{
	uint32_t epoch = (uint32_t)(now / CTL_EPOCH_MS);
	uint8_t want[8];

	for (uint32_t e = epoch; ; e = epoch - 1U) {
		ctl_proto_cookie(c, p, e, want);
		if (memcmp(want, ck, 8) == 0) {
			return true;
		}
		if (e != epoch || epoch == 0U) {
			return false;
		}
	}
}

static void reply_cookie(struct ctl_proto *c, const struct peer *p, int64_t now, struct ctl_out *o)
{
	/* 5 a second to a source, 100 a second in all: the subscriber's refresh is not in the 100 */
	struct ctl_src *s = budget(c, p, now);

	if (!src_limit(s, now, &s->n_c, 5U) || (!is_sub(c, p) && !limit(&c->gwin, &c->gcnt, now, 100U))) {
		return;
	}
	memcpy(o->reply, "VRTC", 4);
	ctl_proto_cookie(c, p, (uint32_t)(now / CTL_EPOCH_MS), o->reply + 4);
	o->reply_len = 12;
	o->act = CTL_REPLY;
}

void ctl_proto_dgram(struct ctl_proto *c, const struct peer *p, const uint8_t *d, size_t len,
		     int64_t now, struct ctl_out *o)
{
	memset(o, 0, sizeof(*o));
	o->act = CTL_IGNORE;
	if (len == 4U && memcmp(d, "VRTS", 4) == 0) {
		reply_cookie(c, p, now, o);
	} else if ((len == 12U || len == 13U) &&
		   (memcmp(d, "VRTS", 4) == 0 || memcmp(d, "VRTT", 4) == 0 || memcmp(d, "VRTX", 4) == 0)) {
		bool sub = memcmp(d, "VRTS", 4) == 0, take = memcmp(d, "VRTT", 4) == 0;

		if (!cookie_ok(c, p, d + 4, now)) {
			/* a stale cookie (or a forged one): a fresh one for those who can read it */
			if (sub) {
				reply_cookie(c, p, now, o);
			}
		} else if (c->blocked) {
			/* nothing */
		} else if (!sub && !take) {
			if (c->live && ctl_peer_same(&c->sub, p)) {
				c->live = false;
				o->evt = CTL_EVT_STOPPED;
			}
		} else if (c->live && !ctl_peer_same(&c->sub, p) && !take) {
			memcpy(o->reply, "VRTB", 4);
			o->reply_len = 4;
			o->act = CTL_REPLY;
		} else {
			bool fresh = !c->live || !ctl_peer_same(&c->sub, p);

			o->nocsum = len == 13U && (d[12] & 1U) != 0U;
			o->evt = !fresh ? CTL_EVT_RENEWED : (c->live ? CTL_EVT_TAKEOVER : CTL_EVT_SUBSCRIBED);
			if (fresh) {
				memset(&c->subs, 0, sizeof(c->subs));
			}
			c->sub = *p;
			c->live = true;
			o->nocsum = len == 13U && (d[12] & 1U) != 0U;
			c->sub.nocsum = o->nocsum;
			c->last_ms = now;
			if (fresh) {
				memcpy(o->reply, "VRTK", 4);
				o->reply_len = 4;
				o->act = CTL_REPLY;
			}
		}
	} else if (len >= 8U && (d[0] >> 4) == 6U && len % 4U == 0U) {
		o->act = CTL_CMD;
		o->is_sub = is_sub(c, p);
	}
}

bool ctl_proto_expire(struct ctl_proto *c, int64_t now)
{
	if (c->live && now - c->last_ms > c->silent_ms) {
		c->live = false;
		return true;
	}
	return false;
}

bool ctl_proto_query_ok(struct ctl_proto *c, const struct peer *p, int64_t now)
{
	struct ctl_src *s = budget(c, p, now);

	return src_limit(s, now, &s->n_q, 2U) && limit(&c->qwin, &c->qcnt, now, 10U);
}
```

## src/ctlproto.h
```c
/*
 * SPDX-License-Identifier: GPL-3.0-or-later
 *
 * The subscription protocol of UDP port 4992, without a network stack under it (so it runs on the
 * host): the board streams only to a host that has shown it can receive at its address.
 *
 *   host -> board  "VRTS"                  board -> host  "VRTC" + 8 byte cookie
 *   host -> board  "VRTS" + cookie         subscribes or renews;  board -> host "VRTK" on a new
 *                                          subscription, "VRTB" when another host has the stream
 *   host -> board  "VRTT" + cookie         takes the stream over from another host
 *   (VRTS and VRTT may have a 13th byte after the cookie: bit 0 asks for a zero UDP checksum over
 *   IPv6, for a host that set UDP_NO_CHECK6_RX; the board does it only if built for it.)
 *   host -> board  "VRTX" + cookie         stops (from the subscriber only)
 *
 * The cookie is SipHash-2-4 of the source address, port, source MAC, the address the host sent to,
 * the interface and a 30 s epoch under a key made at boot: the board keeps no state for a host that has not subscribed. The current and the
 * previous epoch are accepted. A VITA 49.2 command packet is handed back to the caller with a flag
 * telling whether it comes from the subscriber.
 */
#ifndef STREAM_ETH_CTLPROTO_H_
#define STREAM_ETH_CTLPROTO_H_

#include <stddef.h>
#include <stdint.h>

#include "peer.h"

#define CTL_COOKIE_BYTES 8U
#define CTL_EPOCH_MS     30000
#define CTL_MAX_REPLY    12U

enum ctl_act { CTL_IGNORE, CTL_REPLY, CTL_CMD };
enum ctl_evt { CTL_EVT_NONE, CTL_EVT_SUBSCRIBED, CTL_EVT_RENEWED, CTL_EVT_STOPPED, CTL_EVT_TAKEOVER };

struct ctl_out {
	enum ctl_act act;
	enum ctl_evt evt;
	uint8_t reply[CTL_MAX_REPLY];
	uint8_t reply_len;
	/** For CTL_CMD: the packet comes from the live subscriber. */
	bool is_sub;
	/** The subscribe asked for a zero UDP checksum over IPv6 (the flag byte after the cookie). */
	bool nocsum;
};

/** Per-source budgets: a small table, the least recently seen source goes. */
struct ctl_src {
	bool used, v6;
	uint8_t addr[16];
	int64_t win, seen;
	uint32_t n_adm, n_c, n_q;
};
#define CTL_NSRC 8

struct ctl_proto {
	struct ctl_src src[CTL_NSRC];
	/** The live subscriber's own counters (full match: address, port, MAC, local address). */
	struct ctl_src subs;
	int64_t gwin, awin;
	uint32_t gcnt, acnt;
	uint8_t key[16];
	uint32_t ifindex;
	struct peer sub;
	bool live;
	/** `stream stop` on the shell: nobody may subscribe until it is lifted. */
	bool blocked;
	int64_t last_ms;
	int64_t silent_ms;
	int64_t qwin, gwin2;
	uint32_t qcnt, gcnt2;
};

uint64_t siphash24(const uint8_t key[16], const uint8_t *in, size_t len);
void ctl_proto_init(struct ctl_proto *c, const uint8_t key[16], uint32_t ifindex, int64_t silent_ms);
void ctl_proto_cookie(const struct ctl_proto *c, const struct peer *p, uint32_t epoch, uint8_t out[8]);
bool ctl_peer_same(const struct peer *a, const struct peer *b);
void ctl_proto_dgram(struct ctl_proto *c, const struct peer *p, const uint8_t *d, size_t len,
		     int64_t now_ms, struct ctl_out *o);
/** True once when the subscriber has been silent too long: it is gone. */
bool ctl_proto_expire(struct ctl_proto *c, int64_t now_ms);
/**
 * Another host's query-state command: 2 answers a second to a source and 10 a second in all (the
 * subscriber has no share in this: it asks nothing it needs).
 */
bool ctl_proto_query_ok(struct ctl_proto *c, const struct peer *p, int64_t now_ms);

/**
 * Before anything is queued or looked at: may this datagram's source be taken at all? 20 a
 * second from a source and 300 in all; the live subscriber has 60 a second of its own, outside
 * the 300, so that it is never shut out by a flood from others.
 */
bool ctl_proto_admit(struct ctl_proto *c, const struct peer *p, int64_t now_ms);

#endif
```

## src/netframe.c
```c
/*
 * SPDX-License-Identifier: GPL-3.0-or-later
 */

#include <string.h>

#include "netframe.h"

#define BE_HOST (__BYTE_ORDER__ == __ORDER_BIG_ENDIAN__)

static inline void put16(uint8_t *p, uint16_t v)
{
	p[0] = (uint8_t)(v >> 8);
	p[1] = (uint8_t)v;
}

/*
 * Words are loaded as the CPU has them. On a little endian CPU that sums the bytes swapped, which
 * one's complement arithmetic carries through to the end: nf_fold() swaps back.
 */
uint64_t nf_sum(const void *p, size_t len, uint64_t acc)
{
	const uint8_t *b = p;

	if (((uintptr_t)b & 3U) == 0U) {
		const uint32_t *w = (const uint32_t *)__builtin_assume_aligned(b, 4);
		size_t n = len / 4U;

		for (size_t k = 0; k < n; k++) {
			acc += w[k];
		}
		b += n * 4U;
		len -= n * 4U;
	}
	while (len >= 2U) {
		uint16_t h;

		memcpy(&h, b, 2);
		acc += h;
		b += 2;
		len -= 2U;
	}
	if (len != 0U) {
		uint16_t h = 0;

		memcpy(&h, b, 1);
		acc += h;
	}
	return acc;
}

uint16_t nf_fold(uint64_t acc)
{
	uint32_t s;

	acc = (acc & 0xffffffffULL) + (acc >> 32);
	acc = (acc & 0xffffffffULL) + (acc >> 32);
	s = (uint32_t)acc;
	s = (s & 0xffffU) + (s >> 16);
	s = (s & 0xffffU) + (s >> 16);
	if (!BE_HOST) {
		s = ((s & 0xffU) << 8) | (s >> 8);
	}
	return (uint16_t)~s;
}

void nf_tmpl_init(struct nf_tmpl *t, bool v6, const uint8_t dmac[6], const uint8_t smac[6],
		  const uint8_t *saddr, const uint8_t *daddr, uint16_t sport, uint16_t dport)
{
	uint8_t *ip, *udp;
	size_t al = v6 ? 16U : 4U;

	memset(t, 0, sizeof(*t));
	t->v6 = v6;
	memcpy(t->b, dmac, 6);
	memcpy(t->b + 6, smac, 6);
	put16(t->b + 12, v6 ? 0x86ddU : 0x0800U);
	ip = t->b + NF_ETH_LEN;
	if (v6) {
		ip[0] = 0x60;
		ip[6] = 17; /* next header: UDP */
		ip[7] = 64; /* hop limit */
		memcpy(ip + 8, saddr, 16);
		memcpy(ip + 24, daddr, 16);
		udp = ip + 40;
		t->psum = nf_sum(saddr, 16, 0);
		t->psum = nf_sum(daddr, 16, t->psum);
	} else {
		ip[0] = 0x45;
		put16(ip + 6, 0x4000); /* don't fragment: the packets fit the MTU */
		ip[8] = 64;
		ip[9] = 17;
		memcpy(ip + 12, saddr, 4);
		memcpy(ip + 16, daddr, 4);
		udp = ip + 20;
	}
	(void)al;
	put16(udp, sport);
	put16(udp + 2, dport);
	t->len = (uint8_t)(udp + NF_UDP_LEN - t->b);
}

void nf_seal(struct nf_tmpl *t, uint8_t *hdr, size_t vrt_hdr, const uint8_t *body,
	     size_t body_len)
{
	nf_seal2(t, hdr, vrt_hdr, body, body_len, 0, 0);
}

void nf_seal2(struct nf_tmpl *t, uint8_t *hdr, size_t vrt_hdr, const uint8_t *body,
	      size_t body_len, uint64_t pre_sum, size_t pre_len)
{
	uint8_t *ip = hdr + NF_ETH_LEN;
	size_t udp_len = NF_UDP_LEN + vrt_hdr + body_len;

	if (t->v6 && t->zero_csum) {
		uint8_t *udp = ip + 40;

		put16(ip + 4, (uint16_t)udp_len);
		put16(udp + 4, (uint16_t)udp_len);
		put16(udp + 6, 0);
	} else if (t->v6) {
		uint8_t *udp = ip + 40;
		uint64_t acc;
		uint8_t pseudo[8];
		uint16_t c;

		put16(ip + 4, (uint16_t)udp_len);
		put16(udp + 4, (uint16_t)udp_len);
		put16(udp + 6, 0);
		/* length (32 bit) and next header, as the pseudo header has them */
		pseudo[0] = 0;
		pseudo[1] = 0;
		put16(pseudo + 2, (uint16_t)udp_len);
		pseudo[4] = 0;
		pseudo[5] = 0;
		pseudo[6] = 0;
		pseudo[7] = 17;
		acc = nf_sum(pseudo, 8, t->psum);
		acc = nf_sum(udp, NF_UDP_LEN + vrt_hdr, acc);
		acc += pre_sum;
		acc = nf_sum(body + pre_len, body_len - pre_len, acc);
		c = nf_fold(acc);
		put16(udp + 6, c == 0U ? 0xffffU : c);
	} else {
		uint8_t *udp = ip + 20;

		put16(ip + 2, (uint16_t)(20U + udp_len));
		t->id++;
		put16(ip + 4, t->id);
		put16(ip + 10, 0);
		put16(ip + 10, nf_fold(nf_sum(ip, 20, 0)));
		put16(udp + 4, (uint16_t)udp_len);
		put16(udp + 6, 0);
	}
}
```

## src/netframe.h
```c
/*
 * SPDX-License-Identifier: GPL-3.0-or-later
 *
 * Ethernet, IPv4 or IPv6 and UDP headers made once per subscriber as a template, and filled per
 * packet with the lengths and checksums only. No Zephyr in here, so it runs on the host.
 *
 * IPv4 carries a UDP checksum of 0 (legal); IPv6 needs it and gets it, summed over the VRT
 * header and the body.
 */

#ifndef STREAM_ETH_NETFRAME_H_
#define STREAM_ETH_NETFRAME_H_

#include <stdbool.h>
#include <stddef.h>
#include <stdint.h>

#define NF_ETH_LEN  14U
#define NF_UDP_LEN  8U
/* Ethernet, IPv6, UDP: the largest of them. */
#define NF_HDR_MAX  (NF_ETH_LEN + 40U + NF_UDP_LEN)

struct nf_tmpl {
	uint8_t b[NF_HDR_MAX];
	/** Template bytes in use: Ethernet, IP and UDP headers. */
	uint8_t len;
	bool v6;
	/** IPv6: leave the UDP checksum 0 (RFC 6936, on-link, the receiver must allow it). */
	bool zero_csum;
	uint16_t id;
	/** Sum of the pseudo header's addresses and next header, in the domain of nf_sum(). */
	uint64_t psum;
};

/** The sum of 16 bit words of the bytes, big endian, as a 64 bit accumulator. */
uint64_t nf_sum(const void *p, size_t len, uint64_t acc);

/** Fold and complement an accumulator of nf_sum(): the checksum as a host number. */
uint16_t nf_fold(uint64_t acc);

/**
 * @param saddr 4 or 16 bytes.
 * @param daddr 4 or 16 bytes.
 */
void nf_tmpl_init(struct nf_tmpl *t, bool v6, const uint8_t dmac[6], const uint8_t smac[6],
		  const uint8_t *saddr, const uint8_t *daddr, uint16_t sport, uint16_t dport);

/**
 * Finish a frame: `hdr` holds the template's bytes followed by `vrt_hdr` bytes of VRT header
 * (the caller's), and the datagram goes on in `body` (sample data and the trailer), whose length
 * is `body_len`. Sets the IP and UDP lengths, the IPv4 header checksum and ID, and the IPv6 UDP
 * checksum.
 */
void nf_seal(struct nf_tmpl *t, uint8_t *hdr, size_t vrt_hdr, const uint8_t *body,
	     size_t body_len);

/**
 * nf_seal() when the sum of the first `pre_len` bytes of the body (an even number) is known:
 * pre_sum, as nf_sum() gives it (the cells sum while they copy).
 */
void nf_seal2(struct nf_tmpl *t, uint8_t *hdr, size_t vrt_hdr, const uint8_t *body, size_t body_len,
	      uint64_t pre_sum, size_t pre_len);

#endif /* STREAM_ETH_NETFRAME_H_ */
```

## src/peer.h
```c
/*
 * SPDX-License-Identifier: GPL-3.0-or-later
 */
#ifndef STREAM_ETH_PEER_H_
#define STREAM_ETH_PEER_H_

#include <stdbool.h>
#include <stdint.h>

/** Where a stream goes: from the datagram that asked. */
struct peer {
	bool v6;
	uint8_t mac[6];
	uint8_t addr[16];
	/** The address the host sent to, which the packets come from. */
	uint8_t local[16];
	uint16_t port;
	/** IPv6: the host takes a zero UDP checksum (it asked, UDP_NO_CHECK6_RX); see README. */
	bool nocsum;
};

#endif
```
