/*
 * SPDX-License-Identifier: GPL-3.0-or-later
 *
 * The protocol on USB-Serial-JTAG, the XIAO's USB-C port, which also flashes;
 * the console moves to UART0 (D6 TX, D7 RX).
 */

/ {
	chosen {
		esp-sdr,websdr-uart = &usb_serial;
		zephyr,console = &uart0;
		zephyr,shell-uart = &uart0;
	};
};
