## CMakeLists.txt
```
# SPDX-License-Identifier: GPL-3.0-or-later

cmake_minimum_required(VERSION 3.20.0)

find_package(Zephyr REQUIRED HINTS $ENV{ZEPHYR_BASE})
project(esp_sdr_link)

include(${CMAKE_CURRENT_LIST_DIR}/../common/common.cmake)
include(${CMAKE_CURRENT_LIST_DIR}/sources.cmake)

target_sources(app PRIVATE ${LINK_SOURCES})
target_compile_definitions(app PRIVATE QAM_SPS=${CONFIG_APP_SPS})

if(CONFIG_APP_OFDM_ESP_DSP)
  link_esp_dsp_fft(esp_dsp_fft)
  target_sources(app PRIVATE ${esp_dsp_fft})
endif()
```

## Kconfig
```
# SPDX-License-Identifier: GPL-3.0-or-later

mainmenu "ESP-SDR link"

config APP_FREQ_MHZ
	int "Carrier frequency in MHz"
	range 100 6000
	default 2412

config APP_TX_GAIN
	int "Transmit power step at boot (0 weakest)"
	range 0 17
	default 0

config APP_RX_GAIN
	int "Receive gain index at boot (-1: hardware AGC)"
	range -1 82
	default 0
	help
	  A fixed gain keeps the level steady across a capture; the AGC
	  reacts to the frame itself.

config APP_SPS
	int "Samples per symbol (even)"
	range 4 16
	default 4
	help
	  At 80 MS/s: 4 is 20 Mbaud (27 MHz occupied), 6 is 13.3 Mbaud
	  (18 MHz). With the PHY in its 20 MHz mode (APP_CBW 0) the analog
	  filters pass about +-10 MHz, where 6 fits better. Both ends must
	  agree.

config APP_CBW
	int "PHY channel bandwidth flag (esp_sdr_set_channel_bw())"
	range 0 2
	default 2
	help
	  2 widens the analog filters past +-10 MHz (measured: -14 instead of
	  -21 dB at 11 MHz) and lifts the MER by about 1.5 dB at 20 Mbaud.

config APP_RX_BW_MHZ
	int "Receive filter bandwidth in MHz (0: widest, -1: the PHY's setting)"
	range -1 69
	default 0
	help
	  Otherwise 13 to 69 MHz (1 to 12 fail the build). The PHY's own
	  setting is about 22 MHz wide, narrower than the
	  27 MHz the 20 Mbaud signal occupies.

config APP_AMP
	int "RMS amplitude of a frame in DAC steps"
	range 1 300
	default 150

config APP_DATA_AIR_US
	int "Time a data frame stays on air, in us"
	default 700
	help
	  The frame repeats in a loop for this long. It must cover a
	  listener's sense slot, its reaction and one full capture window
	  (205 us), so that the window holds one whole copy.

config APP_ACK_AIR_US
	int "Time an ACK stays on air, in us"
	default 700

config APP_ACK_TIMEOUT_US
	int "How long a sender listens for the ACK, in us"
	default 25000
	help
	  From the end of its frame: covers the receiver's capture, decode
	  and switch to transmit.

config APP_TURN_US
	int "Front end settling at each TX/RX switch, in us"
	range 0 3000
	default 3000
	help
	  esp_sdr_set_turnaround(). Each frame and each ACK switches twice,
	  so this bounds the frame rate of the stop and wait link.

config APP_TURN_RETUNE
	bool "Reprogram the LO at each TX/RX switch"
	default y

config APP_CCA_DB
	int "Carrier sense threshold above the noise floor, in dB"
	default 10

config APP_RADIO_CPU
	int "CPU of the MAC thread"
	range 0 1
	default 1

config APP_NET_CPU
	int "CPU for the system threads (-1: not pinned)"
	range -1 1
	default 0

config APP_BUILD_PRIORITY
	int "Frame builder thread priority (runs on APP_NET_CPU)"
	default 10

config APP_RX2_PRIORITY
	int "Priority of the second decoder of a pair (runs on APP_NET_CPU)"
	default 6

config APP_OFDM_BW_KHZ
	int "OFDM: occupied bandwidth (kHz)"
	default 26000

config APP_OFDM_CHANNELS
	int "OFDM: subcarriers"
	default 84

config APP_OFDM_FS_MHZ
	int "OFDM: transmit sample rate (MS/s, 80 or 40)"
	range 40 80
	default 40

config APP_OFDM_RX_DIV
	int "OFDM: receive at the transmit rate divided by this (1 or 2, at least 40 MS/s)"
	range 1 2
	default 1

config APP_OFDM_ESP_DSP
	bool "OFDM FFT: the esp-dsp ESP32-S3 kernel (modules/lib/esp-dsp)"
	default y
	help
	  Else the same radix-2 algorithm in C, in IRAM.

config APP_RS_PARITY
	int "Reed-Solomon parity bytes per 255-byte unit"
	range 8 64
	default 32
	help
	  Multiple of 4. The unit corrects half as many byte errors. 32 is RS(255,223),
	  24 is RS(255,231), 16 is RS(255,239). The 64-QAM link needs about 4.7
	  corrections per unit at an MER of 23.5 dB and twice that at 22.3 (the MER
	  drifts that much in a session): 24 carries 3.6 % more and decodes faster at
	  the top of the drift but loses half the frames at the bottom, 16 a fifth
	  at the top.

config APP_MAC_PRIORITY
	int "MAC thread priority"
	default 4

rsource "../common/Kconfig"

# USB device helpers shared with the in-tree USB samples.
source "samples/subsys/usb/common/Kconfig.sample_usbd"

source "Kconfig.zephyr"
```

## sample.yaml
```
sample:
  name: ESP-SDR link
  description: >-
    QAM link at the native 80 MS/s with Reed-Solomon coding, a CSMA/CA MAC
    and an iperf style throughput test on the USB shell
common:
  tags: esp-sdr
  sysbuild: true
  platform_allow:
    - xiao_esp32s3/esp32s3/procpu
    - communicator_badge/esp32s3/procpu
  integration_platforms:
    - xiao_esp32s3/esp32s3/procpu
tests:
  # Two boards and a cabled link: run tools/link_perf.py (see README).
  sample.esp_sdr.link:
    build_only: true
```

## prj.conf
```kconfig
# The Wi-Fi driver brings the radio up at boot; nothing may scan or connect.
CONFIG_NETWORKING=y
CONFIG_WIFI=y
CONFIG_ESP32_WIFI_STA_POWER_SAVE_NONE=y

CONFIG_ESP_SDR=y
# Two dump banks: one plays the pending frame, the other captures and ACKs.
CONFIG_ESP_SDR_BANK1=y
# Native 80 MS/s only.
CONFIG_ESP_SDR_RX_DECIM=n

CONFIG_LOG=y
CONFIG_LOG_MODE_DEFERRED=y

CONFIG_FPU=y
CONFIG_FPU_SHARING=y
CONFIG_CBPRINTF_FP_SUPPORT=y
CONFIG_PICOLIBC_IO_FLOAT=y
CONFIG_MAIN_STACK_SIZE=2048

CONFIG_SMP=y
CONFIG_HWINFO=y
CONFIG_ENTROPY_GENERATOR=y

# USB device on the OTG port: shell on CDC-ACM, DFU with sysbuild/MCUboot.
CONFIG_USB_DEVICE_STACK_NEXT=y
CONFIG_SAMPLE_USBD_PRODUCT="ESP-SDR Link"
CONFIG_SAMPLE_USBD_PID=0x0005
CONFIG_USBD_LOG_LEVEL_WRN=y
CONFIG_UDC_DRIVER_LOG_LEVEL_WRN=y
CONFIG_USBD_THREAD_STACK_SIZE=2048
CONFIG_UDC_DWC2_STACK_SIZE=1280
CONFIG_USBD_CDC_ACM_CLASS=y
CONFIG_CDC_ACM_SERIAL_INITIALIZE_AT_BOOT=n

CONFIG_SHELL=y
CONFIG_KERNEL_SHELL=y
CONFIG_LOG_BACKEND_UART=n
CONFIG_SHELL_STACK_SIZE=3072
CONFIG_SHELL_CMD_BUFF_SIZE=128
CONFIG_SHELL_BACKEND_SERIAL_LOG_MESSAGE_QUEUE_SIZE=256
CONFIG_DEVICE_SHELL=n
CONFIG_DATE_SHELL=n
CONFIG_DEVMEM_SHELL=y
# Wi-Fi management commands would retune the radio under the MAC.
CONFIG_NET_L2_WIFI_SHELL=n

# Internal RAM: two 64 KiB dump banks must fit. The Wi-Fi heap goes to the
# 8 MB octal PSRAM.
CONFIG_ESP_SPIRAM=y
CONFIG_SPIRAM_MODE_OCT=y
CONFIG_ESP_WIFI_HEAP_SPIRAM=y
CONFIG_ESP32_WIFI_STATIC_RX_BUFFER_NUM=4
CONFIG_ESP32_WIFI_MGMT_SBUF_NUM=8
CONFIG_ESP32_WIFI_EVENT_TASK_STACK_SIZE=1024
CONFIG_NET_MGMT_EVENT_STACK_SIZE=1024
CONFIG_HEAP_MEM_POOL_IGNORE_MIN=y
# Peak 15.5 KB measured with "link mem".
CONFIG_HEAP_MEM_POOL_SIZE=17408
CONFIG_SYS_HEAP_RUNTIME_STATS=y

# A crash reboots into the confirmed image instead of halting with USB dead;
# "link status" shows the reset cause.
CONFIG_RESET_ON_FATAL_ERROR=y
# Experiments at the radio's limits: a hang resets instead of needing a replug.
CONFIG_APP_LIVENESS_WATCHDOG=y
```

## socs/esp32s3_procpu.overlay
```dts
/*
 * SPDX-License-Identifier: GPL-3.0-or-later
 */

#define APP_SHELL_LABEL "ESP-SDR link shell"
#include "../../common/boards/s3_cdc_shell.dtsi"
```

## src/main.c
```c
/*
 * SPDX-License-Identifier: GPL-3.0-or-later
 *
 * QAM link at 80 MS/s with a CSMA/CA MAC and an iperf style test on the
 * shell ("link"). The MAC thread owns the radio on one CPU, the system
 * threads go to the other.
 */

#include <zephyr/kernel.h>
#include <zephyr/logging/log.h>

#include "app_cpu.h"
#include "app_usb.h"
#include "mac.h"

LOG_MODULE_REGISTER(link, LOG_LEVEL_INF);

int main(void)
{
	app_cpu_pin_system_threads(CONFIG_APP_NET_CPU);
	if (app_usb_init() != 0) {
		LOG_ERR("usb init failed");
	}
	if (link_mac_init() != 0) {
		LOG_ERR("mac init failed");
		return 0;
	}
	/* Again for the threads started since (usbd, UDC). */
	k_sleep(K_MSEC(500));
	app_cpu_pin_system_threads(CONFIG_APP_NET_CPU);
	return 0;
}
```

## src/bch.c
```c
/*
 * SPDX-License-Identifier: GPL-3.0-or-later
 *
 * Binary BCH codec, see bch.h. A block's bits in order (data bytes, then the
 * parity bytes, each byte LSB first) are the coefficients of the codeword
 * polynomial from the highest degree down, n' = 8 k + r of them. The remainder
 * register is reflected like a CRC's: bit i holds the coefficient of
 * x^(r - 1 - i).
 */

#include <string.h>

#include "bch.h"

#if defined(__ZEPHYR__)
#include <esp_attr.h>
#define BCH_HOT IRAM_ATTR __attribute__((noinline))
#else
#define BCH_HOT
#endif

/* Primitive polynomials of GF(2^m), m 5 to 11. */
static const uint16_t prim_poly[BCH_M_MAX + 1U] = {
	[5] = 0x25, [6] = 0x43, [7] = 0x89, [8] = 0x11d, [9] = 0x211, [10] = 0x409, [11] = 0x805,
};

static bool in_range(unsigned int m, unsigned int t)
{
	return m >= BCH_M_MIN && m <= BCH_M_MAX && t >= 1U && t <= BCH_T_MAX;
}

/* The generator's degree: the size of the union of the cyclotomic cosets of 1, 3, .., 2t - 1. */
static unsigned int gen_degree(unsigned int m, unsigned int t)
{
	unsigned int n = (1U << m) - 1U, r = 0;
	uint32_t seen[(BCH_N_MAX + 32U) / 32U];

	memset(seen, 0, sizeof(seen));
	for (unsigned int i = 1; i < 2U * t; i += 2U) {
		unsigned int e = i;

		do {
			if ((seen[e / 32U] & (1U << (e % 32U))) == 0U) {
				seen[e / 32U] |= 1U << (e % 32U);
				r++;
			}
			e = (2U * e) % n;
		} while (e != i);
	}
	return r;
}

bool bch_params(unsigned int m, unsigned int t, unsigned int *r, unsigned int *rbytes,
		unsigned int *kmax)
{
	unsigned int deg;

	if (!in_range(m, t)) {
		return false;
	}
	deg = gen_degree(m, t);
	if (deg > 64U || deg + 8U > (1U << m) - 1U) {
		return false;
	}
	*r = deg;
	*rbytes = (deg + 7U) / 8U;
	*kmax = ((1U << m) - 1U - deg) / 8U;
	return true;
}

static inline unsigned int gf_mul(const struct bch_code *c, unsigned int a, unsigned int b)
{
	unsigned int n = (1U << c->m) - 1U, s;

	if (a == 0U || b == 0U) {
		return 0;
	}
	s = c->index_of[a] + c->index_of[b];
	return c->alpha_to[s >= n ? s - n : s];
}

static inline unsigned int gf_div(const struct bch_code *c, unsigned int a, unsigned int b)
{
	unsigned int n = (1U << c->m) - 1U, s;

	if (a == 0U) {
		return 0;
	}
	s = c->index_of[a] + n - c->index_of[b];
	return c->alpha_to[s >= n ? s - n : s];
}

int bch_init(struct bch_code *c, unsigned int m, unsigned int t)
{
	unsigned int n, r, rbytes, kmax, deg = 0, x = 1;
	/* The generator over GF(2^m) while it is multiplied up: coefficient of x^i. */
	uint16_t g[64U + 1U];
	uint64_t refl = 0;
	uint32_t seen[(BCH_N_MAX + 32U) / 32U];

	if (!bch_params(m, t, &r, &rbytes, &kmax)) {
		return -1;
	}
	n = (1U << m) - 1U;
	c->m = (uint8_t)m;
	c->t = (uint8_t)t;
	c->r = (uint8_t)r;
	c->rbytes = (uint8_t)rbytes;
	c->kmax = (uint16_t)kmax;

	for (unsigned int i = 0; i < n; i++) {
		c->alpha_to[i] = (uint16_t)x;
		c->index_of[x] = (uint16_t)i;
		x <<= 1;
		if ((x & (1U << m)) != 0U) {
			x ^= prim_poly[m];
		}
	}
	c->alpha_to[n] = 0;
	c->index_of[0] = (uint16_t)n;

	/* g(x): the product of (x + alpha^e) over the cosets of 1, 3, .., 2t - 1. */
	memset(g, 0, sizeof(g));
	g[0] = 1;
	memset(seen, 0, sizeof(seen));
	for (unsigned int i = 1; i < 2U * t; i += 2U) {
		unsigned int e = i;

		do {
			if ((seen[e / 32U] & (1U << (e % 32U))) == 0U) {
				unsigned int root = c->alpha_to[e];

				seen[e / 32U] |= 1U << (e % 32U);
				/* g = g (x + root) */
				deg++;
				for (unsigned int j = deg; j > 0U; j--) {
					g[j] = (uint16_t)(g[j - 1U] ^ gf_mul(c, g[j], root));
				}
				g[0] = (uint16_t)gf_mul(c, g[0], root);
			}
			e = (2U * e) % n;
		} while (e != i);
	}
	/* Binary coefficients; without the leading term, reflected: x^k at bit r - 1 - k. */
	for (unsigned int k = 0; k < r; k++) {
		if (g[k] != 0U) {
			refl |= (uint64_t)1U << (r - 1U - k);
		}
	}

	for (unsigned int b = 0; b < 256U; b++) {
		uint64_t v = b;

		for (unsigned int s = 1; s <= 32U; s++) {
			v = (v & 1U) != 0U ? (v >> 1) ^ refl : v >> 1;
			if (r > 32U) {
				if (s == 8U) {
					c->tab.t64[b] = v;
					break;
				}
			} else if (s % 8U == 0U) {
				c->tab.t32[s / 8U - 1U][b] = (uint32_t)v;
			}
		}
	}
	return 0;
}

/* The remainder of the @p k bytes' polynomial times x^r. */
BCH_HOT static uint64_t bch_rem(const struct bch_code *c, const uint8_t *p, size_t k)
{
	if (c->r > 32U) {
		uint64_t reg = 0;

		for (size_t i = 0; i < k; i++) {
			reg = (reg >> 8) ^ c->tab.t64[(reg ^ p[i]) & 0xffU];
		}
		return reg;
	}

	const uint32_t(*t)[256] = c->tab.t32;
	uint32_t reg = 0;

	/* Bytes to a word boundary, words (little endian: the first byte lowest), the rest. */
	while (k > 0U && ((uintptr_t)p & 3U) != 0U) {
		reg = (reg >> 8) ^ t[0][(reg ^ *p++) & 0xffU];
		k--;
	}
	for (; k >= 4U; k -= 4U, p += 4) {
		uint32_t w = reg ^ *(const uint32_t *)(const void *)p;

		reg = t[3][w & 0xffU] ^ t[2][(w >> 8) & 0xffU] ^ t[1][(w >> 16) & 0xffU] ^
		      t[0][w >> 24];
	}
	while (k-- > 0U) {
		reg = (reg >> 8) ^ t[0][(reg ^ *p++) & 0xffU];
	}
	return reg;
}

void bch_encode(const struct bch_code *c, const uint8_t *data, size_t k, uint8_t *parity)
{
	uint64_t reg = bch_rem(c, data, k);

	for (unsigned int q = 0; q < c->rbytes; q++) {
		parity[q] = (uint8_t)(reg >> (8U * q));
	}
}

int bch_decode(const struct bch_code *c, uint8_t *data, size_t k, uint8_t *parity)
{
	unsigned int n = (1U << c->m) - 1U, t = c->t, r = c->r, len = 8U * (unsigned int)k + r;
	/* The locator may grow to degree 2t on the way (more than t errors: rejected below). */
	unsigned int s_[2U * BCH_T_MAX], lam[2U * BCH_T_MAX + 1U], bb[2U * BCH_T_MAX + 1U],
		tmp[2U * BCH_T_MAX + 1U];
	unsigned int el = 0, mm = 1, bd = 1, nroots = 0, pos[BCH_T_MAX];
	unsigned int term[BCH_T_MAX + 1U];
	uint64_t rx = 0, s;

	for (unsigned int q = 0; q < c->rbytes; q++) {
		rx |= (uint64_t)parity[q] << (8U * q);
	}
	if (r < 64U) {
		rx &= ((uint64_t)1U << r) - 1U;
	}
	s = bch_rem(c, data, k) ^ rx;
	if (s == 0U) {
		return 0;
	}

	/* Syndromes S_j = s(alpha^j), j = 1 .. 2t (s_[j - 1]); the even ones as squares. */
	for (unsigned int j = 1; j <= 2U * t; j += 2U) {
		unsigned int acc = 0;

		for (unsigned int i = 0; i < r; i++) {
			if (((s >> i) & 1U) != 0U) {
				acc ^= c->alpha_to[(j * (r - 1U - i)) % n];
			}
		}
		s_[j - 1U] = acc;
	}
	for (unsigned int j = 2; j <= 2U * t; j += 2U) {
		s_[j - 1U] = gf_mul(c, s_[j / 2U - 1U], s_[j / 2U - 1U]);
	}

	/* Berlekamp-Massey: the error locator lam(x), degree el. */
	memset(lam, 0, sizeof(lam));
	memset(bb, 0, sizeof(bb));
	lam[0] = 1;
	bb[0] = 1;
	for (unsigned int i = 0; i < 2U * t; i++) {
		unsigned int d = s_[i];

		for (unsigned int j = 1; j <= el; j++) {
			d ^= gf_mul(c, lam[j], s_[i - j]);
		}
		if (d == 0U) {
			mm++;
			continue;
		}
		{
			unsigned int f = gf_div(c, d, bd);

			memcpy(tmp, lam, sizeof(tmp));
			for (unsigned int j = 0; j + mm <= 2U * t; j++) {
				lam[j + mm] ^= gf_mul(c, f, bb[j]);
			}
			if (2U * el <= i) {
				el = i + 1U - el;
				memcpy(bb, tmp, sizeof(bb));
				bd = d;
				mm = 1;
			} else {
				mm++;
			}
		}
	}
	if (el == 0U || el > t) {
		return -1;
	}

	/* Chien search over the block's degrees e = 0 .. len - 1: lam(alpha^-e) = 0. */
	for (unsigned int j = 0; j <= el; j++) {
		term[j] = c->index_of[lam[j]];
	}
	for (unsigned int e = 0; e < len; e++) {
		unsigned int sum = 0;

		for (unsigned int j = 0; j <= el; j++) {
			if (term[j] != n) {
				sum ^= c->alpha_to[term[j]];
				term[j] = term[j] >= j ? term[j] - j : term[j] + n - j;
			}
		}
		if (sum == 0U) {
			if (nroots == el) {
				return -1;
			}
			pos[nroots++] = e;
		}
	}
	if (nroots != el) {
		return -1;
	}
	for (unsigned int i = 0; i < nroots; i++) {
		/* Degree e is bit len - 1 - e in order: data, then parity. */
		unsigned int b = len - 1U - pos[i];

		if (b < 8U * (unsigned int)k) {
			data[b / 8U] ^= (uint8_t)(1U << (b % 8U));
		} else {
			b -= 8U * (unsigned int)k;
			parity[b / 8U] ^= (uint8_t)(1U << (b % 8U));
		}
	}
	return (int)nroots;
}
```

## src/bch.h
```c
/*
 * SPDX-License-Identifier: GPL-3.0-or-later
 *
 * Binary BCH codes over GF(2^m), m 5 to 11, correcting up to t bit errors per
 * block (t 1 to 4; t 1 is a Hamming code), shortened to whole data bytes: a
 * block is k data bytes and rbytes parity bytes holding the r = deg g parity
 * bits, 8 k + r <= 2^m - 1. Bits go LSB first like a reflected CRC: the encoder
 * and the decoder's check run the remainder register from tables, four bytes
 * per step while r <= 32 (slicing by 4); only a block whose remainder is not
 * zero gets syndromes, Berlekamp-Massey and a Chien search. Portable C, no
 * Zephyr dependencies.
 */

#ifndef LINK_BCH_H_
#define LINK_BCH_H_

#include <stdbool.h>
#include <stddef.h>
#include <stdint.h>

#define BCH_M_MIN 5U
#define BCH_M_MAX 11U
#define BCH_T_MAX 4U
#define BCH_N_MAX ((1U << BCH_M_MAX) - 1U)

struct bch_code {
	uint8_t m, t;
	/* Parity bits (the generator's degree) and the bytes that hold them. */
	uint8_t r, rbytes;
	/* Most data bytes per block. */
	uint16_t kmax;
	/* GF(2^m): alpha_to[i] = alpha^i, index_of[x] = log x, index_of[0] = 2^m - 1. */
	uint16_t alpha_to[BCH_N_MAX + 1U], index_of[BCH_N_MAX + 1U];
	/*
	 * The remainder register after one byte from v = b (t32[0], r <= 32) and after
	 * two, three and four (slicing by 4); a byte at a time in 64 bits for r > 32.
	 */
	union {
		uint32_t t32[4][256];
		uint64_t t64[256];
	} tab;
};

/*
 * The parity bits and bytes and the most data bytes per block of the code
 * (m, t). Returns false for parameters out of range.
 */
bool bch_params(unsigned int m, unsigned int t, unsigned int *r, unsigned int *rbytes,
		unsigned int *kmax);

/* Set up @p c for (m, t). Returns 0, or -1 for parameters out of range. */
int bch_init(struct bch_code *c, unsigned int m, unsigned int t);

/* The rbytes parity bytes of @p k data bytes (k <= kmax). */
void bch_encode(const struct bch_code *c, const uint8_t *data, size_t k, uint8_t *parity);

/*
 * Correct a block in place. Returns the number of corrected bits (0 for a
 * clean block) or -1 if it is not correctable (left as received).
 */
int bch_decode(const struct bch_code *c, uint8_t *data, size_t k, uint8_t *parity);

#endif /* LINK_BCH_H_ */
```

## src/mac.h
```c
/*
 * SPDX-License-Identifier: GPL-3.0-or-later
 *
 * CSMA/CA MAC over the QAM PHY: carrier sense on short captures, DIFS and
 * binary exponential backoff counted in sense slots, stop and wait ARQ with
 * immediate ACKs, duplicate detection by sequence number. One thread owns
 * the radio; frames play from a DAC bank in a loop for a fixed airtime so
 * that a listening receiver catches one whole copy.
 */

#ifndef LINK_MAC_H_
#define LINK_MAC_H_

#include <stdbool.h>
#include <stdint.h>

#include <zephyr/kernel.h>

#include <esp_sdr/esp_sdr.h>

#include "qam.h"

#define MAC_ADDR_BROADCAST 0xffU

enum mac_type {
	MAC_DATA,
	MAC_ACK,
};

/* PHY of the frames (with OFDM the ACKs are header-only OFDM frames). */
enum mac_phy {
	MAC_PHY_QAM,
	MAC_PHY_OFDM,
};

struct mac_cfg {
	uint32_t freq_mhz;
	/* enum mac_phy; both ends alike, and for OFDM the same "ofdm set" settings. */
	int phy;
	/* Transmit power step, receive gain index (ESP_SDR_RX_GAIN_AUTO for AGC). */
	int tx_gain;
	int rx_gain;
	/* TX low-pass codes (esp_sdr_tx_set_lpf(), -1 the PHY's). */
	int tx_lpf_a, tx_lpf_b;
	/* PHY channel bandwidth flag (esp_sdr_set_channel_bw()). */
	int cbw;
	/* Receive filter: two-sided MHz, 0 widest, -1 the PHY's own setting. */
	int bw_mhz;
	/* Receiver: average up to this many loop copies of short frames. */
	int avg;
	/* RMS DAC amplitude of a frame. */
	int amp;
	/* Time a data frame and an ACK stay on air, in us. */
	uint32_t data_air_us;
	uint32_t ack_air_us;
	/* How long a sender listens for the ACK after its frame, in us. */
	uint32_t ack_timeout_us;
	/* Front end settling at each TX/RX switch, and whether it retunes the LO. */
	uint32_t turn_us;
	bool turn_retune;
	/* Carrier sense threshold above the measured noise floor, in dB. */
	int cca_db;
	/* Quiet sense slots before the backoff counts, contention window limits, retries. */
	uint8_t difs;
	uint16_t cw_min;
	uint16_t cw_max;
	uint8_t retries;
	uint8_t addr;
};

/* Counters since boot; the reporter diffs snapshots. */
struct mac_stats {
	/* Sender: new frames, transmissions (with retries), ACKed, given up. */
	uint32_t tx_frames;
	uint32_t tx_attempts;
	uint32_t tx_acked;
	uint32_t tx_dropped;
	uint64_t tx_bytes_acked;
	/* Sense slots found busy, backoff slots counted down. */
	uint32_t cca_busy;
	uint32_t backoff_slots;
	/* Receiver: energy triggers and what decoding them gave. */
	uint32_t rx_triggers;
	uint32_t rx_none;
	uint32_t rx_hdr_err;
	uint32_t rx_data_err;
	uint32_t rx_ok;
	uint32_t rx_dup;
	uint32_t rx_lost;
	uint32_t rx_other;
	uint64_t rx_bytes;
	/* Uptime of the last new data frame, in ms. */
	int64_t rx_last_ms;
	uint32_t acks_sent;
	uint32_t acks_rx;
	/* Sums for averages over decoded frames: MER (centi dB), corrected bytes. */
	int64_t mer_cdb_sum;
	int64_t cfo_hz_sum;
	uint32_t mer_n;
	uint32_t corrected;
	/* Timing in us: decode, front end to TX and back, sense slot. */
	uint64_t decode_us_sum;
	uint32_t decode_n;
	uint32_t decode_us_max;
	uint64_t tx_on_us_sum;
	uint64_t tx_off_us_sum;
	uint32_t tx_switches;
	uint64_t sense_us_sum;
	uint32_t sense_n;
	/* Pair decoding: first frame (this CPU), second (other CPU), both done. */
	uint64_t pair_a_us_sum, pair_b_us_sum, pair_us_sum;
	uint32_t pair_n;
	/* Frame builds (background and retries). */
	uint64_t build_us_sum;
	uint32_t build_n;
	/* Decoder stages (qam_rx_info.prof), summed in us. */
	uint64_t prof_us[6];
	/* Capture engine time of the last sense slot and full window, in us. */
	uint32_t sense_engine_us;
	uint32_t window_engine_us;
};

int link_mac_init(void);

/* Current configuration; link_mac_set_cfg() applies a changed copy while idle. */
void link_mac_get_cfg(struct mac_cfg *cfg);
int link_mac_set_cfg(const struct mac_cfg *cfg);

/* Noise floor in raw units squared (re-measured with link_mac_calibrate()). */
float link_mac_noise_floor(void);
int link_mac_calibrate(void);

/*
 * Send test frames (@p ncw units of @p fec, 0: full frames) to @p dst, @p window
 * of them per transmission (1, or 2 as a pair the receiver decodes on both
 * CPUs), until @p duration_ms passes (0: until stopped),
 * at most @p rate_kbps of user data (0: as fast as the MAC goes).
 *
 * With @p stream_us (OFDM only) the frames are a blind stream: one after the other from
 * both banks without leaving TX, each looped for @p stream_us, no carrier sense, no ACK
 * (the receiver takes what it catches; use a broadcast @p dst). Counted as ACKed when sent;
 * a frame whose successor was not built in time stays on air longer and counts as dropped.
 *
 * @p fec is an enum qam_fec on the QAM PHY, an OFDM code id (ofdm_fec_parse()) on OFDM.
 */
int link_mac_client_start(uint8_t dst, enum qam_mod mod, unsigned int fec, unsigned int ncw,
			  unsigned int window, uint32_t duration_ms, uint32_t rate_kbps,
			  uint32_t stream_us);
void link_mac_client_stop(void);
bool link_mac_client_active(void);
/* When the client last finished (its last frame done), in ms of uptime. */
int64_t link_mac_client_end_ms(void);

void link_mac_get_stats(struct mac_stats *st);
void link_mac_clear_stats(void);

/*
 * Build a frame at @p mod and decode it from memory (MAC paused), no radio:
 * the decoder's own time.
 */
int link_mac_bench_decode(enum qam_mod mod, struct qam_rx_info *info, uint32_t *build_us,
			  uint32_t *decode_us);

/* Park the MAC thread (radio idle) for measurements. */
void link_mac_pause(bool pause);

/* Split the OFDM preamble search over both CPUs (default on with two). */
void link_mac_scan_split(bool on);
bool link_mac_scan_split_get(void);

/*
 * Run @p fn(@p arg) on the paused MAC thread (link_mac_pause()) and wait for
 * it: the decoders need about 3.5 KB of stack, more than the shell has.
 *
 * @return 0; -ENODEV if the MAC thread does not run (the radio failed to
 * start); -ETIMEDOUT if it did not take the job within 10 s.
 */
int link_mac_run_paused(void (*fn)(void *arg), void *arg);

/*
 * Hand out the next capture that crossed the carrier sense threshold (with
 * @p decoded: that held a data frame that decoded) within @p timeout: the MAC thread then holds the bank until link_mac_dump_release().
 */
int link_mac_dump_take(const uint32_t **words, size_t *n, bool decoded, k_timeout_t timeout);
void link_mac_dump_release(void);

/* User bytes per data frame at @p mod with the current PHY settings, 0 if none fit. */
size_t link_mac_frame_bytes(enum qam_mod mod);
/* The same under @p fec (an enum qam_fec, or an OFDM code id on OFDM). */
size_t link_mac_frame_bytes_fec(enum qam_mod mod, unsigned int fec);

struct ofdm_ctx;

/* The OFDM context the MAC and the "ofdm" shell test share, set up (ofdm_test.c). */
struct ofdm_ctx *link_ofdm(void);

/* Its transmit and receive rates. */
enum esp_sdr_rate link_ofdm_tx_rate(void);
enum esp_sdr_rate link_ofdm_rx_rate(void);

#endif /* LINK_MAC_H_ */
```

## src/ofdm.h
```c
/*
 * SPDX-License-Identifier: GPL-3.0-or-later
 *
 * OFDM physical layer on raw radio words. Configured by occupied bandwidth,
 * subcarrier count and cyclic prefix; the FFT size follows (the power of two
 * that puts that many subcarriers into that bandwidth at the sample rate).
 * Complex baseband: the subcarriers sit on both sides of DC, DC unused. The
 * modulation (BPSK to 64-QAM) is chosen per frame.
 *
 * A frame is a Schmidl-Cox preamble (known BPSK on the even subcarriers, so
 * its time halves repeat), one or more pilot symbols (known BPSK on all, for
 * the channel estimate), optional header symbols (BPSK, the header bits
 * repeated over all their subcarriers) and the payload symbols, each with a
 * cyclic prefix. The frame is built to loop in the DAC like the QAM frames;
 * the receiver decodes one whole copy from a capture window at least twice
 * the frame long.
 *
 * Carrier offset correction covers +-1 subcarrier spacing.
 */

#ifndef ESDR_LINK_OFDM_H
#define ESDR_LINK_OFDM_H

#include <stdbool.h>
#include <stddef.h>
#include <stdint.h>

/* Receive and transmit words: esp_sdr_rx_i/q(), esp_sdr_tx_word(). */
#include <esp_sdr/esp_sdr.h>

#define OFDM_NFFT_MIN 16U
/* 256 covers every layout in use (26 MHz at 80 MS/s); 512 would cost 8 KB of internal RAM. */
#define OFDM_NFFT_MAX 256U
/* Shortest cyclic prefix as a fraction of the FFT size (cp_div at most this). */
#define OFDM_CP_DIV_MAX 32U
/* Subcarriers in use at most: a quarter of the band stays free around Nyquist. */
#define OFDM_CH_MAX (OFDM_NFFT_MAX * 3U / 4U)
/* Power of two above the longest cyclic prefix (nfft / 4). */
#define OFDM_RING 256U
#define OFDM_PILOTS_MAX 4U
#define OFDM_HDR_BITS_MAX 64U

enum ofdm_mod {
	OFDM_BPSK,
	OFDM_QPSK,
	OFDM_16QAM,
	OFDM_64QAM,
	OFDM_MODS
};

struct ofdm_cfg {
	/* Radio sample rate, Hz. */
	uint32_t sample_rate_hz;
	/* Occupied bandwidth, Hz: rounded so that spacing = sample_rate / nfft. */
	uint32_t bandwidth_hz;
	/* Subcarriers in use (pilot and data), DC excluded. */
	unsigned int channels;
	/* Cyclic prefix: nfft / cp_div samples (4 to OFDM_CP_DIV_MAX). */
	unsigned int cp_div;
	/* Transmit RMS amplitude, DAC units (full scale 511). */
	int amp;
	/* Symbols after the pilots (header and payload), 0: as many as fit max_samples. */
	unsigned int symbols;
	/* Longest frame in samples. */
	size_t max_samples;
	/* The receiver samples at sample_rate_hz / rx_div (1 or 2): half the work at 2. */
	unsigned int rx_div;
	/* Pilot symbols (1 to OFDM_PILOTS_MAX), averaged for the channel estimate. */
	unsigned int pilots;
	/* Also smooth the estimate over neighbouring subcarriers (3 taps). */
	bool smooth;
	/* Header bits per frame (0 to OFDM_HDR_BITS_MAX), on BPSK symbols before the payload. */
	unsigned int hdr_bits;
	/*
	 * Another pilot symbol in the middle of the payload: the phase is
	 * measured again there, so the second half can be decoded on its own
	 * (on another CPU) and a long frame does not drift.
	 */
	bool mid_pilot;
};

struct ofdm_cf {
	float re, im;
};

/*
 * One receiver working through symbols: its FFT buffer, the tracked common
 * phase and its rate per slot (a residual carrier offset), and the known
 * phase of its current window (u). Two of them decode one frame on two CPUs.
 */
struct ofdm_worker {
	struct ofdm_cf buf[OFDM_NFFT_MAX] __attribute__((aligned(16)));
	struct ofdm_cf trk, rate, u;
	/* The slot in the buffer was read one period earlier: u includes rx.cw. */
	bool wrapped;
	/* The slot in the buffer, and when it was captured in slots from the frame start (one
	 * period earlier if wrapped).
	 */
	unsigned int slot;
	float tslot;
	/*
	 * The vector decoder's equalizer turned against the sample clock's drift (see
	 * rx.dslot), rebuilt when the drift has moved: for which frame, equalizer and phase.
	 */
	int16_t e16[OFDM_CH_MAX][2] __attribute__((aligned(16)));
	const void *e16_src;
	uint32_t e16_gen;
	float e16_th;
	/* The buffer holds the 16-bit FFT's output (payload symbols), else the float FFT's. */
	bool q16;
};

/* Receive state between ofdm_rx_begin() and ofdm_rx_finish(). */
struct ofdm_rxstate {
	int start, dci, dcq;
	/* The window (receive words) and the frame's period in it: a slot past the end is read one period earlier. */
	int n, per;
	/* The carrier's turn over one period, from the window's overlap with itself: a slot read
	 * one period earlier is turned back by this.
	 */
	struct ofdm_cf cw;
	/*
	 * Sample clock drift: subcarrier k of slot s is turned back by exp(j k dslot (s - sref)),
	 * the window's growing timing error against the pilots' (both crystals drive their
	 * chip's carrier and sample clock, so the drift follows the carrier offset).
	 */
	float dslot, sref;
	uint32_t gen;
	float eps;
	/* Step of the window phase per slot. */
	struct ofdm_cf us;
	/* How early the FFT window starts, from the pilots' phase slope (samples). */
	float delay;
	/* First payload slot. */
	unsigned int slot;
	float soft[OFDM_HDR_BITS_MAX];
};

struct ofdm_ctx {
	/* FFT twiddles (esp-dsp radix-2 layout: cos, sin, bit reversed; serves every size up
	 * to nfft).
	 */
	float w[OFDM_NFFT_MAX] __attribute__((aligned(16)));
	/* The same table in Q15 for the 16-bit receive FFT, and the factor back to the float FFT. */
	int16_t w16[OFDM_NFFT_MAX] __attribute__((aligned(16)));
	float fscale;
	/* The receiver's own worker (search, channel, header, payload). */
	struct ofdm_worker w0;
	struct ofdm_cfg cfg;
	/* Derived by ofdm_init(): transmit layout at sample_rate_hz; the payload symbol the
	 * mid pilot comes before (ndata if none).
	 */
	unsigned int nfft, log2n, cp, nhdr, ndata, mid;
	size_t slot, len;
	float spacing_hz, bw_hz;
	/* The same frame at the receive rate. */
	unsigned int rnfft, rcp;
	size_t rslot, rlen;
	/* Bit reversal over nfft; per subcarrier (frequency order) its transmit FFT bin and
	 * where it comes out of the (bit reversed) receive FFT.
	 */
	uint16_t rev[OFDM_NFFT_MAX];
	uint16_t bin[OFDM_CH_MAX], binr[OFDM_CH_MAX];
	/* Equalizer per subcarrier, conj(H) / |H|^2, from the last pilots. */
	struct ofdm_cf eq[OFDM_CH_MAX];
	union {
		/* Search: the last preamble metrics (numerator, denominator) over the prefix. */
		struct {
			float rnum[OFDM_RING], rden[OFDM_RING];
		};
		/* Then the carrier offset derotation over one receive FFT window. */
		struct ofdm_cf rot[OFDM_NFFT_MAX];
	};
	/* The same in Q15 for the vector derotation of the payload symbols. */
	int16_t rot16[OFDM_NFFT_MAX][2] __attribute__((aligned(16)));
	struct ofdm_rxstate rx;
	/* Diagnostic: when set, the payload decoder adds each subcarrier's squared error here. */
	float *sc_err;
	/*
	 * The equalizer for the vector payload decoder, per modulation (16-QAM, 64-QAM): conj(H)
	 * times the receive FFT's scale times the factor that makes the constellation spacing
	 * 256, in 16 bit times 2^sar (sar 0: does not fit, the float decoder is used).
	 */
	struct ofdm_veq {
		int16_t e[OFDM_CH_MAX][2] __attribute__((aligned(16)));
		int16_t sar;
	} veq[2];
};

/* A transmit work buffer (ofdm_tx_build()), separate so that building and decoding can overlap. */
struct ofdm_txbuf {
	struct ofdm_cf buf[OFDM_NFFT_MAX] __attribute__((aligned(16)));
	/* Samples clipped by the last build. */
	uint32_t clipped;
	/* ofdm_frame_build()'s stages in ofdm_clock() cycles: the coding (CRC, FEC), the symbols. */
	uint32_t prof[2];
};

/*
 * Derive the frame layout from @p cfg.
 *
 * @retval 0 on success.
 * @retval -1 if no FFT size fits (bandwidth, channel count, cp_div, frame length).
 */
int ofdm_init(struct ofdm_ctx *ctx, const struct ofdm_cfg *cfg);

static inline unsigned int ofdm_mod_bits(enum ofdm_mod mod)
{
	static const uint8_t bits[OFDM_MODS] = {1, 2, 4, 6};

	return mod < OFDM_MODS ? bits[mod] : 0U;
}

/* Payload bits per frame at @p mod. */
static inline size_t ofdm_frame_bits(const struct ofdm_ctx *ctx, enum ofdm_mod mod)
{
	return (size_t)ctx->ndata * ctx->cfg.channels * ofdm_mod_bits(mod);
}

/* Length of a header-only frame (preamble, pilots, header), at the transmit and receive rate. */
static inline size_t ofdm_hdr_samples(const struct ofdm_ctx *ctx)
{
	return (size_t)(1U + ctx->cfg.pilots + ctx->nhdr) * ctx->slot;
}

static inline size_t ofdm_hdr_rsamples(const struct ofdm_ctx *ctx)
{
	return (size_t)(1U + ctx->cfg.pilots + ctx->nhdr) * ctx->rslot;
}

/*
 * Receive words that hold a looping frame of @p period receive samples whole: the frame
 * loops without a gap, so one period anywhere holds every sample once (rotated); one FFT, a
 * prefix and the coarse search's step more let the search see a start and every slot lie
 * whole in the window or one period earlier.
 */
#define OFDM_RX_WRAP_MARGIN(nfft, cp) ((nfft) + (cp) + 16U)
static inline size_t ofdm_rx_window(const struct ofdm_ctx *ctx, size_t period)
{
	return period + OFDM_RX_WRAP_MARGIN(ctx->rnfft, ctx->rcp);
}

/* Test payload: whitened bits, a function of @p seed (packed, MSB first). */
void ofdm_test_bits(uint8_t *bits, size_t nbits, uint32_t seed);

/*
 * Build one frame into @p out (ctx->len words): cfg.hdr_bits header bits from
 * @p hdr, ofdm_frame_bits(mod) payload bits from @p bits (packed, MSB first).
 * With @p bits NULL a header-only frame (ofdm_hdr_samples() words). Only
 * reads @p ctx.
 *
 * @return Its length in samples, 0 for a bad modulation.
 */
size_t ofdm_tx_build(const struct ofdm_ctx *ctx, struct ofdm_txbuf *tb, enum ofdm_mod mod,
		     const uint8_t *hdr, const uint8_t *bits, uint32_t *out);

/*
 * Frames built with @p tb (one work buffer, in internal RAM) take help from other CPUs: a
 * thread there that calls ofdm_tx_help() builds symbols of the frame while it is being built.
 * The 16-bit transmit path (CONFIG_APP_OFDM_ESP_DSP) only.
 */
void ofdm_tx_share(struct ofdm_txbuf *tb);

/*
 * Wait for the next shared build (ofdm_tx_share()) and build its symbols with it, in @p tb's
 * buffer (the caller's own, internal RAM), until none are left: returns then, or once
 * @p keep_going(@p arg) is false (asked before each symbol, about 30 us apart; it may spin
 * until then).
 */
void ofdm_tx_help(struct ofdm_txbuf *tb, bool (*keep_going)(void *), void *arg);

struct ofdm_rx_info {
	/* Frame start in the window, sample index. */
	int start;
	/* Preamble metric of that start (normalized correlation, squared). */
	float metric;
	/* Carrier offset: in subcarrier spacings, and in Hz. */
	float cfo_frac, cfo_hz;
	/* Error of the payload symbols against their decisions, dB. */
	float mer_db;
	/* Cycles (ofdm_clock): search, channel estimate and header, payload. */
	uint32_t prof[3];
};

/* The vector payload decoder (16-QAM and 64-QAM with the 16-bit FFT); false: the float one. */
extern bool ofdm_vec_enable;
/* The payload derotation on the vector unit (ESP32-S3, 16-bit FFT path). */
extern bool ofdm_vec_derot;
/* Carrier frequency (for the sample clock drift) and the drift correction's sign (0: off). */
extern float ofdm_carrier_hz;
extern int ofdm_sfo;

/* The best metric of a preamble scan (see ofdm_sc_scan()). */
struct ofdm_sc_best {
	float num, den;
	int32_t pr, pi;
	int t, start;
};

/*
 * Schmidl-Cox scan over t = t0, t0 + st, .. t1 (the coarse scan of the preamble search, st > 1).
 * The search splits it in two when ofdm_scan_async is set: that starts the scan of
 * [t0, t1] on another CPU (it calls ofdm_sc_scan() there) and ofdm_scan_wait() returns once it
 * is done. Both stay NULL when there is no second CPU to use.
 */
void ofdm_sc_scan(struct ofdm_ctx *ctx, const uint32_t *w, int t0, int t1, int st, int dci,
		  int dcq, struct ofdm_sc_best *b);
extern void (*ofdm_scan_async)(struct ofdm_ctx *ctx, const uint32_t *w, int t0, int t1, int st,
				int dci, int dcq, struct ofdm_sc_best *b);
extern void (*ofdm_scan_wait)(void);

/* Optional cycle counter for ofdm_rx_info.prof. */
extern uint32_t (*ofdm_clock)(void);

/*
 * Find a whole frame copy in @p n receive words (at the receive rate), set up
 * the channel and decode the header into @p hdr (cfg.hdr_bits bits). The frame
 * loops: n >= ofdm_rx_window(ctx, ctx->rlen) holds it (read around the period).
 *
 * @retval 0 on success.
 * @retval -1 if no preamble was found.
 */
int ofdm_rx_begin(struct ofdm_ctx *ctx, const uint32_t *words, size_t n, uint8_t *hdr,
		  struct ofdm_rx_info *info);

/* The same for a frame looping with @p period receive samples (header-only: ofdm_hdr_rsamples()). */
int ofdm_rx_begin_period(struct ofdm_ctx *ctx, const uint32_t *words, size_t n, size_t period,
			 uint8_t *hdr, struct ofdm_rx_info *info);

/* Then the ofdm_frame_bits(mod) payload bits into @p bits, from the same words. */
void ofdm_rx_finish(struct ofdm_ctx *ctx, const uint32_t *words, enum ofdm_mod mod, uint8_t *bits,
		    struct ofdm_rx_info *info);

/*
 * The payload in two parts, e.g. on two CPUs: ctx->w0 decodes payload
 * symbols 0 .. mid - 1, a second worker set up by ofdm_rx_fork() (which
 * measures the phase on the mid pilot) symbols mid .. ndata - 1.
 * ofdm_rx_part() decodes s0 .. s1 - 1 into @p bits (the frame's bits from
 * symbol s0 on; mid starts a byte) and adds their squared error to @p err.
 * Only the workers are written.
 */
void ofdm_rx_fork(const struct ofdm_ctx *ctx, struct ofdm_worker *wk, const uint32_t *words);
void ofdm_rx_part(const struct ofdm_ctx *ctx, struct ofdm_worker *wk, const uint32_t *words,
		  enum ofdm_mod mod, unsigned int s0, unsigned int s1, uint8_t *bits, float *err);

/* MER of a payload from its squared error. */
float ofdm_rx_mer(const struct ofdm_ctx *ctx, float err);

/* Forward FFT of the receive buffer in place (output bit reversed, see ctx->rev); for tests. */
void ofdm_test_fft(struct ofdm_ctx *ctx);

#endif
```

## src/ofdm_frame.c
```c
/*
 * SPDX-License-Identifier: GPL-3.0-or-later
 *
 * Link frames on the OFDM PHY, see ofdm_frame.h. The payload capacity (whole
 * bytes of the payload symbols) is split into the fewest units (RS) or blocks
 * (BCH) the code allows, all the same length: shortened codes. RS: the missing
 * data bytes are virtual zeros in front, frame byte j belongs to unit
 * j % units. BCH: block u is bytes u len .. (u + 1) len - 1, its data bytes
 * first; the user data and its CRC-32 run through the blocks' data bytes in
 * order.
 */

#include <string.h>

#include "ofdm_frame.h"
#include "qam.h"
#include "rs.h"

#define HDR_VERSION 0xa5U

/* The codes by id: BCH parameters (m 0: not a BCH code). */
static const struct {
	uint8_t m, t;
	char name[9];
} fec_tab[OFDM_FECS] = {
	[OFDM_FEC_RS] = {0, 0, "rs"},       [OFDM_FEC_NONE] = {0, 0, "none"},
	{9, 1, "bch1-64"},   {9, 2, "bch2-64"},   {9, 3, "bch3-64"},   {9, 4, "bch4-64"},
	{10, 1, "bch1-128"}, {10, 2, "bch2-128"}, {10, 3, "bch3-128"}, {10, 4, "bch4-128"},
	{11, 1, "bch1-256"}, {11, 2, "bch2-256"}, {11, 3, "bch3-256"}, {11, 4, "bch4-256"},
	{6, 1, "bch1-8"},
};

const char *ofdm_fec_name(unsigned int fec)
{
	return fec < OFDM_FECS ? fec_tab[fec].name : NULL;
}

int ofdm_fec_parse(const char *name)
{
	for (unsigned int f = 0; f < OFDM_FECS; f++) {
		if (strcmp(name, fec_tab[f].name) == 0) {
			return (int)f;
		}
	}
	return -1;
}

struct layout {
	unsigned int fec, units, len, k;
	size_t cap, user;
};

static bool layout_of(const struct ofdm_ctx *ctx, enum ofdm_mod mod, unsigned int fec,
		      struct layout *l)
{
	unsigned int nmax, parity;

	if (mod >= OFDM_MODS || fec >= OFDM_FECS) {
		return false;
	}
	l->fec = fec;
	l->cap = ofdm_frame_bits(ctx, mod) / 8U;
	/* The work buffer holds the payload bits rounded up to bytes. */
	if (l->cap >= OFDM_FRAME_CAP_MAX) {
		return false;
	}
	if (fec == OFDM_FEC_RS) {
		nmax = RS_N;
		parity = RS_NROOTS;
	} else if (fec == OFDM_FEC_NONE) {
		nmax = (unsigned int)l->cap;
		parity = 0;
	} else {
		unsigned int r, kmax;

		if (!bch_params(fec_tab[fec].m, fec_tab[fec].t, &r, &parity, &kmax)) {
			return false;
		}
		nmax = kmax + parity;
	}
	if (nmax == 0U) {
		return false;
	}
	/* The fewest units, all shortened alike so that they fill the frame. */
	l->units = (unsigned int)((l->cap + nmax - 1U) / nmax);
	if (l->units == 0U) {
		return false;
	}
	l->len = (unsigned int)(l->cap / l->units);
	/* A BCH code may do better with whole blocks and a few bytes unused (short blocks). */
	if (fec != OFDM_FEC_RS && fec != OFDM_FEC_NONE && l->cap / nmax > 0U &&
	    (l->cap / nmax) * (nmax - parity) > l->units * (l->len - parity)) {
		l->units = (unsigned int)(l->cap / nmax);
		l->len = nmax;
	}
	/* A unit needs its parity and some data (RS: 8 bytes); the user data its CRC. */
	if (l->len < parity + (fec == OFDM_FEC_RS ? 8U : 1U) ||
	    (size_t)l->units * (l->len - parity) < 5U) {
		return false;
	}
	l->k = l->len - parity;
	l->user = (size_t)l->units * l->k - 4U;
	return true;
}

size_t ofdm_frame_user_bytes(const struct ofdm_ctx *ctx, enum ofdm_mod mod, unsigned int fec)
{
	struct layout l;

	return layout_of(ctx, mod, fec, &l) ? l.user : 0U;
}

/* The work memory's BCH code set up for @p fec. */
static const struct bch_code *code_for(struct ofdm_fwork *wk, unsigned int fec)
{
	uint32_t key = 0xbc000000U | ((uint32_t)fec_tab[fec].m << 8) | fec_tab[fec].t;

	if (wk->bch_key != key) {
		if (bch_init(&wk->bch, fec_tab[fec].m, fec_tab[fec].t) != 0) {
			return NULL;
		}
		wk->bch_key = key;
	}
	return &wk->bch;
}

/* The user data and its CRC-32 (little endian) into the blocks' data bytes. */
static void blocks_put(const struct layout *l, uint8_t *bytes, const uint8_t *data, uint32_t crc)
{
	const uint8_t tail[4] = {(uint8_t)crc, (uint8_t)(crc >> 8), (uint8_t)(crc >> 16),
				 (uint8_t)(crc >> 24)};
	size_t d = 0;

	for (unsigned int u = 0; u < l->units; u++, d += l->k) {
		uint8_t *dst = &bytes[(size_t)u * l->len];
		size_t nu = d < l->user ? l->user - d : 0U;

		nu = nu > l->k ? l->k : nu;
		memcpy(dst, &data[d], nu);
		for (size_t i = nu; i < l->k; i++) {
			dst[i] = tail[d + i - l->user];
		}
	}
}

/* The user data out of the blocks and its CRC-32 checked: 0, or -3 on a mismatch. */
static int blocks_get(const struct layout *l, const uint8_t *bytes, uint8_t *data)
{
	uint8_t tail[4];
	uint32_t crc = 0;
	size_t d = 0;

	for (unsigned int u = 0; u < l->units; u++, d += l->k) {
		const uint8_t *src = &bytes[(size_t)u * l->len];
		size_t nu = d < l->user ? l->user - d : 0U;

		nu = nu > l->k ? l->k : nu;
		memcpy(&data[d], src, nu);
		crc = qam_crc32_cont(crc, src, nu);
		for (size_t i = nu; i < l->k; i++) {
			tail[d + i - l->user] = src[i];
		}
	}
	return crc == ((uint32_t)tail[0] | ((uint32_t)tail[1] << 8) | ((uint32_t)tail[2] << 16) |
		       ((uint32_t)tail[3] << 24))
		       ? 0
		       : -3;
}

static void hdr_pack(const struct ofdm_fhdr *h, uint8_t b[8])
{
	uint16_t crc;

	b[0] = (uint8_t)(((h->type & 1U) << 7) | ((unsigned int)h->mod << 4) | (h->fec & 0x0fU));
	b[1] = h->dst;
	b[2] = h->src;
	b[3] = (uint8_t)h->seq;
	b[4] = (uint8_t)(h->seq >> 8);
	b[5] = HDR_VERSION;
	crc = qam_crc16(b, 6);
	b[6] = (uint8_t)crc;
	b[7] = (uint8_t)(crc >> 8);
}

static bool hdr_unpack(const uint8_t b[8], struct ofdm_fhdr *h)
{
	if (b[5] != HDR_VERSION || qam_crc16(b, 6) != (uint16_t)(b[6] | (b[7] << 8)) ||
	    (b[0] & 0x0fU) >= OFDM_FECS || ((b[0] >> 4) & 7U) >= OFDM_MODS) {
		return false;
	}
	h->type = b[0] >> 7;
	h->mod = (enum ofdm_mod)((b[0] >> 4) & 7U);
	h->fec = b[0] & 0x0fU;
	h->dst = b[1];
	h->src = b[2];
	h->seq = (uint16_t)(b[3] | (b[4] << 8));
	return true;
}

/* Unit u's byte p as sent (data, then parity), inside its 255 byte buffer. */
static inline uint8_t *unit_byte(struct ofdm_fwork *wk, const struct layout *l, unsigned int u,
				 unsigned int p)
{
	return &wk->units[u][RS_N - l->len + p];
}

size_t ofdm_frame_build(const struct ofdm_ctx *ctx, struct ofdm_txbuf *tb, struct ofdm_fwork *wk,
			const struct ofdm_fhdr *h, const uint8_t *data, uint32_t *out)
{
	struct layout l;
	uint8_t hb[8];
	uint32_t crc;
	size_t j;

	if (!layout_of(ctx, h->mod, h->fec, &l)) {
		return 0;
	}
	crc = qam_crc32(data, l.user);
	if (h->fec != OFDM_FEC_RS) {
		/* Blocks in place, each followed by its parity. */
		const struct bch_code *c = h->fec == OFDM_FEC_NONE ? NULL : code_for(wk, h->fec);

		if (h->fec != OFDM_FEC_NONE && c == NULL) {
			return 0;
		}
		blocks_put(&l, wk->bytes, data, crc);
		for (unsigned int u = 0; c != NULL && u < l.units; u++) {
			uint8_t *blk = &wk->bytes[(size_t)u * l.len];

			bch_encode(c, blk, l.k, &blk[l.k]);
		}
		j = (size_t)l.units * l.len;
		memset(&wk->bytes[j], 0, l.cap - j + 1U);
		hdr_pack(h, hb);
		return ofdm_tx_build(ctx, tb, h->mod, hb, wk->bytes, out);
	}
	/* User data, then its CRC (little endian), over the units' data bytes. */
	for (unsigned int u = 0; u < l.units; u++) {
		memset(wk->units[u], 0, RS_N);
	}
	/* Unit by unit (a division per byte is 15 cycles or more with a divisor that varies). */
	for (unsigned int u = 0, d = 0; u < l.units && d < l.user + 4U; u++) {
		uint8_t *dst = unit_byte(wk, &l, u, 0);

		for (unsigned int pos = 0; pos < l.k && d < l.user + 4U; pos++, d++) {
			dst[pos] = d < l.user ? data[d] : (uint8_t)(crc >> (8U * (d - l.user)));
		}
	}
	for (unsigned int u = 0; u < l.units; u++) {
		rs_encode(wk->units[u]);
	}
	/* Interleaved: byte p of every unit, then byte p + 1. */
	for (unsigned int pos = 0; pos < l.len; pos++) {
		uint8_t *out_p = &wk->bytes[(size_t)pos * l.units];

		for (unsigned int u = 0; u < l.units; u++) {
			out_p[u] = *unit_byte(wk, &l, u, pos);
		}
	}
	j = (size_t)l.units * l.len;
	memset(&wk->bytes[j], 0, l.cap - j + 1U);
	hdr_pack(h, hb);
	return ofdm_tx_build(ctx, tb, h->mod, hb, wk->bytes, out);
}

size_t ofdm_frame_build_hdr(const struct ofdm_ctx *ctx, struct ofdm_txbuf *tb,
			    const struct ofdm_fhdr *h, uint32_t *out)
{
	uint8_t hb[8];

	hdr_pack(h, hb);
	return ofdm_tx_build(ctx, tb, OFDM_BPSK, hb, NULL, out);
}

int ofdm_frame_begin_hdr(struct ofdm_ctx *ctx, const uint32_t *words, size_t n,
			 struct ofdm_fhdr *h, struct ofdm_rx_info *info)
{
	uint8_t hb[8];

	if (ofdm_rx_begin_period(ctx, words, n, ofdm_hdr_rsamples(ctx), hb, info) != 0) {
		return -1;
	}
	return hdr_unpack(hb, h) ? 0 : -2;
}

int ofdm_frame_begin(struct ofdm_ctx *ctx, const uint32_t *words, size_t n, struct ofdm_fhdr *h,
		     struct ofdm_rx_info *info)
{
	uint8_t hb[8];

	if (ofdm_rx_begin(ctx, words, n, hb, info) != 0) {
		return -1;
	}
	return hdr_unpack(hb, h) ? 0 : -2;
}

int ofdm_frame_finish(struct ofdm_ctx *ctx, const uint32_t *words, const struct ofdm_fhdr *h,
		      struct ofdm_fwork *wk, uint8_t *data, int *corrected,
		      struct ofdm_rx_info *info)
{
	struct layout l;

	if (!layout_of(ctx, h->mod, h->fec, &l)) {
		*corrected = 0;
		return -3;
	}
	ofdm_rx_finish(ctx, words, h->mod, wk->bytes, info);
	return ofdm_frame_fec(ctx, h, wk, data, corrected);
}

int ofdm_frame_fec_units(const struct ofdm_ctx *ctx, const struct ofdm_fhdr *h,
			 struct ofdm_fwork *wk, unsigned int u0, unsigned int u1, int *corrected)
{
	struct layout l;

	*corrected = 0;
	if (h->fec != OFDM_FEC_RS || !layout_of(ctx, h->mod, h->fec, &l)) {
		return -3;
	}
	u1 = u1 > l.units ? l.units : u1;
	for (unsigned int u = u0; u < u1; u++) {
		/* Decoded on the stack: the work memory may be PSRAM. */
		uint8_t cw[RS_N];
		int r;

		memset(cw, 0, RS_N - l.len);
		for (unsigned int p = 0; p < l.len; p++) {
			cw[RS_N - l.len + p] = wk->bytes[(size_t)p * l.units + u];
		}
		r = rs_decode(cw);
		if (r < 0) {
			return -3;
		}
		/* A miscorrection may land in the virtual zeros. */
		for (unsigned int i = 0; i < RS_N - l.len; i++) {
			if (cw[i] != 0U) {
				return -3;
			}
		}
		memcpy(wk->units[u], cw, RS_N);
		*corrected += r;
	}
	return 0;
}

unsigned int ofdm_frame_units(const struct ofdm_ctx *ctx, enum ofdm_mod mod)
{
	struct layout l;

	return layout_of(ctx, mod, OFDM_FEC_RS, &l) ? l.units : 0U;
}

int ofdm_frame_check(const struct ofdm_ctx *ctx, const struct ofdm_fhdr *h, struct ofdm_fwork *wk,
		     uint8_t *data)
{
	struct layout l;
	uint32_t crc = 0;

	if (!layout_of(ctx, h->mod, h->fec, &l)) {
		return -3;
	}
	if (h->fec != OFDM_FEC_RS) {
		return blocks_get(&l, wk->bytes, data);
	}
	for (unsigned int u = 0, d = 0; u < l.units && d < l.user + 4U; u++) {
		const uint8_t *src = unit_byte(wk, &l, u, 0);

		for (unsigned int pos = 0; pos < l.k && d < l.user + 4U; pos++, d++) {
			if (d < l.user) {
				data[d] = src[pos];
			} else {
				crc |= (uint32_t)src[pos] << (8U * (d - l.user));
			}
		}
	}
	return qam_crc32(data, l.user) == crc ? 0 : -3;
}

int ofdm_frame_fec(const struct ofdm_ctx *ctx, const struct ofdm_fhdr *h, struct ofdm_fwork *wk,
		   uint8_t *data, int *corrected)
{
	const struct bch_code *c;
	struct layout l;
	int ret;

	if (h->fec == OFDM_FEC_RS) {
		ret = ofdm_frame_fec_units(ctx, h, wk, 0, ~0U, corrected);
		return ret != 0 ? ret : ofdm_frame_check(ctx, h, wk, data);
	}
	*corrected = 0;
	if (!layout_of(ctx, h->mod, h->fec, &l)) {
		return -3;
	}
	/* The CRC first: a clean frame (the usual one at a low error rate) needs no decoding. */
	if (blocks_get(&l, wk->bytes, data) == 0) {
		return 0;
	}
	c = h->fec == OFDM_FEC_NONE ? NULL : code_for(wk, h->fec);
	if (c == NULL) {
		return -3;
	}
	for (unsigned int u = 0; u < l.units; u++) {
		uint8_t *blk = &wk->bytes[(size_t)u * l.len];
		int r = bch_decode(c, blk, l.k, &blk[l.k]);

		if (r < 0) {
			return -3;
		}
		*corrected += r;
	}
	/* Nothing to correct, yet the CRC failed: errors the blocks cannot see. */
	return *corrected > 0 ? blocks_get(&l, wk->bytes, data) : -3;
}
```
