## CMakeLists.txt
```
# SPDX-License-Identifier: GPL-3.0-or-later

cmake_minimum_required(VERSION 3.20.0)

find_package(Zephyr REQUIRED HINTS $ENV{ZEPHYR_BASE})
project(esp_sdr_mch2022_coproc)

target_include_directories(app PRIVATE src ../../include)
target_sources(app PRIVATE
  src/main.c
  src/bridge.c
  src/esp32_ctl.c
  src/fwlog.c
  src/i2c_regs.c
  src/periph.c
  src/pio_out.c
  src/qspi_select.c
  src/regmap.c
  src/reset_detect.c
  src/sysctl.c
  src/uart_dma.c
  src/usb_dev.c
  src/usb_vendor.c)
```

## Kconfig
```
# SPDX-License-Identifier: GPL-3.0-or-later

config APP_MCH2022_COPROC
	bool
	default y
	# The UARTs' receive rings: the hal's DMA, directly (Zephyr's driver has no ring mode).
	select PICOSDK_USE_DMA
	select PICOSDK_USE_CLAIM

config APP_COPROC_RESET_MODE
	int "How DTR and RTS reset the ESP32 at boot (enum coproc_reset_mode)"
	range 0 1
	default 0

source "Kconfig.zephyr"
```

## sample.yaml
```
sample:
  name: ESP-SDR MCH2022 coprocessor
  description: >-
    Firmware for the RP2040 of the MCH2022 badge: all the stock firmware does (USB to the ESP32
    and the FPGA, their reset lines, the I2C coprocessor), with the UARTs on DMA and a bulk
    interface for a faster link
common:
  tags: esp-sdr
  platform_allow:
    - mch2022_rp2040/rp2040
  integration_platforms:
    - mch2022_rp2040/rp2040
tests:
  esp_sdr.mch2022_coproc:
    build_only: true
```

## prj.conf
```kconfig
CONFIG_GPIO=y
CONFIG_I2C=y
CONFIG_I2C_TARGET=y
CONFIG_PWM=y
CONFIG_ADC=y
CONFIG_HWINFO=y
CONFIG_SERIAL=y
CONFIG_UART_USE_RUNTIME_CONFIGURE=y

CONFIG_USB_DEVICE_STACK_NEXT=y
CONFIG_USBD_HWINFO_DEVID_LENGTH=16
CONFIG_USBD_THREAD_STACK_SIZE=2048
CONFIG_UDC_BUF_POOL_SIZE=2048
# Two packets ready on bulk IN: one a time reaches some 600 kB/s.
CONFIG_UDC_RPI_PICO_DOUBLE_BUFFER_BULK_IN=y
CONFIG_UDC_BUF_COUNT=32

# No console: the firmware's log is read over USB (COPROC_REQ_GET_LOG, fwlog.c).
CONFIG_CONSOLE=n
CONFIG_UART_CONSOLE=n
CONFIG_PRINTK=y
CONFIG_LOG=y
CONFIG_LOG_MODE_MINIMAL=y
CONFIG_LOG_DEFAULT_LEVEL=2

CONFIG_SYSTEM_WORKQUEUE_STACK_SIZE=1536
CONFIG_MAIN_STACK_SIZE=1536
CONFIG_ISR_STACK_SIZE=1024

CONFIG_REBOOT=y
CONFIG_WATCHDOG=y
```

## src/main.c
```c
/*
 * SPDX-License-Identifier: GPL-3.0-or-later
 *
 * The RP2040 of the MCH2022 badge (boards/badgeteam/mch2022_rp2040): all the stock firmware does,
 * in its order: the ESP32 starts once its I2C target is up.
 */

#include <zephyr/kernel.h>
#include <zephyr/logging/log.h>

#include "coproc.h"

LOG_MODULE_REGISTER(coproc, LOG_LEVEL_INF);

struct coproc_stats coproc_stats __aligned(8);

#define CHECK(call)                                                                                \
	do {                                                                                       \
		int ret_ = (call);                                                                 \
		if (ret_ != 0) {                                                                   \
			LOG_ERR(#call ": %d", ret_);                                               \
		}                                                                                  \
	} while (false)

int main(void)
{
	LOG_INF("reset reason 0x%08x, ROSC 0x%08x%s", sysctl_reset_reason(), sysctl_rosc_status(),
		sysctl_crashed() ? ", after a crash" : "");
	CHECK(regs_init());
	CHECK(uart_dma_init());
	CHECK(esp32_ctl_init());
	CHECK(pio_out_init());
	CHECK(periph_init());
	CHECK(regs_start());
	esp32_reset(false);
	CHECK(bridge_start());
	CHECK(usb_dev_init());
	return 0;
}
```

## src/bridge.c
```c
/*
 * SPDX-License-Identifier: GPL-3.0-or-later
 *
 * Who each UART talks to. As in the stock firmware's uart_task.c the ESP32's UART goes to its CDC
 * ACM port or, once the host says so, to its WebUSB interface; the FPGA's likewise, or back to
 * itself for the ESP32's self test. New: the ESP32's UART to interface 6 (COPROC_REQ_LINK_OPEN).
 * Whoever owns a UART also sets its line.
 *
 * One thread moves all the data, woken by the USB functions' completions and the UARTs' DMA, and
 * every millisecond for what the UARTs bring.
 */

#include <errno.h>
#include <string.h>

#include <zephyr/device.h>
#include <zephyr/drivers/uart.h>
#include <zephyr/drivers/watchdog.h>
#include <zephyr/kernel.h>
#include <zephyr/logging/log.h>
#include <zephyr/sys/byteorder.h>
#include <zephyr/sys/util.h>

#include "coproc.h"

LOG_MODULE_REGISTER(bridge, LOG_LEVEL_INF);

#define BRIDGE_STACK 1536
#define BRIDGE_PRIO  5
/* A host that reads nothing for this long does not get what it missed on a CDC ACM port. */
#define STALE_MS     200
#define ERRORS_MS    100
/*
 * The bridge thread, the lowest of the firmware's, stops being served when anything hangs: then
 * the badge reboots, and the ESP32 with it, rather than need its power cut.
 */
#define WATCHDOG_MS  2000U
/* The most OUT buffers an interface has (usb_vendor.c). */
#define OUT_BUFFERS_MAX 8
#define LINE_WAIT_MS 10
/* The stock firmware's, for the ESP32's self test. */
#define LOOPBACK_BAUD 1000000U
/* What apps/osmosdr_serial runs at. */
#define LINK_BAUD     2000000U

enum route {
	ROUTE_CDC,
	ROUTE_WEBUSB,
	ROUTE_LINK,
	ROUTE_LOOPBACK,
};

static struct bridge_port {
	enum route route;
	/* The line each owner asked for. */
	struct uart_config cdc_line;
	uint32_t webusb_baud, link_baud;
	/* The line in force. */
	struct uart_config line;
	uint16_t webusb_status;
	/* A buffer from the host, whose it is, how far it went. */
	struct net_buf *out;
	struct vendor_if *out_owner;
	size_t out_off;
	/* The last sign of a host reading its CDC ACM port. */
	int64_t last_read_ms;
} ports[PORT_COUNT];

static K_SEM_DEFINE(wake, 0, 1);
static bool usb_up;
static bool link_open;
static bool loopback;
/* The FPGA's fast line runs; its ready line is up. */
static bool fast_on, fast_ready;
/* Which ring goes out on interface 6 next, whether it stopped between two frames, since when. */
static int merge_port = PORT_ESP32;
static bool merge_between = true;
static int64_t merge_idle_ms;
static uint8_t test_mode;
static uint32_t test_count;

void bridge_wake(void)
{
	k_sem_give(&wake);
}

static enum route route_of(int port)
{
	struct bridge_port *p = &ports[port];

	if (port == PORT_ESP32 && link_open) {
		return ROUTE_LINK;
	}
	if (port == PORT_FPGA && loopback) {
		return ROUTE_LOOPBACK;
	}
	return (p->webusb_status & 1U) != 0U ? ROUTE_WEBUSB : ROUTE_CDC;
}

bool bridge_cdc_owns_esp32(void)
{
	return route_of(PORT_ESP32) == ROUTE_CDC;
}

/* The line the UART's owner wants; 8N1 for all but the CDC ACM port's. */
static void wanted_line(int port, struct uart_config *cfg)
{
	struct bridge_port *p = &ports[port];

	*cfg = p->cdc_line;
	if (route_of(port) != ROUTE_CDC) {
		cfg->parity = UART_CFG_PARITY_NONE;
		cfg->stop_bits = UART_CFG_STOP_BITS_1;
		cfg->data_bits = UART_CFG_DATA_BITS_8;
	}
	/* No such wires. */
	cfg->flow_ctrl = UART_CFG_FLOW_CTRL_NONE;
	switch (route_of(port)) {
	case ROUTE_WEBUSB:
		cfg->baudrate = p->webusb_baud;
		break;
	case ROUTE_LINK:
		cfg->baudrate = p->link_baud;
		break;
	case ROUTE_LOOPBACK:
		cfg->baudrate = LOOPBACK_BAUD;
		break;
	default:
		break;
	}
}

/* Once what is on its way has gone out at the old rate. */
static void line_fn(struct k_work *work)
{
	ARG_UNUSED(work);
	for (int k = 0; k < PORT_COUNT; k++) {
		struct bridge_port *p = &ports[k];
		struct uart_config want;
		int ret;

		wanted_line(k, &want);
		if (memcmp(&want, &p->line, sizeof(want)) == 0) {
			continue;
		}
		for (int t = 0; t < LINE_WAIT_MS && !uart_tx_drained(k); t++) {
			k_msleep(1);
		}
		ret = uart_set_line(k, &want);
		if (ret != 0) {
			/* Mark and space parity, 1.5 stop bits: the line stays. */
			LOG_WRN("UART %d: line refused (%d)", k, ret);
		}
		p->line = want;
		if (k == PORT_ESP32) {
			uint32_t b = want.baudrate / 100U;

			regs_set(COPROC_REG_UART0_BAUD, (uint8_t)b);
			regs_set(COPROC_REG_UART0_BAUD + 1, (uint8_t)(b >> 8));
			regs_set(COPROC_REG_UART0_BAUD + 2, (uint8_t)(b >> 16));
		}
	}
}
static K_WORK_DEFINE(line_work, line_fn);

static void routes_changed(void)
{
	for (int k = 0; k < PORT_COUNT; k++) {
		ports[k].route = route_of(k);
	}
	(void)k_work_submit(&line_work);
	bridge_wake();
}

void bridge_cdc_line(int port, const struct uart_config *cfg)
{
	ports[port].cdc_line = *cfg;
	(void)k_work_submit(&line_work);
}

void bridge_webusb_status(int port, uint16_t status)
{
	ports[port].webusb_status = status;
	routes_changed();
}

void bridge_webusb_baud(int port, uint32_t baud)
{
	ports[port].webusb_baud = baud;
	(void)k_work_submit(&line_work);
}

void bridge_loopback(bool on)
{
	loopback = on;
	routes_changed();
}

void bridge_link_open(bool open)
{
	link_open = open;
	regs_set(COPROC_REG_LINK_STATE, open ? 1U : 0U);
	if (!open && fast_on) {
		(void)bridge_fastlink(0);
	}
	routes_changed();
}

bool bridge_link_is_open(void)
{
	return link_open;
}

int bridge_link_baud(int port, uint32_t baud)
{
	if (port >= PORT_COUNT || baud == 0U) {
		return -EINVAL;
	}
	ports[port].link_baud = baud;
	(void)k_work_submit(&line_work);
	return 0;
}

uint32_t bridge_baud(int port)
{
	return port < PORT_COUNT ? ports[port].line.baudrate : 0U;
}

int bridge_fastlink(uint32_t baud)
{
	int ret = 0;

	if (baud != 0U) {
		ret = fast_rx_start(baud);
	} else {
		fast_rx_stop();
	}
	fast_on = baud != 0U && ret == 0;
	fast_ready = true;
	merge_port = PORT_ESP32;
	merge_between = true;
	bridge_wake();
	return ret;
}

void bridge_set_test(uint8_t mode)
{
	test_mode = mode;
	test_count = 0;
	bridge_wake();
}

uint8_t bridge_get_test(void)
{
	return test_mode;
}

void bridge_usb_up(bool up)
{
	usb_up = up;
	bridge_wake();
}

/* ---- the USB functions ---- */

/* The UART's bytes out on @p v's bulk IN, while it has buffers; how many. */
static size_t uart_to_vendor(int port, struct vendor_if *v)
{
	size_t room, total = 0;
	struct net_buf *buf;
	/*
	 * What is here now, not until the ring is empty: bytes keep coming as fast as this takes
	 * them, in buffers of a few bytes, and the thread would never get back to its other work.
	 */
	size_t left = uart_rx_pending(port);

	while (left > 0U) {
		const uint8_t *data;
		size_t n = uart_rx_peek(port, &data);

		if (n == 0U) {
			return total;
		}
		buf = vendor_in_get(v, &room);
		if (buf == NULL) {
			return total;
		}
		n = MIN(n, room);
		net_buf_add_mem(buf, data, n);
		uart_rx_consume(port, n);
		/* What lies past the ring's end, if the buffer has room for it. */
		if (net_buf_tailroom(buf) > 0U) {
			size_t more = uart_rx_peek(port, &data);

			more = MIN(more, net_buf_tailroom(buf));
			if (more > 0U) {
				net_buf_add_mem(buf, data, more);
				uart_rx_consume(port, more);
			}
		}
		total += buf->len;
		left -= MIN(left, (size_t)buf->len);
		vendor_in_put(v, buf, uart_rx_peek(port, &data) > 0U);
	}
	return total;
}

/* @p v's bulk OUT into the UART, as the ring takes it (the host waits meanwhile); how many. */
static size_t vendor_to_uart(int port, struct vendor_if *v)
{
	struct bridge_port *p = &ports[port];
	size_t total = 0;

	/* As many as can wait at a time: with the host as fast as this, the loop would not end. */
	for (int k = 0; k < OUT_BUFFERS_MAX; k++) {
		size_t n;

		if (p->out == NULL) {
			p->out = vendor_out_get(v);
			p->out_owner = v;
			p->out_off = 0;
			if (p->out == NULL) {
				return total;
			}
		}
		n = uart_tx_write(port, p->out->data + p->out_off, p->out->len - p->out_off);
		p->out_off += n;
		total += n;
		if (p->out_off < p->out->len) {
			return total;
		}
		/* A route may have changed since it came: it still goes to the UART. */
		vendor_out_done(p->out_owner, p->out);
		p->out = NULL;
	}
	/* The next ones may be there already. */
	bridge_wake();
	return total;
}

/*
 * Interface 6 with the FPGA's fast line: two rings of whole frames into one pipe. A ring goes on
 * until the other has something and this one has just ended a frame (the zero byte): blocks come
 * from the FPGA, a reply from the ESP32's UART waits for at most one of them.
 */
#define MERGE_WAIT_MS 10

static size_t merge_to_link(void)
{
	struct vendor_if *v = vendor_link;
	size_t total = 0;
	/* What is here now: see uart_to_vendor(). */
	size_t left = uart_rx_pending(PORT_ESP32) + uart_rx_pending(PORT_FAST);

	while (left > 0U) {
		size_t room;
		struct net_buf *buf = vendor_in_get(v, &room);

		if (buf == NULL) {
			break;
		}
		while (room > 0U) {
			const int other = merge_port == PORT_FAST ? PORT_ESP32 : PORT_FAST;
			const uint8_t *data;
			const bool waiting = uart_rx_pending(other) > 0U;
			size_t n;

			if (merge_between && waiting) {
				merge_port = other;
			}
			/* Not inside MIN(), which reads it twice: the DMA moves on in between. */
			n = uart_rx_peek(merge_port, &data);
			n = MIN(n, room);
			if (n == 0U) {
				/*
				 * Inside a frame that does not go on: a reply on its way, which
				 * comes within this; or a boot message, which has no zero at all.
				 */
				if (waiting && k_uptime_get() - merge_idle_ms > MERGE_WAIT_MS) {
					merge_between = true;
					continue;
				}
				break;
			}
			merge_idle_ms = k_uptime_get();
			if (uart_rx_pending(merge_port == PORT_FAST ? PORT_ESP32 : PORT_FAST) > 0U) {
				const uint8_t *zero = memchr(data, 0, n);

				if (zero != NULL) {
					n = (size_t)(zero - data) + 1U;
				}
			}
			net_buf_add_mem(buf, data, n);
			merge_between = data[n - 1U] == 0U;
			uart_rx_consume(merge_port, n);
			room -= n;
			total += n;
		}
		if (buf->len == 0U) {
			net_buf_unref(buf);
			break;
		}
		left -= MIN(left, (size_t)buf->len);
		vendor_in_put(v, buf, uart_rx_pending(PORT_ESP32) > 0U ||
				      uart_rx_pending(PORT_FAST) > 0U);
	}
	return total;
}

/* A fuller ring than this holds the FPGA back, until it is down to the other. */
#define FAST_HOLD_ABOVE  24576U
#define FAST_LET_GO_BELOW 12288U

static void fast_flow(void)
{
	const size_t pending = uart_rx_pending(PORT_FAST);

	coproc_stats.fast_peak = MAX(coproc_stats.fast_peak, (uint32_t)pending);
	if (fast_rx_framing_error()) {
		coproc_stats.fast_framing++;
	}
	if (fast_ready && pending > FAST_HOLD_ABOVE) {
		fast_ready = false;
		fast_rx_ready(false);
		coproc_stats.fast_stalls++;
	} else if (!fast_ready && pending < FAST_LET_GO_BELOW) {
		fast_ready = true;
		fast_rx_ready(true);
	}
}

/*
 * Nobody reading a CDC ACM port (it is closed: the host's driver takes nothing then). The next
 * reader gets no old news, as with the stock firmware's small buffers.
 */
static void stale_check(int port, size_t moved)
{
	struct bridge_port *p = &ports[port];
	const uint8_t *data;
	size_t n = uart_rx_peek(port, &data);
	int64_t now = k_uptime_get();

	if (moved > 0U || n == 0U) {
		p->last_read_ms = now;
	} else if (now - p->last_read_ms > STALE_MS) {
		LOG_WRN("UART %d: %u bytes stale, %d IN buffers out", port, (unsigned int)n,
			vendor_in_flight(vendor_cdc[port]));
		while (n > 0U) {
			coproc_stats.stale_dropped[port] += n;
			uart_rx_consume(port, n);
			n = uart_rx_peek(port, &data);
		}
		p->last_read_ms = now;
	}
}

static void loopback_service(int port)
{
	const uint8_t *data;
	size_t n = uart_rx_peek(port, &data);
	const size_t room = uart_tx_room(port);
	static uint8_t chunk[128];

	/* What the stock firmware's self test expects back. */
	n = MIN(n, MIN(sizeof(chunk), room));
	for (size_t k = 0; k < n; k++) {
		chunk[k] = data[k] ^ 0xA5U;
	}
	if (n > 0U) {
		uart_rx_consume(port, n);
		(void)uart_tx_write(port, chunk, n);
	}
}

static void drain_out(struct vendor_if *v)
{
	struct net_buf *buf;

	for (int k = 0; k < OUT_BUFFERS_MAX && (buf = vendor_out_get(v)) != NULL; k++) {
		vendor_out_done(v, buf);
	}
}

/* Interface 6 under test: the words count on, across buffers. */
static void test_source(void)
{
	struct vendor_if *v = vendor_link;
	struct net_buf *buf;
	size_t room;

	drain_out(v);
	while ((buf = vendor_in_get(v, &room)) != NULL) {
		size_t words = room / 4U;
		uint8_t *to = net_buf_add(buf, words * 4U);

		for (size_t k = 0; k < words; k++, to += 4) {
			sys_put_le32(test_count++, to);
		}
		coproc_stats.link_in += buf->len;
		vendor_in_put(v, buf, true);
	}
}

static void test_loopback(void)
{
	static struct net_buf *out;
	static size_t off;
	struct vendor_if *v = vendor_link;

	while (true) {
		struct net_buf *in;
		size_t room, n;

		if (out == NULL) {
			out = vendor_out_get(v);
			off = 0;
			if (out == NULL) {
				return;
			}
		}
		in = vendor_in_get(v, &room);
		if (in == NULL) {
			return;
		}
		n = MIN(room, out->len - off);
		net_buf_add_mem(in, out->data + off, n);
		off += n;
		coproc_stats.link_out += n;
		coproc_stats.link_in += n;
		vendor_in_put(v, in, off < out->len);
		if (off >= out->len) {
			vendor_out_done(v, out);
			out = NULL;
		}
	}
}

static void service_port(int port)
{
	struct bridge_port *p = &ports[port];
	struct vendor_if *web = vendor_webusb[port];
	struct vendor_if *cdc = vendor_cdc[port];
	const uint8_t *data;

	/* As the stock firmware, what comes on a WebUSB interface always goes to its UART. */
	if (p->route != ROUTE_LINK && vendor_enabled(web)) {
		(void)vendor_to_uart(port, web);
	}
	/* What comes on a CDC ACM port that does not own the UART goes nowhere. */
	if (p->route != ROUTE_CDC) {
		drain_out(cdc);
	}
	switch (p->route) {
	case ROUTE_CDC:
		(void)vendor_to_uart(port, cdc);
		stale_check(port, uart_to_vendor(port, cdc));
		break;
	case ROUTE_WEBUSB:
		(void)uart_to_vendor(port, web);
		break;
	case ROUTE_LINK:
		if (test_mode == COPROC_TEST_OFF) {
			coproc_stats.link_out += vendor_to_uart(port, vendor_link);
			if (fast_on) {
				coproc_stats.link_in += merge_to_link();
				fast_flow();
			} else {
				coproc_stats.link_in += uart_to_vendor(port, vendor_link);
			}
		} else {
			/* The UART has no way out meanwhile. */
			size_t n = uart_rx_peek(port, &data);

			uart_rx_consume(port, n);
		}
		break;
	case ROUTE_LOOPBACK:
		loopback_service(port);
		break;
	}
}

static void bridge_fn(void *a, void *b, void *c)
{
	const struct device *const wdt = DEVICE_DT_GET(DT_ALIAS(watchdog0));
	const struct wdt_timeout_cfg wdt_cfg = {
		.window = {.max = WATCHDOG_MS},
		.flags = WDT_FLAG_RESET_SOC,
	};
	int64_t next_errors = 0;
	int wdt_ch = -1;

	ARG_UNUSED(a);
	ARG_UNUSED(b);
	ARG_UNUSED(c);
	if (device_is_ready(wdt)) {
		wdt_ch = wdt_install_timeout(wdt, &wdt_cfg);
		if (wdt_ch >= 0 && wdt_setup(wdt, 0) != 0) {
			wdt_ch = -1;
		}
	}
	for (;;) {
		(void)k_sem_take(&wake, K_MSEC(1));
		if (wdt_ch >= 0) {
			(void)wdt_feed(wdt, wdt_ch);
		}
		if (k_uptime_get() >= next_errors) {
			next_errors = k_uptime_get() + ERRORS_MS;
			for (int k = 0; k < PORT_COUNT; k++) {
				uart_poll_errors(k);
			}
		}
		if (!usb_up) {
			/* Nobody to tell: no old news when somebody comes. */
			for (int k = 0; k < PORT_COUNT; k++) {
				const uint8_t *data;
				size_t n = uart_rx_peek(k, &data);

				uart_rx_consume(k, n);
			}
			continue;
		}
		if (test_mode == COPROC_TEST_CRASH) {
			k_oops();
		}
		if (test_mode == COPROC_TEST_SOURCE && vendor_enabled(vendor_link)) {
			test_source();
		} else if (test_mode == COPROC_TEST_LOOPBACK && vendor_enabled(vendor_link)) {
			test_loopback();
		}
		for (int k = 0; k < PORT_COUNT; k++) {
			service_port(k);
		}
	}
}

K_THREAD_STACK_DEFINE(bridge_stack, BRIDGE_STACK);
static struct k_thread bridge_thread;

int bridge_start(void)
{
	for (int k = 0; k < PORT_COUNT; k++) {
		struct bridge_port *p = &ports[k];

		p->cdc_line = (struct uart_config){
			.baudrate = 115200,
			.parity = UART_CFG_PARITY_NONE,
			.stop_bits = UART_CFG_STOP_BITS_1,
			.data_bits = UART_CFG_DATA_BITS_8,
			.flow_ctrl = UART_CFG_FLOW_CTRL_NONE,
		};
		p->line = p->cdc_line;
		p->webusb_baud = 115200;
		p->link_baud = LINK_BAUD;
	}
	regs_set(COPROC_REG_UART0_BAUD, (uint8_t)(115200U / 100U));
	regs_set(COPROC_REG_UART0_BAUD + 1, (uint8_t)((115200U / 100U) >> 8));
	k_thread_create(&bridge_thread, bridge_stack, K_THREAD_STACK_SIZEOF(bridge_stack),
			bridge_fn, NULL, NULL, NULL, BRIDGE_PRIO, 0, K_NO_WAIT);
	k_thread_name_set(&bridge_thread, "bridge");
	return 0;
}
```

## src/coproc.h
```c
/*
 * SPDX-License-Identifier: GPL-3.0-or-later
 *
 * What the parts of apps/mch2022_coproc share.
 */

#ifndef COPROC_H_
#define COPROC_H_

#include <stdbool.h>
#include <stddef.h>
#include <stdint.h>

#include <zephyr/drivers/uart.h>
#include <zephyr/net_buf.h>

#include <esp_sdr/mch2022_coproc.h>

#define PORT_ESP32 COPROC_UART_ESP32
#define PORT_FPGA  COPROC_UART_FPGA
#define PORT_COUNT 2
/* The FPGA's fast line: a receive ring like the UARTs', from the PIO. */
#define PORT_FAST  2

extern struct coproc_stats coproc_stats;

/* ---- the UARTs (uart_dma.c): rings on DMA ---- */

int uart_dma_init(void);
/* The received bytes that lie together; 0 if none. Overruns are counted and skipped here. */
size_t uart_rx_peek(int port, const uint8_t **data);
void uart_rx_consume(int port, size_t n);
/* As many of @p n bytes as fit; they go out by DMA. Any thread. */
size_t uart_tx_write(int port, const uint8_t *data, size_t n);
size_t uart_tx_room(int port);
/* Nothing queued, and the UART has sent its last bit. */
bool uart_tx_drained(int port);
int uart_set_line(int port, const struct uart_config *cfg);
/* The UART's errors into the counters. */
void uart_poll_errors(int port);
/* Bytes waiting in a receive ring. */
size_t uart_rx_pending(int port);
/* The FPGA's UART pins: GPIO25 read by the PIO at @p baud, GPIO24 a ready line; or back. */
int fast_rx_start(uint32_t baud);
void fast_rx_stop(void);
void fast_rx_ready(bool ready);
/* A byte with a bad stop bit since the last call. */
bool fast_rx_framing_error(void);

/* ---- routing (bridge.c) ---- */

int bridge_start(void);
/* Something for the bridge thread to do. */
void bridge_wake(void);
/* A CDC ACM port's line coding changed. */
void bridge_cdc_line(int port, const struct uart_config *cfg);
/* Whether DTR and RTS on the ESP32's CDC ACM port count. */
bool bridge_cdc_owns_esp32(void);
/* The WebUSB interfaces' requests: their status (bit 0: they own the UART), their baud rate. */
void bridge_webusb_status(int port, uint16_t status);
void bridge_webusb_baud(int port, uint32_t baud);
/* The FPGA's UART looped back, as the ESP32's self test asks. */
void bridge_loopback(bool on);
/* Interface 6. */
void bridge_link_open(bool open);
bool bridge_link_is_open(void);
int bridge_link_baud(int port, uint32_t baud);
uint32_t bridge_baud(int port);
/* The FPGA's fast line at @p baud into interface 6; 0 off. */
int bridge_fastlink(uint32_t baud);
void bridge_set_test(uint8_t mode);
uint8_t bridge_get_test(void);
/* USB configured or not. */
void bridge_usb_up(bool up);

/* ---- USB functions (usb_vendor.c): bulk pipes ---- */

struct vendor_if;
extern struct vendor_if *const vendor_cdc[PORT_COUNT];
extern struct vendor_if *const vendor_webusb[PORT_COUNT];
extern struct vendor_if *const vendor_link;

/* The classes' names, in the order of their interfaces. */
#define VENDOR_CLASSES 5
extern const char *const vendor_class_names[VENDOR_CLASSES];

bool vendor_enabled(struct vendor_if *v);
int vendor_in_flight(struct vendor_if *v);
/* A buffer to fill, or NULL if all are out; its room in *room. */
struct net_buf *vendor_in_get(struct vendor_if *v, size_t *room);
/* It goes out; @p more: more follows at once, so a whole number of packets needs no end mark. */
void vendor_in_put(struct vendor_if *v, struct net_buf *buf, bool more);
/* The next buffer the host sent, or NULL; back with vendor_out_done(). */
struct net_buf *vendor_out_get(struct vendor_if *v);
void vendor_out_done(struct vendor_if *v, struct net_buf *buf);

/* ---- USB (usb_dev.c) ---- */

int usb_dev_init(void);
/* For the BOS descriptors' and classes' control data. */
struct usbd_context;
extern struct usbd_context *const coproc_usbd;

/* ---- the ESP32's and FPGA's lines (esp32_ctl.c) ---- */

int esp32_ctl_init(void);
void esp32_reset(bool download);
/* A new state of DTR and RTS on the ESP32's CDC ACM port. */
void esp32_line_state(bool dtr, bool rts);
void esp32_set_reset_mode(uint8_t mode);
uint8_t esp32_get_reset_mode(void);
/* CRESET: the FPGA held in reset or let go. */
void fpga_run(bool run);
bool fpga_cdone(void);

/* ---- the I2C registers (i2c_regs.c) ---- */

int regs_init(void);
/* The target on the bus. */
int regs_start(void);
uint8_t regs_get(uint8_t reg);
void regs_set(uint8_t reg, uint8_t val);
/* A new reading of an input register (regmap_update_input()). */
void regs_input(uint8_t reg, uint8_t value, uint8_t ignore);
/* The WebUSB interface's mode (register 17), the USB state (register 15). */
void regs_webusb_mode(uint8_t mode);
uint8_t regs_webusb_mode_get(void);
void regs_usb_state(bool mounted, bool suspended, bool remote_wakeup);

/* ---- buttons, ADC, backlight (periph.c, qspi_select.c) ---- */

int periph_init(void);
void backlight_set(uint8_t value);
/* SAO and test point pins: registers 1 and 3. */
void gpio_regs_apply(uint8_t dir, uint8_t out);
/* SELECT, which is the flash's chip select: blocks every interrupt some 30 us. */
bool select_pressed(void);

/* ---- PIO (pio_out.c) ---- */

int pio_out_init(void);
/* 0: off, 1: RGB, 2: RGBW. */
void ws2812_mode(uint8_t mode);
void ws2812_put(uint32_t data);
void ir_send(uint16_t address, uint16_t data);

/* ---- system (sysctl.c, fwlog.c) ---- */

/* How this run began. */
bool sysctl_crashed(void);
uint32_t sysctl_reset_reason(void);
uint32_t sysctl_rosc_status(void);
/* Into the badge's bootloader (0xBE to register 16), the ROM's USB bootloader, soon. */
void sysctl_reboot_bootloader(void);
void sysctl_reboot_bootsel(void);
/* Log bytes not yet read, at most @p max. */
size_t fwlog_read(uint8_t *out, size_t max);

#endif /* COPROC_H_ */
```

## src/esp32_ctl.c
```c
/*
 * SPDX-License-Identifier: GPL-3.0-or-later
 *
 * The ESP32's EN and IO0 and the FPGA's CRESET and CDONE. Resets of the ESP32 as the stock
 * firmware's uart_task.c: each one holds the FPGA in reset too (the ESP32 loads it again, register
 * 5 keeps its value), EN low for a millisecond, IO0 low with it for download mode. Unlike there,
 * IO0 is let go again: it is also the codec's clock, and stayed low until the next normal reset.
 */

#include <errno.h>

#include <zephyr/device.h>
#include <zephyr/drivers/gpio.h>
#include <zephyr/kernel.h>
#include <zephyr/logging/log.h>

#include "coproc.h"
#include "regmap.h"
#include "reset_detect.h"

LOG_MODULE_REGISTER(esp32_ctl, LOG_LEVEL_INF);

#define USER_NODE DT_PATH(zephyr_user)

/* After EN rises the ESP32 has read its strapping pins long ago. */
#define IO0_HOLD_MS 50
#define EN_LOW_MS   1
/* The circuit's capacitor on EN: IO0 goes low before EN rises, whichever line moves first. */
#define CIRCUIT_EN_DELAY_MS 10

static const struct gpio_dt_spec en = GPIO_DT_SPEC_GET(USER_NODE, esp32_en_gpios);
static const struct gpio_dt_spec io0 = GPIO_DT_SPEC_GET(USER_NODE, esp32_io0_gpios);
static const struct gpio_dt_spec creset = GPIO_DT_SPEC_GET(USER_NODE, fpga_creset_gpios);
static const struct gpio_dt_spec cdone = GPIO_DT_SPEC_GET(USER_NODE, fpga_cdone_gpios);

static struct reset_detect detect;
static bool reset_active;
static bool circuit_en_low;

static void io0_release_fn(struct k_work *work)
{
	ARG_UNUSED(work);
	(void)gpio_pin_set_dt(&io0, 0);
}
static K_WORK_DELAYABLE_DEFINE(io0_release_work, io0_release_fn);

static void en_release_fn(struct k_work *work)
{
	ARG_UNUSED(work);
	(void)gpio_pin_set_dt(&en, 1);
	reset_active = false;
	(void)k_work_reschedule(&io0_release_work, K_MSEC(IO0_HOLD_MS));
}
static K_WORK_DELAYABLE_DEFINE(en_release_work, en_release_fn);

void esp32_reset(bool download)
{
	if (reset_active) {
		return;
	}
	reset_active = true;
	coproc_stats.esp32_resets++;
	(void)k_work_cancel_delayable(&io0_release_work);
	(void)gpio_pin_set_dt(&creset, 1);
	(void)gpio_pin_set_dt(&en, 0);
	(void)gpio_pin_set_dt(&io0, download ? 1 : 0);
	reset_detect_clear(&detect);
	(void)k_work_reschedule(&en_release_work, K_MSEC(EN_LOW_MS));
}

/* What a download reset becomes with the lock set: the launcher's flash protection. */
static bool download_allowed(void)
{
	if (regs_get(REG_RESET_LOCK) == 0U) {
		return true;
	}
	regs_set(REG_RESET_ATTEMPTED, 1);
	coproc_stats.resets_locked++;
	return false;
}

static void circuit_lines(bool dtr, bool rts)
{
	struct reset_lines l = reset_detect_circuit(dtr, rts);

	if (l.io0_low && download_allowed()) {
		(void)k_work_cancel_delayable(&io0_release_work);
		(void)gpio_pin_set_dt(&io0, 1);
	} else if (!l.io0_low) {
		/* Later: EN may be about to rise. */
		(void)k_work_reschedule(&io0_release_work, K_MSEC(IO0_HOLD_MS));
	}
	if (l.en_low) {
		if (!circuit_en_low) {
			coproc_stats.esp32_resets++;
		}
		circuit_en_low = true;
		(void)k_work_cancel_delayable(&en_release_work);
		(void)gpio_pin_set_dt(&creset, 1);
		(void)gpio_pin_set_dt(&en, 0);
	} else if (circuit_en_low) {
		circuit_en_low = false;
		reset_active = true;
		(void)k_work_reschedule(&en_release_work, K_MSEC(CIRCUIT_EN_DELAY_MS));
	}
}

void esp32_line_state(bool dtr, bool rts)
{
	if (!bridge_cdc_owns_esp32()) {
		return;
	}
	if (detect.mode == COPROC_RESET_CIRCUIT) {
		circuit_lines(dtr, rts);
		return;
	}
	switch (reset_detect_stock(&detect, dtr, rts, reset_active)) {
	case RESET_ACTION_DOWNLOAD:
		esp32_reset(download_allowed());
		break;
	case RESET_ACTION_APP:
		esp32_reset(false);
		break;
	default:
		break;
	}
}

void esp32_set_reset_mode(uint8_t mode)
{
	reset_detect_init(&detect, mode);
	regs_set(COPROC_REG_RESET_MODE, mode);
}

uint8_t esp32_get_reset_mode(void)
{
	return detect.mode;
}

void fpga_run(bool run)
{
	(void)gpio_pin_set_dt(&creset, run ? 0 : 1);
}

bool fpga_cdone(void)
{
	return gpio_pin_get_dt(&cdone) > 0;
}

int esp32_ctl_init(void)
{
	int ret;

	if (!gpio_is_ready_dt(&en)) {
		return -ENODEV;
	}
	/* EN and CRESET were driven low at PRE_KERNEL_2 (sysctl.c). */
	ret = gpio_pin_configure_dt(&en, GPIO_OUTPUT_INACTIVE);
	ret = ret != 0 ? ret : gpio_pin_configure_dt(&creset, GPIO_OUTPUT_ACTIVE);
	ret = ret != 0 ? ret : gpio_pin_configure_dt(&io0, GPIO_OUTPUT_INACTIVE);
	ret = ret != 0 ? ret : gpio_pin_configure_dt(&cdone, GPIO_INPUT);
	if (ret == 0) {
		esp32_set_reset_mode(CONFIG_APP_COPROC_RESET_MODE);
	}
	return ret;
}
```

## src/fwlog.c
```c
/*
 * SPDX-License-Identifier: GPL-3.0-or-later
 *
 * The firmware's log in a ring, there being no console: the UARTs belong to the ESP32 and the
 * FPGA. COPROC_REQ_GET_LOG reads it over USB.
 */

#include <zephyr/init.h>
#include <zephyr/irq.h>
#include <zephyr/kernel.h>
#include <zephyr/sys/printk-hooks.h>
#include <zephyr/sys/util.h>

#include "coproc.h"

#define LOG_BYTES 2048U

static uint8_t ring[LOG_BYTES];
static uint32_t head, tail;

static int log_out(int c)
{
	unsigned int key = irq_lock();

	ring[head++ % LOG_BYTES] = (uint8_t)c;
	if (head - tail > LOG_BYTES) {
		tail = head - LOG_BYTES;
	}
	irq_unlock(key);
	return c;
}

size_t fwlog_read(uint8_t *out, size_t max)
{
	size_t n = 0;

	while (n < max) {
		unsigned int key = irq_lock();
		bool empty = head == tail;

		if (!empty) {
			out[n++] = ring[tail++ % LOG_BYTES];
		}
		irq_unlock(key);
		if (empty) {
			break;
		}
	}
	return n;
}

static int fwlog_init(void)
{
	__printk_hook_install(log_out);
	return 0;
}
SYS_INIT(fwlog_init, PRE_KERNEL_1, 0);
```

## src/i2c_regs.c
```c
/*
 * SPDX-License-Identifier: GPL-3.0-or-later
 *
 * The I2C target at 0x17: the register map on the bus, and what writes do (the stock firmware's
 * i2c_peripheral.c). Bytes come and go in the driver's interrupt; the effects of writes and the
 * interrupt line to the ESP32 wait in a work item until the bus is free, as there.
 */

#include <errno.h>

#include <zephyr/device.h>
#include <zephyr/drivers/gpio.h>
#include <zephyr/drivers/hwinfo.h>
#include <zephyr/drivers/i2c.h>
#include <zephyr/kernel.h>
#include <zephyr/logging/log.h>
#include <zephyr/sys/byteorder.h>

#include "coproc.h"
#include "regmap.h"

LOG_MODULE_REGISTER(i2c_regs, LOG_LEVEL_INF);

#define USER_NODE DT_PATH(zephyr_user)
#define I2C_ADDR  0x17

static const struct device *const bus = DEVICE_DT_GET(DT_NODELABEL(i2c1));
static const struct gpio_dt_spec irq_line = GPIO_DT_SPEC_GET(USER_NODE, esp32_int_gpios);

static struct regmap map;
static atomic_t bus_active;
/* The line should be low; a read of register 9 asked it released. */
static atomic_t irq_want, irq_clear;
static bool irq_is_low;
static uint8_t webusb_mode;
static uint8_t usb_state;

uint8_t regs_get(uint8_t reg)
{
	return map.regs[reg];
}

void regs_set(uint8_t reg, uint8_t val)
{
	map.regs[reg] = val;
}

uint8_t regs_webusb_mode_get(void)
{
	return webusb_mode;
}

static void apply_register(uint8_t reg, uint8_t value)
{
	switch (reg) {
	case REG_GPIO_DIR:
	case REG_GPIO_OUT:
		gpio_regs_apply(map.regs[REG_GPIO_DIR], map.regs[REG_GPIO_OUT]);
		break;
	case REG_BACKLIGHT:
		backlight_set(value);
		break;
	case REG_FPGA:
		fpga_run((value & 0x01U) != 0U);
		bridge_loopback((value & 0x02U) != 0U);
		break;
	case REG_BL_TRIGGER:
		if (value == 0xBEU) {
			sysctl_reboot_bootloader();
		}
		break;
	case REG_IR_TRIGGER:
		if (value == 0x01U) {
			uint8_t cmd = map.regs[REG_IR_COMMAND];

			ir_send(map.regs[REG_IR_ADDRESS_LO] |
					((uint16_t)map.regs[REG_IR_ADDRESS_HI] << 8),
				cmd | ((uint16_t)(uint8_t)~cmd << 8));
		}
		break;
	case REG_WS2812_MODE:
		ws2812_mode(value);
		gpio_regs_apply(map.regs[REG_GPIO_DIR], map.regs[REG_GPIO_OUT]);
		break;
	case REG_WS2812_TRIGGER: {
		uint8_t n = MIN(map.regs[REG_WS2812_LENGTH], 10U);

		for (uint8_t k = 0; k < n; k++) {
			ws2812_put(sys_get_le32(&map.regs[REG_WS2812_LED0 + 4U * k]));
		}
		break;
	}
	case COPROC_REG_RESET_MODE:
		if (value <= COPROC_RESET_CIRCUIT) {
			esp32_set_reset_mode(value);
		}
		break;
	case COPROC_REG_BOOTSEL:
		if (value == COPROC_BOOTSEL_MAGIC) {
			sysctl_reboot_bootsel();
		}
		break;
	default:
		break;
	}
}

static void apply_fn(struct k_work *work)
{
	int reg = -1;

	ARG_UNUSED(work);
	if (atomic_get(&bus_active) != 0) {
		/* The transfer's stop comes back here. */
		return;
	}
	if (atomic_clear(&irq_clear) != 0) {
		atomic_set(&irq_want, 0);
	}
	if ((atomic_get(&irq_want) != 0) != irq_is_low) {
		irq_is_low = !irq_is_low;
		(void)gpio_pin_set_dt(&irq_line, irq_is_low ? 1 : 0);
	}
	while ((reg = regmap_next_modified(&map, reg + 1)) >= 0) {
		apply_register((uint8_t)reg, map.regs[reg]);
	}
	map.regs[REG_USB] = usb_state;
	map.regs[REG_WEBUSB_MODE] = webusb_mode;
}
static K_WORK_DEFINE(apply_work, apply_fn);

void regs_input(uint8_t reg, uint8_t value, uint8_t ignore)
{
	if (regmap_update_input(&map, reg, value, ignore)) {
		atomic_set(&irq_want, 1);
		(void)k_work_submit(&apply_work);
	}
}

void regs_webusb_mode(uint8_t mode)
{
	webusb_mode = mode;
	(void)k_work_submit(&apply_work);
}

void regs_usb_state(bool mounted, bool suspended, bool remote_wakeup)
{
	usb_state = (mounted ? BIT(0) : 0U) | (suspended ? BIT(1) : 0U) |
		    (remote_wakeup ? BIT(2) : 0U);
	(void)k_work_submit(&apply_work);
}

/* ---- the bus, in the driver's interrupt ---- */

static uint8_t read_next(void)
{
	bool cleared;
	uint8_t val;

	/* CDONE is the one the ESP32 waits on: read when asked. */
	if (map.ptr == REG_INPUT1) {
		if (fpga_cdone()) {
			map.regs[REG_INPUT1] &= ~REG_INPUT1_NOT_CDONE;
		} else {
			map.regs[REG_INPUT1] |= REG_INPUT1_NOT_CDONE;
		}
	}
	val = regmap_read_byte(&map, &cleared);
	if (cleared) {
		atomic_set(&irq_clear, 1);
	}
	return val;
}

static int on_write_requested(struct i2c_target_config *cfg)
{
	ARG_UNUSED(cfg);
	atomic_set(&bus_active, 1);
	regmap_write_start(&map);
	return 0;
}

static int on_write_received(struct i2c_target_config *cfg, uint8_t val)
{
	ARG_UNUSED(cfg);
	regmap_write_byte(&map, val);
	return 0;
}

static int on_read_requested(struct i2c_target_config *cfg, uint8_t *val)
{
	ARG_UNUSED(cfg);
	atomic_set(&bus_active, 1);
	*val = read_next();
	return 0;
}

static int on_read_processed(struct i2c_target_config *cfg, uint8_t *val)
{
	ARG_UNUSED(cfg);
	*val = read_next();
	return 0;
}

static int on_stop(struct i2c_target_config *cfg)
{
	ARG_UNUSED(cfg);
	atomic_set(&bus_active, 0);
	/* CRESET at once: the ESP32 starts the bitstream 2 ms after this and the FPGA needs 1.2. */
	if (atomic_test_bit(map.modified, REG_FPGA)) {
		fpga_run((map.regs[REG_FPGA] & 0x01U) != 0U);
	}
	(void)k_work_submit(&apply_work);
	return 0;
}

static const struct i2c_target_callbacks callbacks = {
	.write_requested = on_write_requested,
	.write_received = on_write_received,
	.read_requested = on_read_requested,
	.read_processed = on_read_processed,
	.stop = on_stop,
};

static struct i2c_target_config target = {
	.address = I2C_ADDR,
	.callbacks = &callbacks,
};

int regs_init(void)
{
	uint8_t id[8] = {0};

	regmap_init(&map);
	if (hwinfo_get_device_id(id, sizeof(id)) > 0) {
		memcpy(&map.regs[REG_UID], id, sizeof(id));
	}
	map.regs[COPROC_REG_FEATURES] = (uint8_t)(COPROC_F_LINK | COPROC_F_FASTLINK);
	map.regs[REG_CRASH_DEBUG] = sysctl_crashed() ? BIT(0) : 0U;
	/* What the PWM starts at (the stock firmware's register said 0). */
	map.regs[REG_BACKLIGHT] = 255;
	return gpio_pin_configure_dt(&irq_line, GPIO_OUTPUT_INACTIVE);
}

int regs_start(void)
{
	if (!device_is_ready(bus)) {
		return -ENODEV;
	}
	return i2c_target_register(bus, &target);
}
```

## src/periph.c
```c
/*
 * SPDX-License-Identifier: GPL-3.0-or-later
 *
 * The buttons (every 30 ms), the ADC and the charger (every 250 ms), the backlight, the SAO port's
 * pins: their registers, as the stock firmware's i2c_peripheral.c and lcd.c.
 */

#include <errno.h>

#include <zephyr/device.h>
#include <zephyr/drivers/adc.h>
#include <zephyr/drivers/gpio.h>
#include <zephyr/drivers/pwm.h>
#include <zephyr/kernel.h>
#include <zephyr/logging/log.h>
#include <zephyr/sys/util.h>

#include <hardware/adc.h>

#include "coproc.h"
#include "regmap.h"

LOG_MODULE_REGISTER(periph, LOG_LEVEL_INF);

#define USER_NODE DT_PATH(zephyr_user)
#define INPUT_MS  30
#define ADC_MS    250

#define SPEC_ELEM(node, prop, idx) GPIO_DT_SPEC_GET_BY_IDX(node, prop, idx),

static const struct gpio_dt_spec input1[] = {
	DT_FOREACH_PROP_ELEM(USER_NODE, input1_gpios, SPEC_ELEM)
};
static const struct gpio_dt_spec input2[] = {
	DT_FOREACH_PROP_ELEM(USER_NODE, input2_gpios, SPEC_ELEM)
};
static const struct gpio_dt_spec sao[] = {
	DT_FOREACH_PROP_ELEM(USER_NODE, sao_gpios, SPEC_ELEM)
};
static const struct gpio_dt_spec charging = GPIO_DT_SPEC_GET(USER_NODE, charging_gpios);
static const struct pwm_dt_spec backlight = PWM_DT_SPEC_GET(USER_NODE);
static const struct adc_dt_spec adc_ch[] = {
	ADC_DT_SPEC_GET_BY_IDX(USER_NODE, 0),
	ADC_DT_SPEC_GET_BY_IDX(USER_NODE, 1),
	ADC_DT_SPEC_GET_BY_IDX(USER_NODE, 2),
};
static const uint8_t adc_reg[] = {REG_ADC_VUSB, REG_ADC_VBAT, REG_TEMP};

/* Bit 5 of INPUT1 is CDONE, bit 7 SELECT; the pins above fill the others from bit 0. */
#define INPUT1_SELECT BIT(7)

static uint8_t read_pins(const struct gpio_dt_spec *pins, size_t n)
{
	uint8_t val = 0;

	for (size_t k = 0; k < n; k++) {
		if (gpio_pin_get_dt(&pins[k]) > 0) {
			val |= BIT(k);
		}
	}
	return val;
}

static void input_fn(struct k_work *work)
{
	struct k_work_delayable *dw = k_work_delayable_from_work(work);
	uint8_t v1 = read_pins(input1, ARRAY_SIZE(input1));
	uint8_t in = 0;

	if (select_pressed()) {
		v1 |= INPUT1_SELECT;
	}
	if (!fpga_cdone()) {
		v1 |= REG_INPUT1_NOT_CDONE;
	}
	/* CDONE raises no interrupt in the stock firmware either: it reads it apart. */
	regs_input(REG_INPUT1, v1, REG_INPUT1_NOT_CDONE);
	regs_input(REG_INPUT2, read_pins(input2, ARRAY_SIZE(input2)), 0);

	ARRAY_FOR_EACH(sao, k) {
		if (gpio_pin_get_dt(&sao[k]) > 0) {
			in |= BIT(k);
		}
	}
	regs_set(REG_GPIO_IN, in);
	(void)k_work_reschedule(dw, K_MSEC(INPUT_MS));
}
static K_WORK_DELAYABLE_DEFINE(input_work, input_fn);

static void adc_fn(struct k_work *work)
{
	static unsigned int next;
	struct k_work_delayable *dw = k_work_delayable_from_work(work);
	int16_t raw = 0;
	struct adc_sequence seq = {
		.buffer = &raw,
		.buffer_size = sizeof(raw),
	};

	regs_set(REG_CHARGING, gpio_pin_get_dt(&charging) > 0 ? 1U : 0U);
	if (adc_sequence_init_dt(&adc_ch[next], &seq) == 0 && adc_read_dt(&adc_ch[next], &seq) == 0) {
		regs_set(adc_reg[next], (uint8_t)raw);
		regs_set(adc_reg[next] + 1, (uint8_t)((uint16_t)raw >> 8));
	}
	next = (next + 1U) % ARRAY_SIZE(adc_ch);
	(void)k_work_reschedule(dw, K_MSEC(ADC_MS));
}
static K_WORK_DELAYABLE_DEFINE(adc_work, adc_fn);

void backlight_set(uint8_t value)
{
	(void)pwm_set_pulse_dt(&backlight, (uint32_t)((uint64_t)backlight.period * value / 255U));
}

void gpio_regs_apply(uint8_t dir, uint8_t out)
{
	ARRAY_FOR_EACH(sao, k) {
		gpio_flags_t flags = GPIO_INPUT;

		/* SAO IO0 is the PIO's while WS2812 is on. */
		if (k == 0U && regs_get(REG_WS2812_MODE) != 0U) {
			continue;
		}
		/* Input too: register 2 reads the pin back, the driver would switch that off. */
		if ((dir & BIT(k)) != 0U) {
			flags |= (out & BIT(k)) != 0U ? GPIO_OUTPUT_HIGH : GPIO_OUTPUT_LOW;
		}
		(void)gpio_pin_configure_dt(&sao[k], flags);
	}
}

int periph_init(void)
{
	int ret = 0;

	ARRAY_FOR_EACH(input1, k) {
		ret = ret != 0 ? ret : gpio_pin_configure_dt(&input1[k], GPIO_INPUT);
	}
	ARRAY_FOR_EACH(input2, k) {
		ret = ret != 0 ? ret : gpio_pin_configure_dt(&input2[k], GPIO_INPUT);
	}
	ret = ret != 0 ? ret : gpio_pin_configure_dt(&charging, GPIO_INPUT);
	if (ret != 0) {
		return ret;
	}
	gpio_regs_apply(0, 0);
	if (!pwm_is_ready_dt(&backlight)) {
		return -ENODEV;
	}
	backlight_set(255);
	ARRAY_FOR_EACH(adc_ch, k) {
		ret = adc_channel_setup_dt(&adc_ch[k]);
		if (ret != 0) {
			return ret;
		}
	}
	adc_set_temp_sensor_enabled(true);
	(void)k_work_schedule(&input_work, K_NO_WAIT);
	(void)k_work_schedule(&adc_work, K_NO_WAIT);
	return 0;
}
```

## src/pio_out.c
```c
/*
 * SPDX-License-Identifier: GPL-3.0-or-later
 *
 * WS2812 on the SAO port and the IR LED's NEC frames: the stock firmware's PIO programs, assembled
 * (the WS2812 program is Raspberry Pi's, BSD-3-Clause; the NEC ones from pico-examples, the same).
 */

#include <zephyr/device.h>
#include <zephyr/drivers/misc/pio_rpi_pico/pio_rpi_pico.h>
#include <zephyr/kernel.h>
#include <zephyr/logging/log.h>

#include <hardware/clocks.h>
#include <hardware/pio.h>

#include "coproc.h"

LOG_MODULE_REGISTER(pio_out, LOG_LEVEL_INF);

#define WS2812_PIO pio1
#define WS2812_SM  0U
#define WS2812_PIN 18U
#define WS2812_HZ  800000U
/* Instructions a bit. */
#define WS2812_CYCLES 10U

#define IR_PIO     pio0
#define IR_BURST_SM 0U
#define IR_CTRL_SM  1U
#define IR_PIN      27U

RPI_PICO_PIO_DEFINE_PROGRAM(ws2812, 0, 3,
	/* out x, 1       side 0 [2] */
	0x6221,
	/* jmp !x do_zero side 1 [1] */
	0x1123,
	/* jmp bitloop    side 1 [4] */
	0x1400,
	/* do_zero: nop   side 0 [4] */
	0xa442);

RPI_PICO_PIO_DEFINE_PROGRAM(nec_burst, 0, 4,
	/* set x, 20 */
	0xe034,
	/* wait 1 irq 7 */
	0x20c7,
	/* cycle_loop: set pins, 1 */
	0xe001,
	/* set pins, 0 [1] */
	0xe100,
	/* jmp x--, cycle_loop */
	0x0042);

RPI_PICO_PIO_DEFINE_PROGRAM(nec_control, 0, 10,
	/* pull */
	0x80a0,
	/* set x, 15 */
	0xe02f,
	/* long_burst: irq 7 */
	0xc007,
	/* jmp x--, long_burst */
	0x0042,
	/* nop [15] */
	0xaf42,
	/* irq 7 [1] */
	0xc107,
	/* data_bit: out x, 1 */
	0x6021,
	/* jmp !x, burst */
	0x0029,
	/* nop [3] */
	0xa342,
	/* burst: irq 7 */
	0xc007,
	/* jmp !osre, data_bit */
	0x00e6);

static uint ws2812_offset;
static bool ws2812_on;

void ws2812_mode(uint8_t mode)
{
	pio_sm_config c;

	pio_sm_set_enabled(WS2812_PIO, WS2812_SM, false);
	ws2812_on = mode == 1U || mode == 2U;
	if (!ws2812_on) {
		return;
	}
	c = pio_get_default_sm_config();
	sm_config_set_wrap(&c, ws2812_offset + RPI_PICO_PIO_GET_WRAP_TARGET(ws2812),
			   ws2812_offset + RPI_PICO_PIO_GET_WRAP(ws2812));
	sm_config_set_sideset(&c, 1, false, false);
	sm_config_set_sideset_pins(&c, WS2812_PIN);
	sm_config_set_out_shift(&c, false, true, mode == 2U ? 32U : 24U);
	sm_config_set_fifo_join(&c, PIO_FIFO_JOIN_TX);
	sm_config_set_clkdiv(&c, (float)clock_get_hz(clk_sys) / (WS2812_HZ * WS2812_CYCLES));
	pio_gpio_init(WS2812_PIO, WS2812_PIN);
	pio_sm_set_consecutive_pindirs(WS2812_PIO, WS2812_SM, WS2812_PIN, 1, true);
	pio_sm_init(WS2812_PIO, WS2812_SM, ws2812_offset, &c);
	pio_sm_set_enabled(WS2812_PIO, WS2812_SM, true);
}

void ws2812_put(uint32_t data)
{
	/* Off, the FIFO would fill and stay full (the stock firmware hangs there). */
	if (ws2812_on) {
		pio_sm_put_blocking(WS2812_PIO, WS2812_SM, data);
	}
}

void ir_send(uint16_t address, uint16_t data)
{
	/* A frame takes some 70 ms: one at a time, the rest wait for a free FIFO place. */
	if (!pio_sm_is_tx_fifo_full(IR_PIO, IR_CTRL_SM)) {
		pio_sm_put(IR_PIO, IR_CTRL_SM, address | ((uint32_t)data << 16));
	}
}

int pio_out_init(void)
{
	uint burst = pio_add_program(IR_PIO, RPI_PICO_PIO_GET_PROGRAM(nec_burst));
	uint ctrl = pio_add_program(IR_PIO, RPI_PICO_PIO_GET_PROGRAM(nec_control));
	const float hz = (float)clock_get_hz(clk_sys);
	pio_sm_config c;

	ws2812_offset = pio_add_program(WS2812_PIO, RPI_PICO_PIO_GET_PROGRAM(ws2812));

	/* The 38.222 kHz carrier, 4 instructions a cycle, 21 cycles to a burst. */
	c = pio_get_default_sm_config();
	sm_config_set_wrap(&c, burst + RPI_PICO_PIO_GET_WRAP_TARGET(nec_burst),
			   burst + RPI_PICO_PIO_GET_WRAP(nec_burst));
	sm_config_set_set_pins(&c, IR_PIN, 1);
	sm_config_set_clkdiv(&c, hz / (38222.0f * 4.0f));
	pio_gpio_init(IR_PIO, IR_PIN);
	pio_sm_set_consecutive_pindirs(IR_PIO, IR_BURST_SM, IR_PIN, 1, true);
	pio_sm_init(IR_PIO, IR_BURST_SM, burst, &c);
	pio_sm_set_enabled(IR_PIO, IR_BURST_SM, true);

	/* Two ticks per burst of 562.5 us. */
	c = pio_get_default_sm_config();
	sm_config_set_wrap(&c, ctrl + RPI_PICO_PIO_GET_WRAP_TARGET(nec_control),
			   ctrl + RPI_PICO_PIO_GET_WRAP(nec_control));
	sm_config_set_out_shift(&c, true, false, 32);
	sm_config_set_clkdiv(&c, hz / (2.0f / 562.5e-6f));
	pio_sm_init(IR_PIO, IR_CTRL_SM, ctrl, &c);
	pio_sm_set_enabled(IR_PIO, IR_CTRL_SM, true);
	return 0;
}
```

## src/qspi_select.c
```c
/*
 * SPDX-License-Identifier: GPL-3.0-or-later
 *
 * The SELECT button hangs on the flash's chip select (it is the RP2040's BOOTSEL), so it can only
 * be read with the flash out of use: from RAM, with every interrupt off, its pin let go for a
 * moment. After pico-examples' picoboard/button (Raspberry Pi, BSD-3-Clause). Nothing in here may
 * call into flash, and the compiler must not make a call of it: no helpers, only registers.
 */

#include <zephyr/irq.h>
#include <zephyr/kernel.h>
#include <zephyr/linker/section_tags.h>

#include <hardware/structs/ioqspi.h>
#include <hardware/structs/sio.h>

#include "coproc.h"

#define CS_INDEX 1U
/* Some 30 us at 125 MHz, for the pin to settle: 1k to the button against the pad's pull-up. */
#define SETTLE 400U

__ramfunc bool select_pressed(void)
{
	volatile uint32_t *const ctrl = &ioqspi_hw->io[CS_INDEX].ctrl;
	unsigned int key = irq_lock();
	uint32_t saved = *ctrl;
	bool released;

	*ctrl = (saved & ~IO_QSPI_GPIO_QSPI_SS_CTRL_OEOVER_BITS) |
		(IO_QSPI_GPIO_QSPI_SS_CTRL_OEOVER_VALUE_DISABLE
		 << IO_QSPI_GPIO_QSPI_SS_CTRL_OEOVER_LSB);
	for (volatile uint32_t i = 0; i < SETTLE; i++) {
	}
	released = (sio_hw->gpio_hi_in & (1U << CS_INDEX)) != 0U;
	*ctrl = saved;
	irq_unlock(key);
	return !released;
}
```

## src/regmap.c
```c
/*
 * SPDX-License-Identifier: GPL-3.0-or-later
 */

#include <string.h>

#include <zephyr/irq.h>
#include <zephyr/kernel.h>
#include <zephyr/sys/util.h>

#include <esp_sdr/mch2022_coproc.h>

#include "regmap.h"

bool regmap_read_only(uint8_t reg)
{
	switch (reg) {
	case REG_FW_VER:
	case REG_GPIO_IN:
	case REG_INPUT1:
	case REG_INPUT2:
	case REG_INTERRUPT1:
	case REG_INTERRUPT2:
	case REG_ADC_VUSB:
	case REG_ADC_VUSB + 1:
	case REG_ADC_VBAT:
	case REG_ADC_VBAT + 1:
	case REG_USB:
	case REG_CRASH_DEBUG:
	case REG_CHARGING:
	case REG_TEMP:
	case REG_TEMP + 1:
	case COPROC_REG_ID:
	case COPROC_REG_API_MAJOR:
	case COPROC_REG_API_MINOR:
	case COPROC_REG_FEATURES:
	case COPROC_REG_LINK_STATE:
	case COPROC_REG_UART0_BAUD:
	case COPROC_REG_UART0_BAUD + 1:
	case COPROC_REG_UART0_BAUD + 2:
		return true;
	default:
		return reg >= REG_UID && reg < REG_UID + 8;
	}
}

void regmap_init(struct regmap *m)
{
	memset(m, 0, sizeof(*m));
	m->regs[REG_FW_VER] = REGMAP_FW_VERSION;
	m->regs[COPROC_REG_ID] = COPROC_ID;
	m->regs[COPROC_REG_API_MAJOR] = COPROC_API_MAJOR;
	m->regs[COPROC_REG_API_MINOR] = COPROC_API_MINOR;
}

void regmap_write_start(struct regmap *m)
{
	m->address_next = true;
}

void regmap_write_byte(struct regmap *m, uint8_t val)
{
	if (m->address_next) {
		m->ptr = val;
		m->address_next = false;
		return;
	}
	if (!regmap_read_only(m->ptr)) {
		m->regs[m->ptr] = val;
		atomic_set_bit(m->modified, m->ptr);
	}
	m->ptr++;
}

uint8_t regmap_read_byte(struct regmap *m, bool *cleared)
{
	uint8_t val = m->regs[m->ptr];

	*cleared = m->ptr == REG_INTERRUPT2;
	if (*cleared) {
		m->regs[REG_INTERRUPT1] = 0;
		m->regs[REG_INTERRUPT2] = 0;
	}
	m->ptr++;
	return val;
}

int regmap_next_modified(struct regmap *m, unsigned int from)
{
	for (unsigned int reg = from; reg < ARRAY_SIZE(m->regs); reg++) {
		if (atomic_test_and_clear_bit(m->modified, reg)) {
			return (int)reg;
		}
	}
	return -1;
}

bool regmap_update_input(struct regmap *m, uint8_t reg, uint8_t value, uint8_t ignore)
{
	const uint8_t irq_reg = reg == REG_INPUT1 ? REG_INTERRUPT1 : REG_INTERRUPT2;
	unsigned int key = irq_lock();
	uint8_t changed = (m->regs[reg] ^ value) & ~ignore;

	m->regs[irq_reg] |= changed;
	m->regs[reg] = value;
	irq_unlock(key);
	return changed != 0U;
}
```
