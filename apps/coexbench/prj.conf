## CMakeLists.txt
```
# SPDX-License-Identifier: GPL-3.0-or-later

cmake_minimum_required(VERSION 3.20.0)

find_package(Zephyr REQUIRED HINTS $ENV{ZEPHYR_BASE})
project(esp_sdr_coexbench)

# USB: the CDC-ACM shell and DFU (app_usb.h).
include(${CMAKE_CURRENT_LIST_DIR}/../common/common.cmake)

target_sources(app PRIVATE src/main.c src/phylog.c src/espnow.c src/sdrwin.c)

# The PHY event log: the blob's channel calls go through src/phylog.c first; its PHY power calls
# are wrapped by the radio arbiter (CONFIG_ESP_SDR_ARB), which reports them to phylog.c.
zephyr_ld_options(
  -Wl,--wrap=phy_change_channel
  -Wl,--wrap=chip_v7_set_chan
  -Wl,--wrap=chip_v7_set_chan_misc
  -Wl,--wrap=set_chanfreq)
```

## Kconfig
```
# SPDX-License-Identifier: GPL-3.0-or-later

mainmenu "coexbench: Wi-Fi, ESP-NOW and SDR coexistence bench"

rsource "../common/Kconfig"
source "samples/subsys/usb/common/Kconfig.sample_usbd"

config COEX_LOG_ENTRIES
	int "PHY event log entries"
	default 512

source "Kconfig.zephyr"
```

## sample.yaml
```
sample:
  name: ESP-SDR Wi-Fi, ESP-NOW and SDR coexistence bench
  description: >-
    Station Wi-Fi with the net shell, ESP-NOW, passive and forced SDR bursts and a log of the
    blob's PHY power and channel calls
common:
  tags: esp-sdr
  build_only: true
tests:
  sample.esp_sdr.coexbench.s3:
    sysbuild: true
    platform_allow:
      - xiao_esp32s3/esp32s3/procpu
    integration_platforms:
      - xiao_esp32s3/esp32s3/procpu
```

## prj.conf
```kconfig
# SPDX-License-Identifier: GPL-3.0-or-later
#
# Wi-Fi driver (station, DHCP, net and wifi shell) plus lib/esp_sdr sharing the radio with it.

CONFIG_NETWORKING=y
CONFIG_WIFI=y
CONFIG_NET_L2_WIFI_SHELL=y
CONFIG_NET_IPV4=y
CONFIG_NET_IPV6=n
CONFIG_NET_DHCPV4=y
CONFIG_NET_UDP=y
CONFIG_NET_TCP=y
CONFIG_NET_SHELL=y
CONFIG_NET_STATISTICS=y
CONFIG_NET_MAX_CONTEXTS=10
CONFIG_NET_PKT_RX_COUNT=10
CONFIG_NET_PKT_TX_COUNT=10
CONFIG_NET_BUF_RX_COUNT=20
CONFIG_NET_BUF_TX_COUNT=20
CONFIG_NET_MGMT_EVENT_QUEUE_TIMEOUT=5000
CONFIG_NET_MGMT_EVENT_QUEUE_SIZE=16
CONFIG_NET_MGMT_EVENT_INFO=y
CONFIG_WIFI_LOG_LEVEL_ERR=y

# Wi-Fi keeps its power save, mode and channel: the SDR only samples (esp_sdr_rx_set_passive()).
CONFIG_ESP_SDR=y
CONFIG_ESP_SDR_WIFI_SHARED=y
# The radio arbiter: coex sdr takes the radio in Wi-Fi's sleep windows, captures need a claim.
CONFIG_ESP_SDR_ARB=y

CONFIG_SHELL=y
CONFIG_LOG=y
CONFIG_LOG_MODE_DEFERRED=y
CONFIG_MAIN_STACK_SIZE=4096
CONFIG_SHELL_STACK_SIZE=6144
CONFIG_PICOLIBC_IO_FLOAT=y
CONFIG_CBPRINTF_FP_SUPPORT=y
```

## socs/esp32s3_procpu.conf
```kconfig
# main() starts the USB shell and DFU (app_usb_init()).
CONFIG_FPU=y
CONFIG_FPU_SHARING=y
CONFIG_RESET_ON_FATAL_ERROR=y

# USB device on the OTG port: shell on CDC-ACM, DFU with sysbuild/MCUboot.
CONFIG_USB_DEVICE_STACK_NEXT=y
CONFIG_SAMPLE_USBD_PRODUCT="ESP-SDR coexbench"
CONFIG_SAMPLE_USBD_PID=0x0005
CONFIG_USBD_LOG_LEVEL_WRN=y
CONFIG_UDC_DRIVER_LOG_LEVEL_WRN=y
CONFIG_USBD_CDC_ACM_CLASS=y
# CDC-ACM carries the console and the shell: its own logging must stay off
# (doc/dev/testing.md: usbd_cdc_acm.c's #warning is fatal under twister).
CONFIG_USBD_CDC_ACM_LOG_LEVEL_OFF=y
CONFIG_CDC_ACM_SERIAL_INITIALIZE_AT_BOOT=n
CONFIG_LOG_BACKEND_UART=n
CONFIG_USBD_CDC_ACM_WORKQUEUE=y
CONFIG_KERNEL_SHELL=y
CONFIG_SHELL_BACKEND_SERIAL_LOG_MESSAGE_QUEUE_SIZE=256

# SMP for the window worker on CPU 1 (coex sdr); Wi-Fi's thread, timers and MAC interrupt stay on
# CPU 0. No ring here: its three 64 KiB banks and Wi-Fi's stacks do not fit DRAM together (cutting
# the stacks to 1 KiB double-faulted CPU 1 on association), so coex sdr uses bursts. Ring windows
# run under multiapp, where Wi-Fi and the radio are modules.
CONFIG_SMP=y
CONFIG_SCHED_CPU_MASK=y

# The Wi-Fi heap in the octal PSRAM (as osmosdr).
CONFIG_ESP_SPIRAM=y
CONFIG_SPIRAM_MODE_OCT=y
CONFIG_ESP_WIFI_HEAP_SPIRAM=y
```

## socs/esp32s3_procpu.overlay
```dts
/*
 * SPDX-License-Identifier: GPL-3.0-or-later
 */

#define APP_SHELL_LABEL "ESP-SDR coexbench shell"
#include "../../common/boards/s3_cdc_shell.dtsi"
```

## src/main.c
```c
/*
 * SPDX-License-Identifier: GPL-3.0-or-later
 *
 * coexbench: Wi-Fi (station, net shell, wifi shell) beside lib/esp_sdr on one S3 radio.
 * Shell: "coex ps|listen|chan|cap|sdr|arb|log", "espnow ..." (espnow.c), the net and wifi shells.
 */

#include <errno.h>
#include <math.h>
#include <stdlib.h>
#include <string.h>

#include <zephyr/app_version.h>
#include <zephyr/kernel.h>
#include <zephyr/net/net_if.h>
#include <zephyr/net/net_mgmt.h>
#include <zephyr/shell/shell.h>
#include <zephyr/sys/util.h>

#include <esp_wifi.h>

#include <esp_sdr/esp_sdr.h>
#include <esp_sdr/esp_sdr_arb.h>
#include <esp_sdr/esp_sdr_rx.h>

#include "app_usb.h"
#include "coex.h"

#define CAP_RATE    ESP_SDR_RATE_40MSPS
#define CAP_SAMPLES 4096U
#define FULLSCALE   512.0f

void coex_channel_refresh(void)
{
	uint8_t primary = 0;
	wifi_second_chan_t second;

	if (esp_wifi_get_channel(&primary, &second) == ESP_OK) {
		phylog_set_channel(primary);
		/* The arbiter makes no driver call of its own (esp_sdr_arb.h). */
		esp_sdr_arb_wifi_set_channel(primary, (int)second);
	}
}

uint32_t coex_chan_mhz(uint8_t chan)
{
	return chan == 14U ? 2484U : 2407U + 5U * chan;
}

static int cmd_ps(const struct shell *sh, size_t argc, char **argv)
{
	wifi_ps_type_t type;
	esp_err_t err;

	if (strcmp(argv[1], "none") == 0) {
		type = WIFI_PS_NONE;
	} else if (strcmp(argv[1], "min") == 0) {
		type = WIFI_PS_MIN_MODEM;
	} else if (strcmp(argv[1], "max") == 0) {
		type = WIFI_PS_MAX_MODEM;
	} else {
		return -EINVAL;
	}
	err = esp_wifi_set_ps(type);
	if (err == ESP_OK) {
		err = esp_wifi_get_ps(&type);
	}
	shell_print(sh, "ps now %d (0 none, 1 min, 2 max): %d", (int)type, err);
	return err == ESP_OK ? 0 : -EIO;
}

/* Applies at the next association, and only with MAX modem sleep. */
static int cmd_listen(const struct shell *sh, size_t argc, char **argv)
{
	wifi_config_t cfg;
	esp_err_t err = esp_wifi_get_config(WIFI_IF_STA, &cfg);

	if (err == ESP_OK) {
		cfg.sta.listen_interval = (uint16_t)atoi(argv[1]);
		err = esp_wifi_set_config(WIFI_IF_STA, &cfg);
	}
	shell_print(sh, "listen interval %s: %d", argv[1], err);
	return err == ESP_OK ? 0 : -EIO;
}

static int cmd_chan(const struct shell *sh, size_t argc, char **argv)
{
	coex_channel_refresh();
	shell_print(sh, "channel %u (%u MHz)", phylog_channel(), coex_chan_mhz(phylog_channel()));
	return 0;
}

static int cmd_cap(const struct shell *sh, size_t argc, char **argv)
{
	int n = atoi(argv[1]);
	bool forced = argc > 2 && strcmp(argv[2], "forced") == 0;
	int interval = argc > 3 ? atoi(argv[3]) : 0;
	float pmin = 1e30f, pmax = -1e30f, psum = 0.0f;
	int ok = 0, ret;

	if (n < 1 || (argc > 2 && !forced && strcmp(argv[2], "passive") != 0)) {
		return -EINVAL;
	}
	coex_channel_refresh();
	if (phylog_channel() == 0U) {
		shell_error(sh, "no Wi-Fi channel");
		return -ENODEV;
	}
	/* Forced: the SDR owns the front end and the PLL in each capture's window. */
	(void)esp_sdr_rx_set_passive(!forced);
	if (forced) {
		ret = esp_sdr_set_freq(coex_chan_mhz(phylog_channel()));
		if (ret != 0) {
			shell_error(sh, "set_freq %d", ret);
		}
	}
	for (int i = 0; i < n; i++) {
		struct esp_sdr_rx_burst b;
		int64_t t0 = k_uptime_get();
		uint32_t wall;
		float acc = 0.0f, db;
		unsigned int peak = 0;
		int agc = esp_sdr_rx_agc_index();

		/* Forced: a radio window of its own (the arbiter), one capture long. */
		ret = forced ? esp_sdr_arb_claim(K_MSEC(2000), NULL) : 0;
		if (ret == 0) {
			ret = esp_sdr_rx_capture(CAP_RATE, CAP_SAMPLES, &b);
			if (forced) {
				esp_sdr_arb_release();
			}
		}
		wall = (uint32_t)(k_uptime_get() - t0);
		if (ret != 0) {
			shell_print(sh, "cap %d: error %d", i, ret);
		} else {
			for (size_t j = 0; j < b.count; j++) {
				int si = esp_sdr_rx_i(b.words[j]), sq = esp_sdr_rx_q(b.words[j]);

				acc += (float)(si * si + sq * sq);
				peak = MAX(peak, (unsigned int)MAX(abs(si), abs(sq)));
			}
			acc /= (float)b.count;
			db = 10.0f * log10f(MAX(acc, 1e-3f) / (FULLSCALE * FULLSCALE));
			pmin = MIN(pmin, db);
			pmax = MAX(pmax, db);
			psum += db;
			ok++;
			shell_print(sh, "cap %d %s ch %u: %.1f dBFS peak %u agc %d burst %u us wall %u ms",
				    i, forced ? "forced" : "passive", phylog_channel(), (double)db,
				    peak, agc, b.elapsed_us, wall);
		}
		if (interval > 0) {
			k_sleep(K_MSEC(interval));
		}
	}
	if (ok > 0) {
		shell_print(sh, "%d of %d ok, power min %.1f mean %.1f max %.1f dBFS", ok, n,
			    (double)pmin, (double)(psum / ok), (double)pmax);
	}
	/* Back to passive: the AGC owns the gain, the PHY's filter codes return. */
	(void)esp_sdr_rx_set_passive(true);
	return ok == n ? 0 : -EIO;
}

static int cmd_log(const struct shell *sh, size_t argc, char **argv)
{
	return phylog_shell(sh, argc > 1 && strcmp(argv[1], "clear") == 0);
}

SHELL_STATIC_SUBCMD_SET_CREATE(
	coex_cmds,
	SHELL_CMD_ARG(ps, NULL, "none|min|max: esp_wifi_set_ps()", cmd_ps, 2, 0),
	SHELL_CMD_ARG(listen, NULL, "<n> listen interval in beacons (next association)", cmd_listen,
		      2, 0),
	SHELL_CMD_ARG(chan, NULL, "Wi-Fi primary channel", cmd_chan, 1, 0),
	SHELL_CMD_ARG(cap, NULL, "<n> [passive|forced] [interval_ms] burst captures", cmd_cap, 2, 2),
	SHELL_CMD_ARG(sdr, NULL,
		      "<seconds> [ring|burst] [freq_mhz] SDR windows in Wi-Fi's sleep (arbiter)",
		      coex_cmd_sdr, 2, 2),
	SHELL_CMD_ARG(arb, NULL, "[clear] radio arbiter counters", coex_cmd_arb, 1, 1),
	SHELL_CMD_ARG(log, NULL, "[clear] PHY event log and statistics", cmd_log, 1, 1),
	SHELL_SUBCMD_SET_END);
SHELL_CMD_REGISTER(coex, &coex_cmds, "Coexistence bench", NULL);

int main(void)
{
	int ret;

	if (app_usb_init() != 0) {
		printk("USB failed\n");
	}
	printk("coexbench %s\n", APP_VERSION_STRING);
	/* Before init: the first retune would force the front end. Captures sample until asked. */
	(void)esp_sdr_rx_set_passive(true);
	ret = esp_sdr_init();
	if (ret != 0) {
		printk("esp_sdr_init failed (%d)\n", ret);
	}
	return 0;
}
```

## src/coex.h
```c
/*
 * SPDX-License-Identifier: GPL-3.0-or-later
 */

#ifndef COEXBENCH_COEX_H_
#define COEXBENCH_COEX_H_

#include <stdint.h>

#include <zephyr/shell/shell.h>

/* The Wi-Fi primary channel the log stamps its entries with (0: unknown). */
void phylog_set_channel(uint8_t chan);
uint8_t phylog_channel(void);

/* "coex log [clear]": the entries and the statistics. */
int phylog_shell(const struct shell *sh, bool clear);

/* Refresh the cached channel from the driver (thread context only). */
void coex_channel_refresh(void);

/* Centre frequency of a 2.4 GHz Wi-Fi channel, MHz. */
uint32_t coex_chan_mhz(uint8_t chan);

/* "coex sdr <seconds> [ring|burst] [freq_mhz]" and "coex arb [clear]" (sdrwin.c). */
int coex_cmd_sdr(const struct shell *sh, size_t argc, char **argv);
int coex_cmd_arb(const struct shell *sh, size_t argc, char **argv);

/* ESP-NOW shell commands are registered by espnow.c. */

#endif
```

## src/espnow.c
```c
/*
 * SPDX-License-Identifier: GPL-3.0-or-later
 *
 * "espnow": ESP-NOW between two boards running this image (libespnow is linked with the Wi-Fi
 * blobs, nothing gates it in Kconfig).
 */

#include <errno.h>
#include <stdlib.h>
#include <string.h>

#include <zephyr/kernel.h>
#include <zephyr/shell/shell.h>
#include <zephyr/sys/atomic.h>

#include <esp_now.h>
#include <esp_wifi.h>

#include "coex.h"

static bool inited;
static uint8_t peer_mac[ESP_NOW_ETH_ALEN];
static bool have_peer;
static atomic_t rx_count, rx_bytes, tx_ok, tx_fail;
static volatile int rx_rssi;
static struct k_sem send_done;

static void on_recv(const esp_now_recv_info_t *info, const uint8_t *data, int len)
{
	ARG_UNUSED(data);
	atomic_inc(&rx_count);
	atomic_add(&rx_bytes, len);
	if (info->rx_ctrl != NULL) {
		rx_rssi = info->rx_ctrl->rssi;
	}
}

static void on_send(const esp_now_send_info_t *info, esp_now_send_status_t status)
{
	ARG_UNUSED(info);
	atomic_inc(status == ESP_NOW_SEND_SUCCESS ? &tx_ok : &tx_fail);
	k_sem_give(&send_done);
}

static int need_init(const struct shell *sh)
{
	if (!inited) {
		shell_error(sh, "espnow init first");
		return -ENODEV;
	}
	return 0;
}

static int cmd_init(const struct shell *sh, size_t argc, char **argv)
{
	wifi_mode_t mode;
	esp_err_t err;
	uint8_t mac[6];

	if (inited) {
		shell_print(sh, "already initialised");
		return 0;
	}
	err = esp_wifi_get_mode(&mode);
	if (err == ESP_OK && mode == ESP32_WIFI_MODE_NULL) {
		/* The driver starts Wi-Fi in NULL mode: STA, without connecting. */
		err = esp_wifi_set_mode(ESP32_WIFI_MODE_STA);
	}
	if (err != ESP_OK) {
		shell_error(sh, "wifi mode: %d", err);
		return -EIO;
	}
	err = esp_now_init();
	if (err != ESP_OK) {
		shell_error(sh, "esp_now_init: %d", err);
		return -EIO;
	}
	k_sem_init(&send_done, 0, 1);
	(void)esp_now_register_recv_cb(on_recv);
	(void)esp_now_register_send_cb(on_send);
	inited = true;
	(void)esp_wifi_get_mac(WIFI_IF_STA, mac);
	shell_print(sh, "espnow up, own mac %02x:%02x:%02x:%02x:%02x:%02x", mac[0], mac[1], mac[2],
		    mac[3], mac[4], mac[5]);
	return 0;
}

static int cmd_peer(const struct shell *sh, size_t argc, char **argv)
{
	esp_now_peer_info_t peer = {.channel = 0, .ifidx = WIFI_IF_STA, .encrypt = false};
	unsigned int m[6];
	esp_err_t err;

	if (need_init(sh) != 0) {
		return -ENODEV;
	}
	if (sscanf(argv[1], "%x:%x:%x:%x:%x:%x", &m[0], &m[1], &m[2], &m[3], &m[4], &m[5]) != 6) {
		shell_error(sh, "mac as aa:bb:cc:dd:ee:ff");
		return -EINVAL;
	}
	for (int i = 0; i < 6; i++) {
		peer_mac[i] = m[i];
		peer.peer_addr[i] = m[i];
	}
	if (have_peer) {
		(void)esp_now_del_peer(peer_mac);
	}
	err = esp_now_add_peer(&peer);
	if (err != ESP_OK && err != ESP_ERR_ESPNOW_EXIST) {
		shell_error(sh, "add_peer: %d", err);
		return -EIO;
	}
	have_peer = true;
	shell_print(sh, "peer set (channel: the current one)");
	return 0;
}

static int cmd_send(const struct shell *sh, size_t argc, char **argv)
{
	static uint8_t payload[ESP_NOW_MAX_DATA_LEN];
	int count = atoi(argv[1]), interval = atoi(argv[2]);
	int bytes = argc > 3 ? atoi(argv[3]) : 16;
	int refused = 0;
	int64_t t0 = k_uptime_get();
	uint32_t ok0, fail0;

	if (need_init(sh) != 0) {
		return -ENODEV;
	}
	if (!have_peer || count < 1 || interval < 0 || bytes < 1 || bytes > ESP_NOW_MAX_DATA_LEN) {
		shell_error(sh, "peer first; send <count> <interval_ms> [bytes 1..%d]",
			    ESP_NOW_MAX_DATA_LEN);
		return -EINVAL;
	}
	ok0 = atomic_get(&tx_ok);
	fail0 = atomic_get(&tx_fail);
	k_sem_reset(&send_done);
	for (int i = 0; i < count; i++) {
		int64_t next = t0 + (int64_t)(i + 1) * interval;
		esp_err_t err;

		memset(payload, i, sizeof(payload));
		memcpy(payload, &i, sizeof(i));
		err = esp_now_send(peer_mac, payload, bytes);
		if (err != ESP_OK) {
			refused++;
		} else {
			/* The send callback follows the air time, or the retries' end. */
			(void)k_sem_take(&send_done, K_MSEC(2000));
		}
		int64_t left = next - k_uptime_get();

		if (left > 0) {
			k_sleep(K_MSEC(left));
		}
	}
	shell_print(sh, "sent %d: callback ok %u fail %u, refused %d, %lld ms", count,
		    (uint32_t)atomic_get(&tx_ok) - ok0, (uint32_t)atomic_get(&tx_fail) - fail0,
		    refused, k_uptime_get() - t0);
	return 0;
}

static int cmd_stats(const struct shell *sh, size_t argc, char **argv)
{
	shell_print(sh, "rx %u bytes %u last rssi %d, tx ok %u fail %u", (uint32_t)atomic_get(&rx_count),
		    (uint32_t)atomic_get(&rx_bytes), rx_rssi, (uint32_t)atomic_get(&tx_ok),
		    (uint32_t)atomic_get(&tx_fail));
	if (argc > 1) {
		atomic_clear(&rx_count);
		atomic_clear(&rx_bytes);
		atomic_clear(&tx_ok);
		atomic_clear(&tx_fail);
		shell_print(sh, "cleared");
	}
	return 0;
}

/* esp_now.h: window in ms awake per interval (0..65535); esp_wifi.h: interval in ms (1..65535). */
static int cmd_window(const struct shell *sh, size_t argc, char **argv)
{
	int window = atoi(argv[1]), interval = atoi(argv[2]);
	esp_err_t err;

	if (need_init(sh) != 0) {
		return -ENODEV;
	}
	if (window < 0 || window > 65535 || interval < 1 || interval > 65535) {
		return -EINVAL;
	}
	err = esp_wifi_connectionless_module_set_wake_interval(interval);
	if (err == ESP_OK) {
		err = esp_now_set_wake_window(window);
	}
	shell_print(sh, "window %d ms every %d ms: %d", window, interval, err);
	return err == ESP_OK ? 0 : -EIO;
}

SHELL_STATIC_SUBCMD_SET_CREATE(
	espnow_cmds,
	SHELL_CMD_ARG(init, NULL, "Set STA mode if needed, start ESP-NOW", cmd_init, 1, 0),
	SHELL_CMD_ARG(peer, NULL, "<mac> unicast peer, current channel", cmd_peer, 2, 0),
	SHELL_CMD_ARG(send, NULL, "<count> <interval_ms> [bytes]", cmd_send, 3, 1),
	SHELL_CMD_ARG(stats, NULL, "[clear] rx and tx counters", cmd_stats, 1, 1),
	SHELL_CMD_ARG(window, NULL, "<window_ms> <interval_ms> wake window", cmd_window, 3, 0),
	SHELL_SUBCMD_SET_END);
SHELL_CMD_REGISTER(espnow, &espnow_cmds, "ESP-NOW bench", NULL);
```

## src/phylog.c
```c
/*
 * SPDX-License-Identifier: GPL-3.0-or-later
 *
 * A log of the Wi-Fi blob's PHY power and channel calls. The power calls come from the radio
 * arbiter's trace hook (lib/esp_sdr/src/esp_sdr_arb.c, which wraps them), the channel calls
 * through linker wraps (CMakeLists.txt): each is recorded in a ring and goes on to the real
 * function.
 */

#include <string.h>

#include <zephyr/kernel.h>
#include <zephyr/spinlock.h>
#include <zephyr/sys/util.h>

#include <esp_phy_init.h>
#include <esp_timer.h>

#include <esp_sdr/esp_sdr_arb.h>
#include <esp_sdr/esp_sdr_place.h>

#include "coex.h"

enum ev_kind {
	EV_PHY_ENABLE,
	EV_PHY_DISABLE,
	EV_CHANGE_CHANNEL,
	EV_SET_CHAN,
	EV_SET_CHAN_MISC,
	EV_SET_CHANFREQ,
	EV_SDR_CLAIM,
	EV_SDR_RELEASE,
	EV_PREEMPT,
	EV_PREEMPT_TIMEOUT,
	EV_COUNT,
};

static const char *const ev_name[EV_COUNT] = {
	"phy_enable", "phy_disable", "phy_change_channel", "chip_v7_set_chan",
	"chip_v7_set_chan_misc", "set_chanfreq", "sdr_claim", "sdr_release", "preempt",
	"preempt_timeout",
};

struct ev {
	uint64_t t_us;
	uint32_t a0;
	uint32_t a1;
	uint8_t kind;
	uint8_t isr;
	uint8_t cpu;
	uint8_t chan;
	char thread[12];
};

#define N CONFIG_COEX_LOG_ENTRIES

/* In PSRAM: the DRAM image must end below the ring's banks (socs/esp32s3_procpu.conf). */
static struct ev ring[N] ESP_SDR_DATA(BULK, ring);
static uint32_t head; /* Entries ever written. */
static uint32_t counts[EV_COUNT];
static struct k_spinlock lock;
static volatile uint8_t wifi_chan;

void phylog_set_channel(uint8_t chan)
{
	wifi_chan = chan;
}

uint8_t phylog_channel(void)
{
	return wifi_chan;
}

static void record_at(enum ev_kind kind, int64_t t_us, uint32_t a0, uint32_t a1)
{
	struct ev e = {
		.t_us = (uint64_t)t_us,
		.a0 = a0,
		.a1 = a1,
		.kind = kind,
		.isr = k_is_in_isr(),
		.cpu = arch_curr_cpu()->id,
		.chan = wifi_chan,
	};
	k_spinlock_key_t key;

	if (!e.isr) {
		const char *name = k_thread_name_get(k_current_get());

		if (name != NULL) {
			strncpy(e.thread, name, sizeof(e.thread) - 1);
		}
	}
	key = k_spin_lock(&lock);
	ring[head % N] = e;
	head++;
	counts[kind]++;
	k_spin_unlock(&lock, key);
}

static void record(enum ev_kind kind, uint32_t a0, uint32_t a1)
{
	record_at(kind, esp_timer_get_time(), a0, a1);
}

/* The arbiter's events: Wi-Fi's PHY enables and disables (a0: modem bits), the SDR's windows. */
void esp_sdr_arb_trace(enum esp_sdr_arb_event ev, int64_t t_us, uint32_t arg)
{
	static const enum ev_kind kind[] = {
		[ESP_SDR_ARB_WIFI_ENABLE] = EV_PHY_ENABLE,
		[ESP_SDR_ARB_WIFI_DISABLE] = EV_PHY_DISABLE,
		[ESP_SDR_ARB_SDR_CLAIM] = EV_SDR_CLAIM,
		[ESP_SDR_ARB_SDR_RELEASE] = EV_SDR_RELEASE,
		[ESP_SDR_ARB_PREEMPT] = EV_PREEMPT,
		[ESP_SDR_ARB_PREEMPT_TIMEOUT] = EV_PREEMPT_TIMEOUT,
	};

	record_at(kind[ev], t_us, arg, 0);
}

/*
 * The blob's channel entry points: signatures unknown, so up to six word arguments are passed
 * through (Xtensa windowed ABI: a2 to a7) and a word returned.
 */
#define WRAP_CHAN(name, kind)                                                                      \
	uint32_t __real_##name(uint32_t, uint32_t, uint32_t, uint32_t, uint32_t, uint32_t);        \
	uint32_t __wrap_##name(uint32_t a0, uint32_t a1, uint32_t a2, uint32_t a3, uint32_t a4,    \
			       uint32_t a5)                                                        \
	{                                                                                          \
		record(kind, a0, a1);                                                              \
		return __real_##name(a0, a1, a2, a3, a4, a5);                                      \
	}

WRAP_CHAN(phy_change_channel, EV_CHANGE_CHANNEL)
WRAP_CHAN(chip_v7_set_chan, EV_SET_CHAN)
WRAP_CHAN(chip_v7_set_chan_misc, EV_SET_CHAN_MISC)
WRAP_CHAN(set_chanfreq, EV_SET_CHANFREQ)

struct span {
	uint32_t n;
	uint64_t min, max, sum;
};

static void span_add(struct span *s, uint64_t v)
{
	s->min = s->n == 0U ? v : MIN(s->min, v);
	s->max = MAX(s->max, v);
	s->sum += v;
	s->n++;
}

static void span_print(const struct shell *sh, const char *what, const struct span *s)
{
	if (s->n == 0U) {
		shell_print(sh, "%s: none", what);
		return;
	}
	shell_print(sh, "%s: n %u min %llu mean %llu max %llu us", what, s->n, s->min,
		    s->sum / s->n, s->max);
}

int phylog_shell(const struct shell *sh, bool clear)
{
	struct span off = {0}, on = {0};
	uint32_t total, first, c[EV_COUNT];
	uint64_t t_dis = 0, t_en = 0;
	bool have_dis = false, have_en = false;
	k_spinlock_key_t key = k_spin_lock(&lock);

	total = head;
	memcpy(c, counts, sizeof(c));
	k_spin_unlock(&lock, key);
	first = total > N ? total - N : 0U;

	for (uint32_t i = first; i < total; i++) {
		struct ev e = ring[i % N];

		shell_print(sh, "%llu %-22s a0 %u a1 %u isr %u cpu %u thr %s ch %u", e.t_us,
			    ev_name[e.kind], e.a0, e.a1, e.isr, e.cpu, e.thread, e.chan);
		/* Wi-Fi's own bit only: the others have their own timelines. */
		if (e.kind == EV_PHY_ENABLE && (e.a0 & PHY_MODEM_WIFI)) {
			if (have_dis) {
				span_add(&off, e.t_us - t_dis);
			}
			t_en = e.t_us;
			have_en = true;
			have_dis = false;
		} else if (e.kind == EV_PHY_DISABLE && (e.a0 & PHY_MODEM_WIFI)) {
			if (have_en) {
				span_add(&on, e.t_us - t_en);
			}
			t_dis = e.t_us;
			have_dis = true;
			have_en = false;
		}
	}
	shell_print(sh, "entries %u shown %u (ring %d)", total, total - first, N);
	for (int k = 0; k < EV_COUNT; k++) {
		shell_print(sh, "count %-22s %u", ev_name[k], c[k]);
	}
	span_print(sh, "off window (enable - previous disable)", &off);
	span_print(sh, "on time (disable - enable)", &on);
	if (clear) {
		key = k_spin_lock(&lock);
		head = 0U;
		memset(counts, 0, sizeof(counts));
		k_spin_unlock(&lock, key);
		shell_print(sh, "log cleared");
	}
	return 0;
}
```

## src/sdrwin.c
```c
/*
 * SPDX-License-Identifier: GPL-3.0-or-later
 *
 * "coex sdr": the SDR in the radio arbiter's windows (claim, run to the deadline, release) while
 * Wi-Fi sleeps, and "coex arb": the arbiter's counters.
 */

#include <errno.h>
#include <stdlib.h>
#include <string.h>

#include <zephyr/kernel.h>
#include <zephyr/shell/shell.h>
#include <zephyr/sys/atomic.h>
#include <zephyr/sys/util.h>

#include <esp_sdr/esp_sdr.h>
#include <esp_sdr/esp_sdr_arb.h>
#include <esp_sdr/esp_sdr_place.h>
#include <esp_sdr/esp_sdr_ring.h>
#include <esp_sdr/esp_sdr_rx.h>

#include "coex.h"

#define CAP_RATE    ESP_SDR_RATE_40MSPS
#define CAP_SAMPLES 4096U

/* What a run counted (written by the worker thread, read after it signals done). */
struct run_result {
	uint32_t claim_ebusy, claim_eagain, claim_other, claim_canceled;
	uint32_t windows;
	/* Ring runs: ended by the window, by a failure; index gaps seen by the sink. */
	uint32_t ring_runs, ring_window_ends, ring_fail, gaps;
	uint64_t samples;
	/* Bursts taken. */
	uint32_t bursts, burst_err;
	uint32_t late_max;
	int ring_status_last;
};

static struct run_result res;
static struct k_sem done_sem;
static struct k_timer end_timer;
static volatile bool run_over;
static bool use_ring;
static uint32_t run_ms;
#if defined(CONFIG_ESP_SDR_RING)
/* The sink's own counters: it runs with interrupts masked. */
static uint64_t sink_samples, sink_next;
static uint32_t sink_gaps;
static bool sink_first;
#endif

static struct k_thread sdr_thread;
ESP_SDR_STACK_DEFINE(sdr_stack, 3072);

#if defined(CONFIG_ESP_SDR_RING)
ESP_SDR_CODE(PACED_SAMPLE, ring_sink)
static void ring_sink(void *user, const int16_t *i, const int16_t *q, size_t n, uint64_t index)
{
	ARG_UNUSED(user);
	ARG_UNUSED(i);
	ARG_UNUSED(q);
	if (!sink_first && index != sink_next) {
		sink_gaps++;
	}
	sink_first = false;
	sink_next = index + n;
	sink_samples += n;
}
#endif

static void end_expired(struct k_timer *timer)
{
	ARG_UNUSED(timer);
	run_over = true;
#if defined(CONFIG_ESP_SDR_RING)
	esp_sdr_ring_stop();
#endif
}

static void window_ring(void)
{
#if defined(CONFIG_ESP_SDR_RING)
	struct esp_sdr_ring_cfg cfg = {
		.decim = ESP_SDR_RING_DECIM_MIN * 2U,
		.sink = ring_sink,
	};
	struct esp_sdr_ring_stats st;
	int ret;

	sink_first = true;
	sink_samples = 0U;
	sink_gaps = 0U;
	ret = esp_sdr_ring_run(&cfg, &st);
	res.ring_runs++;
	res.samples += sink_samples;
	res.gaps += sink_gaps;
	res.late_max = MAX(res.late_max, st.late_max);
	res.ring_status_last = (int)st.status;
	if (st.status == ESP_SDR_RING_WINDOW) {
		res.ring_window_ends++;
	} else if (ret != 0 || st.status != ESP_SDR_RING_OK) {
		res.ring_fail++;
	}
#endif
}

static void window_burst(void)
{
	while (!esp_sdr_arb_window_over() && !run_over) {
		struct esp_sdr_rx_burst b;

		if (esp_sdr_rx_capture(CAP_RATE, CAP_SAMPLES, &b) == 0) {
			res.bursts++;
			res.samples += b.count;
		} else {
			res.burst_err++;
		}
	}
}

static void sdr_worker(void *a, void *b, void *c)
{
	ARG_UNUSED(a);
	ARG_UNUSED(b);
	ARG_UNUSED(c);

	while (!run_over) {
		int64_t deadline;
		int ret = esp_sdr_arb_claim(K_MSEC(MIN(2000U, run_ms)), &deadline);

		if (ret != 0) {
			switch (ret) {
			case -EBUSY:
				res.claim_ebusy++;
				break;
			case -EAGAIN:
				res.claim_eagain++;
				break;
			case -ECANCELED:
				res.claim_canceled++;
				break;
			default:
				res.claim_other++;
				break;
			}
			if (ret != -EBUSY && ret != -EAGAIN) {
				k_msleep(1);
			}
			continue;
		}
		res.windows++;
		if (use_ring) {
			window_ring();
		} else {
			window_burst();
		}
		esp_sdr_arb_release();
	}
	k_sem_give(&done_sem);
}

int coex_cmd_sdr(const struct shell *sh, size_t argc, char **argv)
{
	int secs = atoi(argv[1]);
	uint32_t mhz = 0U;
	struct esp_sdr_arb_stats arb;
	int64_t t0;
	int ret;

	use_ring = IS_ENABLED(CONFIG_ESP_SDR_RING);
	if (argc > 2) {
		if (strcmp(argv[2], "burst") == 0) {
			use_ring = false;
		} else if (strcmp(argv[2], "ring") != 0) {
			return -EINVAL;
		} else if (!IS_ENABLED(CONFIG_ESP_SDR_RING)) {
			shell_error(sh, "built without the ring: burst only");
			return -ENOTSUP;
		}
	}
	if (secs < 1) {
		return -EINVAL;
	}
	if (argc > 3) {
		mhz = (uint32_t)atoi(argv[3]);
	} else {
		coex_channel_refresh();
		mhz = coex_chan_mhz(phylog_channel() != 0U ? phylog_channel() : 6U);
	}
	/* The SDR owns the front end in its windows: forced, at the frequency asked. */
	(void)esp_sdr_rx_set_passive(false);
	ret = esp_sdr_set_freq(mhz);
	if (ret != 0) {
		shell_error(sh, "set_freq %u: %d", mhz, ret);
		(void)esp_sdr_rx_set_passive(true);
		return ret;
	}
	memset(&res, 0, sizeof(res));
	esp_sdr_arb_reset_stats();
	run_over = false;
	run_ms = (uint32_t)secs * 1000U;
	k_sem_init(&done_sem, 0, 1);
	k_timer_init(&end_timer, end_expired, NULL);

	k_thread_create(&sdr_thread, sdr_stack, K_KERNEL_STACK_SIZEOF(sdr_stack), sdr_worker, NULL,
			NULL, NULL, K_PRIO_COOP(2), K_FP_REGS, K_FOREVER);
	k_thread_name_set(&sdr_thread, "coex_sdr");
#if defined(CONFIG_SCHED_CPU_MASK)
	if (arch_num_cpus() > 1) {
		/* The ring masks its CPU: the other one keeps Wi-Fi's thread and interrupt. */
		k_thread_cpu_pin(&sdr_thread, 1);
	}
#endif
	t0 = k_uptime_get();
	k_timer_start(&end_timer, K_SECONDS(secs), K_NO_WAIT);
	k_thread_start(&sdr_thread);
	/* The worker ends after its last claim wait, at most 2 s past the time. */
	ret = k_sem_take(&done_sem, K_SECONDS(secs + 10));
	k_timer_stop(&end_timer);
	if (ret != 0) {
		shell_error(sh, "SDR worker did not finish");
		return -ETIMEDOUT;
	}
	(void)k_thread_join(&sdr_thread, K_SECONDS(2));
	t0 = k_uptime_get() - t0;
	(void)esp_sdr_rx_set_passive(true);

	esp_sdr_arb_get_stats(&arb);
	shell_print(sh, "%s %u MHz, %lld ms", use_ring ? "ring" : "burst", mhz, t0);
	shell_print(sh, "windows %u (claims failed: busy %u again %u other %u canceled %u)",
		    res.windows, res.claim_ebusy, res.claim_eagain, res.claim_other,
		    res.claim_canceled);
	shell_print(sh, "SDR time %llu us, duty %u.%02u %%, hold max %u us, per window %u us",
		    arb.sdr_us, (uint32_t)(arb.sdr_us * 100U / (uint64_t)(t0 * 1000)),
		    (uint32_t)(arb.sdr_us * 10000U / (uint64_t)(t0 * 1000)) % 100U,
		    arb.hold_max_us, arb.windows != 0U ? (uint32_t)(arb.sdr_us / arb.windows) : 0U);
	shell_print(sh, "samples %llu (%u bursts, %u burst errors)", res.samples, res.bursts,
		    res.burst_err);
	if (use_ring) {
		shell_print(sh, "ring runs %u: window ends %u, failures %u (last status %d), "
				"late max %u pairs, sink gaps %u",
			    res.ring_runs, res.ring_window_ends, res.ring_fail,
			    res.ring_status_last, res.late_max, res.gaps);
	}
	shell_print(sh, "preemptions %u (timeouts %u, wait max %u us), deadline misses %u",
		    arb.preempts, arb.preempt_timeouts, arb.preempt_wait_max_us,
		    arb.deadline_misses);
	return 0;
}

int coex_cmd_arb(const struct shell *sh, size_t argc, char **argv)
{
	struct esp_sdr_arb_stats s;

	esp_sdr_arb_get_stats(&s);
	shell_print(sh, "Wi-Fi: awake %d, enables %u, disables %u, learned period %u us, "
			"interval error %d..%d us",
		    esp_sdr_arb_wifi_awake(), s.wifi_on, s.wifi_off, s.period_us,
		    s.jitter_min_us == INT32_MAX ? 0 : s.jitter_min_us,
		    s.jitter_max_us == INT32_MIN ? 0 : s.jitter_max_us);
	shell_print(sh, "SDR: holds %d, windows %u, total %llu us, longest %u us, claim wait max %u us, "
			"own PHY power-up %llu us",
		    esp_sdr_arb_holds(), s.windows, s.sdr_us, s.hold_max_us, s.claim_wait_max_us,
		    s.powerup_us);
	shell_print(sh, "preemptions %u, timeouts %u, wait max %u us, deadline misses %u", s.preempts,
		    s.preempt_timeouts, s.preempt_wait_max_us, s.deadline_misses);
	if (argc > 1 && strcmp(argv[1], "clear") == 0) {
		esp_sdr_arb_reset_stats();
		shell_print(sh, "counters cleared");
	}
	return 0;
}
```
