## CMakeLists.txt
```
# SPDX-License-Identifier: GPL-3.0-or-later

cmake_minimum_required(VERSION 3.20.0)

find_package(Zephyr REQUIRED HINTS $ENV{ZEPHYR_BASE})
project(esp_sdr_rxbench)

include(${CMAKE_CURRENT_LIST_DIR}/../../lib/esp_sdr/place.cmake)

target_sources(app PRIVATE src/main.c src/rxb.c src/shell.c)
target_include_directories(app PRIVATE ${CMAKE_CURRENT_LIST_DIR}/../../include)
target_compile_options(app PRIVATE -O2)
```

## Kconfig
```
# SPDX-License-Identifier: GPL-3.0-or-later

mainmenu "ESP-SDR receive bench"

config APP_RXB_RING
	int "Claimed frames the receive interrupt can hand to the consumer (a power of two)"
	range 8 256
	default 32
	help
	  Every claimed frame is a buffer of the network stack's receive pool until the consumer
	  returns it: CONFIG_NET_BUF_RX_COUNT must cover the DMA ring (CONFIG_DWMAC_NB_RX_DESCS - 1
	  buffers are always with the MAC), this ring and the stack's own need (the build checks).
	  A frame that finds the ring full is dropped and counted, never passed to the stack.

config APP_RXB_STACK_HEADROOM
	int "Receive buffers kept for the stack (ARP, ND, ICMP, DHCP)"
	default 16

config APP_RXB_CONSUMER_CPU
	int "CPU of the consumer thread (-1: not pinned)"
	default 1
	range -1 1

config APP_RXB_CONSUMER_PRIO
	int "Priority of the consumer thread (preemptible), below the network threads"
	default 10
	help
	  The network threads run at 8 (prj.conf): ARP, ND and ping are served before the consumer
	  on its CPU, even in a flood.

config APP_RXB_RAMFUNC
	bool "Run the hook and the consumer from internal RAM"
	default y
	depends on SOC_FAMILY_ESPRESSIF_ESP32

source "Kconfig.zephyr"
```

## sample.yaml
```
sample:
  name: ESP-SDR receive bench
  description: >-
    UDP to port 4993 of the ESP32-S31 CoreBoard's gigabit Ethernet, taken from the DMA ring by
    the MAC driver's receive hook before the network stack sees it (CONFIG_ETH_DWMAC_RX_FAST),
    checked by a consumer thread on the second core
common:
  tags: esp-sdr
  platform_allow:
    - esp32s31_function_coreboard/esp32s31/hpcore
  integration_platforms:
    - esp32s31_function_coreboard/esp32s31/hpcore
tests:
  sample.esp_sdr.rxbench:
    build_only: true
```

## prj.conf
```kconfig
# Receive bench: UDP to one port taken from the MAC's DMA ring by the driver's hook.
CONFIG_LOG=y
CONFIG_LOG_MODE_DEFERRED=y
CONFIG_LOG_BUFFER_SIZE=2048
CONFIG_MAIN_STACK_SIZE=2048
CONFIG_PRINTK=y
CONFIG_SHELL=y
CONFIG_SHELL_STACK_SIZE=4096
CONFIG_KERNEL_SHELL=y
CONFIG_THREAD_NAME=y

# Ethernet: YT8531 on RGMII, the driver is the fork's DWC MAC. Gigabit, 125 MHz reference clock.
CONFIG_NETWORKING=y
CONFIG_NET_L2_ETHERNET=y
CONFIG_ETH_DRIVER=y
CONFIG_ETHERNET_LOG_LEVEL_WRN=y
CONFIG_PHY_LOG_LEVEL_WRN=y
CONFIG_MDIO_LOG_LEVEL_WRN=y
CONFIG_MDIO=y
CONFIG_ETH_DWMAC_RX_FAST=y
CONFIG_ETH_DWMAC_TX_RAMFUNC=y
# the DMA needs cache line sized and aligned buffers (64 byte lines)
CONFIG_NET_BUF_DATA_SIZE=1536
CONFIG_NET_BUF_ALIGNMENT=64
# 63 buffers with the MAC, 32 in the app's ring (CONFIG_APP_RXB_RING), the rest for the stack:
# the build checks the sum. 128 buffers are about 200 KB.
CONFIG_DWMAC_NB_RX_DESCS=64
CONFIG_NET_BUF_RX_COUNT=128
CONFIG_NET_PKT_RX_COUNT=16
CONFIG_NET_PKT_TX_COUNT=8
CONFIG_NET_BUF_TX_COUNT=8
CONFIG_DWMAC_NB_TX_DESCS=16

# Addresses: DHCPv4, IPv6 link-local and autoconfiguration. Answers ping and neighbour requests.
CONFIG_NET_IPV4=y
CONFIG_NET_IPV6=y
CONFIG_NET_UDP=y
CONFIG_NET_DHCPV4=y
CONFIG_NET_DHCPV4_INITIAL_DELAY_MAX=2
CONFIG_NET_IPV6_ND=y
CONFIG_NET_IF_UNICAST_IPV6_ADDR_COUNT=5
CONFIG_NET_IF_IPV6_PREFIX_COUNT=3
CONFIG_NET_CONFIG_SETTINGS=y
CONFIG_NET_CONFIG_NEED_IPV4=y
CONFIG_NET_CONFIG_NEED_IPV6=y
CONFIG_NET_CONFIG_MY_IPV4_ADDR=""
CONFIG_NET_CONFIG_PEER_IPV4_ADDR=""
CONFIG_NET_CONFIG_INIT_TIMEOUT=10
CONFIG_NET_SHELL=y
CONFIG_NET_STATISTICS=y
CONFIG_NET_STATISTICS_ETHERNET=y
CONFIG_NET_STATISTICS_ETHERNET_VENDOR=y

# The network threads (8) run before the consumer (10), also with a flood on the port: preemptible,
# above the system work queue.
CONFIG_SYSTEM_WORKQUEUE_PRIORITY=7
CONFIG_NET_TC_THREAD_PREEMPTIVE=y
CONFIG_NET_TC_THREAD_PRIO_CUSTOM=y
CONFIG_NET_TC_TX_THREAD_BASE_PRIO=8
CONFIG_NET_TC_RX_THREAD_BASE_PRIO=8
CONFIG_NET_MGMT_EVENT_STACK_SIZE=3072
CONFIG_NET_RX_STACK_SIZE=4096
CONFIG_NET_TX_STACK_SIZE=4096
CONFIG_HEAP_MEM_POOL_SIZE=8192

# The receive interrupt on one core, the consumer on the other.
CONFIG_SMP=y
CONFIG_MP_MAX_NUM_CPUS=2
CONFIG_SCHED_CPU_MASK=y
```

## onecore.conf
```kconfig
# One core: the consumer and the interrupt share the CPU.
CONFIG_SMP=n
CONFIG_MP_MAX_NUM_CPUS=1
CONFIG_SCHED_CPU_MASK=n
```

## txmem.conf
```kconfig
# The receive bench in the transmit image's memory layout (TCM groups 1 and 2 untouched, the image in
# group 0, buffers and stacks in group 3): west build ... -- -DEXTRA_CONF_FILE=txmem.conf
# (path relative to this app). Nothing is dropped from prj.conf.
CONFIG_ESP_SDR_S31_TXMEM=y

# 34 receive buffers of 1664 B (1536 + the 128 B net_buf): the MAC holds 15 (16 descriptors), the
# app's ring 16, the stack the rest. The build checks the sum. Alternative with a shallower ring:
# CONFIG_APP_RXB_RING=8 and CONFIG_APP_RXB_STACK_HEADROOM=10.
CONFIG_DWMAC_NB_RX_DESCS=16
CONFIG_NET_BUF_RX_COUNT=34
CONFIG_APP_RXB_RING=16
CONFIG_APP_RXB_STACK_HEADROOM=2
CONFIG_NET_BUF_TX_COUNT=4
CONFIG_NET_PKT_TX_COUNT=4
```

## boards/esp32s31_function_coreboard_esp32s31_hpcore.overlay
```dts
/*
 * SPDX-License-Identifier: GPL-3.0-or-later
 *
 * The gigabit Ethernet of the ESP32-S31-Function-CoreBoard-1: YT8531 on RGMII (GPIO4-19, MDC 5,
 * MDIO 6, PHY reset 7). TWAI shares GPIO13/14 with TX_CLK and RX_CLK. The diag16 pads (20-25,
 * 36-40, 42-44, 47, 48) are none of those.
 */

&eth {
	status = "okay";
};

&mdio {
	status = "okay";
};

&phy {
	status = "okay";
	/* Gigabit: the 125 MHz reference clock, so let the PHY offer 1000BASE-T. */
	/delete-property/ default-speeds;
};

&twai0 {
	status = "disabled";
};
```

## src/main.c
```c
/*
 * SPDX-License-Identifier: GPL-3.0-or-later
 *
 * UDP to port 4993 straight from the MAC's DMA ring, measured by a consumer thread. See
 * ../README.rst.
 */

#include <zephyr/app_version.h>
#include <zephyr/kernel.h>
#include <zephyr/logging/log.h>
#include <zephyr/net/ethernet.h>
#include <zephyr/net/net_if.h>

#include "rxb.h"
#include "rxb_proto.h"

LOG_MODULE_REGISTER(rxbench, LOG_LEVEL_INF);

void rxb_shell_init(const struct device *eth, struct net_if *iface);

int main(void)
{
	struct net_if *iface = net_if_get_first_by_type(&NET_L2_GET_NAME(ETHERNET));
	const struct device *eth;

	LOG_INF("rxbench %s", APP_VERSION_STRING);
	if (iface == NULL) {
		LOG_ERR("no Ethernet interface");
		return 0;
	}
	eth = net_if_get_device(iface);
	if (rxb_init(eth, iface) != 0) {
		return 0;
	}
	rxb_shell_init(eth, iface);
	LOG_INF("\"rxb start\" takes UDP to port %u", RXB_PORT);
	return 0;
}
```

## src/canary.c
```c
/*
 * SPDX-License-Identifier: GPL-3.0-or-later
 *
 * The "canary" shell command, for the transmit memory layout (CONFIG_ESP_SDR_S31_TXMEM):
 *   canary fill [seed]   write a pattern to TCM groups 1 and 2 (0x2F020000 to 0x2F060000)
 *   canary check         compare: a word that differs was written by something since the fill
 * Nothing of the image lives there, so after a run of rxb (DMA into group 3, both cores) every word
 * must still match. Both groups are 64 Ki words: a fill or check is a few ms.
 */

#include <stdint.h>
#include <stdlib.h>

#include <zephyr/kernel.h>
#include <zephyr/shell/shell.h>

#define GRP1 0x2F020000UL
#define GRP2 0x2F040000UL
#define GRP_END 0x2F060000UL
#define MAX_SHOWN 8U

static uint32_t filled_seed;
static bool filled;

static uint32_t pat(uintptr_t a, uint32_t seed)
{
	return (uint32_t)a * 0x9E3779B1U ^ seed;
}

static int cmd_fill(const struct shell *sh, size_t argc, char **argv)
{
	uint32_t seed = argc > 1 ? (uint32_t)strtoul(argv[1], NULL, 0) : 0xC0DEC0DEU;

	for (uintptr_t a = GRP1; a < GRP_END; a += 4U) {
		*(volatile uint32_t *)a = pat(a, seed);
	}
	filled_seed = seed;
	filled = true;
	shell_print(sh, "canary: 0x%08lx..0x%08lx filled, seed 0x%08x", GRP1, GRP_END, seed);
	return 0;
}

static int cmd_check(const struct shell *sh, size_t argc, char **argv)
{
	uint32_t bad[2] = {0, 0}, shown = 0;

	ARG_UNUSED(argc);
	ARG_UNUSED(argv);
	if (!filled) {
		shell_error(sh, "canary: not filled");
		return -EAGAIN;
	}
	for (uintptr_t a = GRP1; a < GRP_END; a += 4U) {
		uint32_t got = *(volatile uint32_t *)a, want = pat(a, filled_seed);

		if (got != want) {
			bad[a >= GRP2]++;
			if (shown++ < MAX_SHOWN) {
				shell_print(sh, "  0x%08lx: 0x%08x, filled 0x%08x", a, got, want);
			}
		}
	}
	shell_print(sh, "canary: group 1 %u words changed, group 2 %u words changed: %s", bad[0],
		    bad[1], bad[0] + bad[1] == 0U ? "PASS" : "FAIL");
	return bad[0] + bad[1] == 0U ? 0 : -EIO;
}

SHELL_STATIC_SUBCMD_SET_CREATE(canary_cmds,
	SHELL_CMD_ARG(fill, NULL, "[seed]: write the pattern to groups 1 and 2", cmd_fill, 1, 1),
	SHELL_CMD(check, NULL, "count the words that changed since the fill", cmd_check),
	SHELL_SUBCMD_SET_END);
SHELL_CMD_REGISTER(canary, &canary_cmds, "TCM groups 1 and 2 untouched: fill | check", NULL);
```

## src/rxb.c
```c
/*
 * SPDX-License-Identifier: GPL-3.0-or-later
 *
 * The receive hook (interrupt), the ring, and the consumer thread. See ../README.rst.
 *
 * Hand-over: the MAC driver calls rxb_hook() for each frame in one descriptor. A frame for the UDP
 * port is pushed on a lock-free single producer ring (the interrupt is the only producer) and
 * claimed, the buffer going back to the receive pool from the consumer; rxb_batch() wakes the
 * consumer once per interrupt. Frames not for the port are not claimed: the stack gets them as it
 * always does. A claimed frame is never passed on, even one the ring has no room for.
 */

#include <string.h>

#include <zephyr/kernel.h>
#include <zephyr/drivers/ethernet/eth_dwmac_fast.h>
#include <zephyr/logging/log.h>
#include <zephyr/net/net_if.h>
#include <zephyr/net_buf.h>

#include <esp_sdr/esp_sdr_place.h>

#include "rxb.h"
#include "rxb_parse.h"
#include "rxb_proto.h"
#include "rxb_ring.h"

LOG_MODULE_REGISTER(rxb, LOG_LEVEL_INF);

#define RING_SLOTS CONFIG_APP_RXB_RING
#define CONSUMER_STACK 2048
/* Items the consumer takes between two commits of its counters */
#define COMMIT_EVERY 32U

BUILD_ASSERT((RING_SLOTS & (RING_SLOTS - 1)) == 0, "CONFIG_APP_RXB_RING must be a power of two");
/* the MAC always holds DMA ring - 1 buffers; the ring and the stack's own need come on top */
BUILD_ASSERT(CONFIG_NET_BUF_RX_COUNT >=
	     CONFIG_DWMAC_NB_RX_DESCS + RING_SLOTS + CONFIG_APP_RXB_STACK_HEADROOM,
	     "CONFIG_NET_BUF_RX_COUNT: DMA descriptors + ring + headroom for the stack");

static struct rxb_item items[RING_SLOTS];
static struct rxb_ring ring;
static struct net_if *board_iface;

static K_THREAD_STACK_DEFINE(consumer_stack, CONSUMER_STACK);
static struct k_thread consumer_thread;
static K_SEM_DEFINE(wake, 0, 1);

/*
 * The interrupt writes the hook counts (hc) and the consumer its totals, both only ever counting
 * up. A start does not zero anything: it takes a baseline of both under the lock (nothing the
 * interrupt does needs the lock), and a snapshot is the difference.
 */
static atomic_t running;
static atomic_t full_check;
static atomic_t generation;	/* bumped by start: the consumer forgets the sequence */
static struct rxb_hook_counts hc, hc_base;
static struct rxb_totals totals, totals_base;
static struct rxb_seq pos;	/* the consumer's position, copied at each commit */
static uint32_t ring_high;
static uint64_t cons_cycles, cons_cycles_base;
static uint32_t cons_pkts, cons_pkts_base;
static int64_t start_ms;
static struct k_spinlock lock;

/* In the receive interrupt, for every good frame in one descriptor: take it or leave it. */
static ESP_SDR_CODE(EVENT, rxb_hook) bool rxb_hook(const struct device *dev,
						   const struct dwmac_rx_frame *f, void *user)
{
	struct rxb_hit hit;
	struct rxb_item it;
	int ver = rxb_parse(f->data, f->len, net_if_get_link_addr(board_iface)->addr, RXB_PORT, &hit);

	ARG_UNUSED(dev);
	ARG_UNUSED(user);
	if (ver == 0) {
		return false;
	}
	if (atomic_get(&running) == 0) {
		hc.idle++;
		net_buf_unref(f->buf);
		return true;
	}
	it.buf = f->buf;
	it.len = f->len;
	it.off = hit.off;
	it.plen = hit.plen;
	if (!rxb_ring_push(&ring, &it)) {
		hc.ring_full++;
		net_buf_unref(f->buf);
		return true;
	}
	hc.taken++;
	if (ver == 4) {
		hc.ip4++;
	} else {
		hc.ip6++;
	}
	return true;
}

/* After the interrupt's frames: wake the consumer once. */
static ESP_SDR_CODE(EVENT, rxb_batch) void rxb_batch(const struct device *dev, unsigned int n,
						     void *user)
{
	ARG_UNUSED(dev);
	ARG_UNUSED(n);
	ARG_UNUSED(user);
	k_sem_give(&wake);
}

static ESP_SDR_CODE(EVENT, rxb_consume) __noinline void rxb_consume(struct rxb_seq *seq,
								    atomic_val_t *gen)
{
	struct rxb_totals loc;
	struct rxb_item it;
	uint32_t t0;
	uint64_t cycles = 0U;
	uint32_t waiting = 0U;
	bool full = atomic_get(&full_check) != 0;
	atomic_val_t now = atomic_get(&generation);
	unsigned int n = 0U;

	if (now != *gen) {
		/* a new start: the sequence begins again with the next packet */
		*gen = now;
		rxb_seq_reset(seq);
	}
	memset(&loc, 0, sizeof(loc));
	while (n < COMMIT_EVERY) {
		const uint8_t *frame;
		uint32_t s, cnt = rxb_ring_count(&ring);

		waiting = MAX(waiting, cnt);
		if (!rxb_ring_pop(&ring, &it)) {
			break;
		}
		frame = ((struct net_buf *)it.buf)->data;
		t0 = k_cycle_get_32();
		loc.pkts++;
		loc.frame_bytes += it.len;
		loc.payload_bytes += it.plen;
		if (rxb_check(frame + it.off, it.plen, full, &s)) {
			rxb_seq_track(seq, s, &loc.seq);
		} else {
			loc.bad++;
		}
		net_buf_unref(it.buf);
		cycles += k_cycle_get_32() - t0;
		n++;
	}
	if (n == 0U) {
		return;
	}
	K_SPINLOCK(&lock) {
		totals.pkts += loc.pkts;
		totals.frame_bytes += loc.frame_bytes;
		totals.payload_bytes += loc.payload_bytes;
		totals.bad += loc.bad;
		totals.seq.lost += loc.seq.lost;
		totals.seq.gaps += loc.seq.gaps;
		totals.seq.dups += loc.seq.dups;
		totals.seq.ooo += loc.seq.ooo;
		totals.seq.restarts += loc.seq.restarts;
		pos = *seq;
		ring_high = MAX(ring_high, waiting);
		cons_cycles += cycles;
		cons_pkts += n;
	}
}

static void consumer_entry(void *a, void *b, void *c)
{
	struct rxb_seq seq;
	atomic_val_t gen = atomic_get(&generation);

	ARG_UNUSED(a);
	ARG_UNUSED(b);
	ARG_UNUSED(c);
	rxb_seq_reset(&seq);
	for (;;) {
		while (rxb_ring_count(&ring) != 0U) {
			rxb_consume(&seq, &gen);
		}
		/* An outage is no reason to forget the sequence: what did not come is lost. A
		 * sender that started again is seen by its number (rxb_seq.h).
		 */
		k_sem_take(&wake, K_FOREVER);
	}
}

int rxb_init(const struct device *eth, struct net_if *iface)
{
	int ret;

	board_iface = iface;
	rxb_ring_init(&ring, items, RING_SLOTS);

	/* created stopped, pinned, then started: a running thread's pin fails silently */
	k_thread_create(&consumer_thread, consumer_stack, K_THREAD_STACK_SIZEOF(consumer_stack),
			consumer_entry, NULL, NULL, NULL, K_PRIO_PREEMPT(CONFIG_APP_RXB_CONSUMER_PRIO),
			0, K_FOREVER);
	k_thread_name_set(&consumer_thread, "rxb_consumer");
#if defined(CONFIG_SMP) && defined(CONFIG_SCHED_CPU_MASK)
	if (CONFIG_APP_RXB_CONSUMER_CPU >= 0 && arch_num_cpus() > 1) {
		ret = k_thread_cpu_pin(&consumer_thread, CONFIG_APP_RXB_CONSUMER_CPU);
		if (ret != 0) {
			LOG_ERR("pinning the consumer to CPU %d: %d", CONFIG_APP_RXB_CONSUMER_CPU,
				ret);
			return ret;
		}
	}
#endif
	k_thread_start(&consumer_thread);

	ret = dwmac_rx_hook_set(eth, rxb_hook, rxb_batch, NULL);
	if (ret != 0) {
		LOG_ERR("receive hook: %d", ret);
	}
	return ret;
}

void rxb_start(bool full)
{
	K_SPINLOCK(&lock) {
		totals_base = totals;
		hc_base = hc;
		cons_cycles_base = cons_cycles;
		cons_pkts_base = cons_pkts;
		ring_high = 0U;
		start_ms = k_uptime_get();
	}
	atomic_set(&full_check, full ? 1 : 0);
	atomic_inc(&generation);
	atomic_set(&running, 1);
	k_sem_give(&wake);
}

void rxb_stop(void)
{
	atomic_set(&running, 0);
}

void rxb_snapshot(struct rxb_snap *s)
{
	uint64_t cyc;
	uint32_t pk;

	s->running = atomic_get(&running) != 0;
	s->full_check = atomic_get(&full_check) != 0;
	s->ring_slots = RING_SLOTS;
	K_SPINLOCK(&lock) {
		s->start_ms = start_ms;
		s->t.pkts = totals.pkts - totals_base.pkts;
		s->t.frame_bytes = totals.frame_bytes - totals_base.frame_bytes;
		s->t.payload_bytes = totals.payload_bytes - totals_base.payload_bytes;
		s->t.bad = totals.bad - totals_base.bad;
		s->t.seq.lost = totals.seq.lost - totals_base.seq.lost;
		s->t.seq.gaps = totals.seq.gaps - totals_base.seq.gaps;
		s->t.seq.dups = totals.seq.dups - totals_base.seq.dups;
		s->t.seq.ooo = totals.seq.ooo - totals_base.seq.ooo;
		s->t.seq.restarts = totals.seq.restarts - totals_base.seq.restarts;
		s->pos = pos;
		s->h.taken = hc.taken - hc_base.taken;
		s->h.ip4 = hc.ip4 - hc_base.ip4;
		s->h.ip6 = hc.ip6 - hc_base.ip6;
		s->h.ring_full = hc.ring_full - hc_base.ring_full;
		s->h.idle = hc.idle - hc_base.idle;
		s->ring_high = ring_high;
		ring_high = 0U;
		cyc = cons_cycles - cons_cycles_base;
		pk = cons_pkts - cons_pkts_base;
	}
	s->consumer_us_per_pkt_x10 =
		pk == 0U ? 0U : (uint32_t)(cyc * 10U * USEC_PER_SEC / sys_clock_hw_cycles_per_sec() / pk);
}
```

## src/rxb.h
```c
/*
 * SPDX-License-Identifier: GPL-3.0-or-later
 */

#ifndef RXB_H_
#define RXB_H_

#include <stdbool.h>
#include <stdint.h>

#include <zephyr/device.h>
#include <zephyr/net/net_if.h>

#include "rxb_seq.h"

/* What the consumer counted (a snapshot gives the difference to the last start). */
struct rxb_totals {
	uint64_t pkts;
	uint64_t frame_bytes;
	uint64_t payload_bytes;
	uint32_t bad;		/* short payload or wrong pattern */
	struct rxb_seq_counts seq;
};

/* What the receive hook counted (interrupt side), since the last start. */
struct rxb_hook_counts {
	uint32_t taken;		/* frames put in the ring */
	uint32_t ip4, ip6;	/* of those, by IP version */
	uint32_t ring_full;	/* claimed and dropped: the consumer is behind */
	uint32_t idle;		/* claimed and dropped: not started */
};

struct rxb_snap {
	bool running;
	bool full_check;
	int64_t start_ms;
	struct rxb_totals t;
	struct rxb_hook_counts h;
	struct rxb_seq pos;	/* first, latest and next sequence number of the run */
	uint32_t ring_high;	/* most frames waiting in the ring since the last snapshot */
	uint32_t ring_slots;
	uint32_t consumer_us_per_pkt_x10;	/* consumer time per packet, tenths of a microsecond */
};

/*
 * Register the hook on the Ethernet device and start the consumer thread. Frames are taken for the
 * interface's current link address (read for each frame, so a changed MAC address follows).
 */
int rxb_init(const struct device *eth, struct net_if *iface);

/* Take the counters as the baseline and take frames; full_check reads every payload byte. */
void rxb_start(bool full_check);

/* Stop counting; the port stays claimed and its frames are dropped, not passed to the stack. */
void rxb_stop(void);

/* Totals, the hook's counts and the ring's high water mark (which it then resets). */
void rxb_snapshot(struct rxb_snap *s);

#endif /* RXB_H_ */
```

## src/rxb_parse.h
```c
/*
 * SPDX-License-Identifier: GPL-3.0-or-later
 *
 * Which frames the receive hook takes: Ethernet, then IPv4 (any header length, not a fragment) or
 * IPv6 (UDP straight after the fixed header: no extension headers, so no fragment header), then
 * UDP to one port, unicast to the board's MAC address. Everything else is the stack's. Plain C.
 */

#ifndef RXB_PARSE_H_
#define RXB_PARSE_H_

#include <stddef.h>
#include <stdint.h>
#include <string.h>

#define RXB_ETH_HLEN   14U
#define RXB_ETYPE_IPV4 0x0800U
#define RXB_ETYPE_IPV6 0x86ddU
#define RXB_IP_UDP     17U
#define RXB_IPV4_MINHL 20U
#define RXB_IPV6_HLEN  40U
#define RXB_UDP_HLEN   8U
/* more fragments (0x2000) and the fragment offset (0x1fff): the don't-fragment bit is no fragment */
#define RXB_IPV4_FRAG  0x3fffU

/* Where the payload sits in a taken frame. */
struct rxb_hit {
	uint16_t off;	/* of the UDP payload in the frame */
	uint16_t plen;	/* its length (from the UDP length field) */
	uint8_t ip;	/* 4 or 6 */
};

static inline uint16_t rxb_be16(const uint8_t *p)
{
	return (uint16_t)(((uint16_t)p[0] << 8) | p[1]);
}

/* 4 (IPv4) or 6 (IPv6) when the frame is UDP to port for mac, filling *hit; else 0. */
static inline int rxb_parse(const uint8_t *f, size_t len, const uint8_t mac[6], uint16_t port,
			    struct rxb_hit *hit)
{
	const uint8_t *ip;
	const uint8_t *udp;
	size_t avail, hl, ulen, room;
	uint16_t etype;
	int ver;

	if (len < RXB_ETH_HLEN || memcmp(f, mac, 6) != 0) {
		return 0;
	}
	etype = rxb_be16(f + 12);
	ip = f + RXB_ETH_HLEN;
	avail = len - RXB_ETH_HLEN;

	if (etype == RXB_ETYPE_IPV4) {
		if (avail < RXB_IPV4_MINHL || (ip[0] >> 4) != 4) {
			return 0;
		}
		hl = (size_t)(ip[0] & 0xfU) * 4U;
		room = rxb_be16(ip + 2);	/* the IP packet; the frame may be padded beyond it */
		if (hl < RXB_IPV4_MINHL || room > avail || room < hl + RXB_UDP_HLEN ||
		    ip[9] != RXB_IP_UDP || (rxb_be16(ip + 6) & RXB_IPV4_FRAG) != 0U) {
			return 0;
		}
		room -= hl;
		ver = 4;
	} else if (etype == RXB_ETYPE_IPV6) {
		if (avail < RXB_IPV6_HLEN + RXB_UDP_HLEN || (ip[0] >> 4) != 6 ||
		    ip[6] != RXB_IP_UDP) {
			return 0;
		}
		hl = RXB_IPV6_HLEN;
		room = rxb_be16(ip + 4);
		if (room > avail - hl || room < RXB_UDP_HLEN) {
			return 0;
		}
		ver = 6;
	} else {
		return 0;
	}

	udp = ip + hl;
	ulen = rxb_be16(udp + 4);
	if (rxb_be16(udp + 2) != port || ulen < RXB_UDP_HLEN || ulen > room) {
		return 0;
	}
	hit->off = (uint16_t)(RXB_ETH_HLEN + hl + RXB_UDP_HLEN);
	hit->plen = (uint16_t)(ulen - RXB_UDP_HLEN);
	hit->ip = (uint8_t)ver;
	return ver;
}

#endif /* RXB_PARSE_H_ */
```

## src/rxb_proto.h
```c
/*
 * SPDX-License-Identifier: GPL-3.0-or-later
 *
 * The payload of a rxbench packet, shared by the board and tools/udp_tx.c (plain C, no Zephyr):
 *   bytes 0..3  sequence number, big endian
 *   bytes 4..   the pattern A5 C3 5A 3C, repeated to the end (the position decides the byte)
 * A payload is at least RXB_MIN_PAYLOAD bytes.
 */

#ifndef RXB_PROTO_H_
#define RXB_PROTO_H_

#include <stdbool.h>
#include <stddef.h>
#include <stdint.h>

/* The one UDP port the board claims. */
#define RXB_PORT 4993

#define RXB_SEQ_BYTES   4U
#define RXB_MIN_PAYLOAD 8U

/* Bytes the sparse check reads at the end of a payload. */
#define RXB_TAIL_CHECK 4U

static inline uint8_t rxb_pat_byte(size_t pos)
{
	static const uint8_t pat[4] = {0xa5, 0xc3, 0x5a, 0x3c};

	return pat[(pos - RXB_SEQ_BYTES) & 3U];
}

/* Fill a payload of len bytes (at least RXB_MIN_PAYLOAD) for sequence number seq. */
static inline void rxb_fill(uint8_t *p, size_t len, uint32_t seq)
{
	p[0] = (uint8_t)(seq >> 24);
	p[1] = (uint8_t)(seq >> 16);
	p[2] = (uint8_t)(seq >> 8);
	p[3] = (uint8_t)seq;
	for (size_t i = RXB_SEQ_BYTES; i < len; i++) {
		p[i] = rxb_pat_byte(i);
	}
}

/*
 * Check a payload and return its sequence number in *seq. Sparse: the first pattern word and the
 * last RXB_TAIL_CHECK bytes (a few cycles, whatever the length); full: every byte.
 */
static inline bool rxb_check(const uint8_t *p, size_t len, bool full, uint32_t *seq)
{
	size_t from = len - RXB_TAIL_CHECK;

	if (len < RXB_MIN_PAYLOAD) {
		return false;
	}
	*seq = ((uint32_t)p[0] << 24) | ((uint32_t)p[1] << 16) | ((uint32_t)p[2] << 8) | p[3];
	for (size_t i = RXB_SEQ_BYTES; i < RXB_MIN_PAYLOAD; i++) {
		if (p[i] != rxb_pat_byte(i)) {
			return false;
		}
	}
	if (full) {
		from = RXB_MIN_PAYLOAD;
	}
	for (size_t i = from; i < len; i++) {
		if (p[i] != rxb_pat_byte(i)) {
			return false;
		}
	}
	return true;
}

#endif /* RXB_PROTO_H_ */
```

## src/rxb_ring.h
```c
/*
 * SPDX-License-Identifier: GPL-3.0-or-later
 *
 * Single producer, single consumer ring, without locks: the producer owns head and writes an
 * item before it publishes it (release), the consumer owns tail and frees a slot after it has
 * copied the item out (release). Plain C (GCC __atomic builtins) so that it builds on the host.
 */

#ifndef RXB_RING_H_
#define RXB_RING_H_

#include <stdbool.h>
#include <stdint.h>

/* One claimed frame: the buffer to give back, and where the payload is. */
struct rxb_item {
	void *buf;
	uint16_t len;	/* the frame */
	uint16_t off;	/* of the UDP payload */
	uint16_t plen;	/* of the UDP payload */
};

struct rxb_ring {
	uint32_t head;	/* next slot to write, counts up and wraps by 2^32 */
	uint32_t tail;	/* next slot to read */
	uint32_t mask;	/* slots - 1, slots a power of two */
	struct rxb_item *items;
};

static inline void rxb_ring_init(struct rxb_ring *r, struct rxb_item *items, uint32_t slots)
{
	r->head = 0U;
	r->tail = 0U;
	r->mask = slots - 1U;
	r->items = items;
}

/* Producer: false when full. */
static inline bool rxb_ring_push(struct rxb_ring *r, const struct rxb_item *it)
{
	uint32_t head = r->head;

	if (head - __atomic_load_n(&r->tail, __ATOMIC_ACQUIRE) > r->mask) {
		return false;
	}
	r->items[head & r->mask] = *it;
	__atomic_store_n(&r->head, head + 1U, __ATOMIC_RELEASE);
	return true;
}

/* Consumer: false when empty. */
static inline bool rxb_ring_pop(struct rxb_ring *r, struct rxb_item *it)
{
	uint32_t tail = r->tail;

	if (tail == __atomic_load_n(&r->head, __ATOMIC_ACQUIRE)) {
		return false;
	}
	*it = r->items[tail & r->mask];
	__atomic_store_n(&r->tail, tail + 1U, __ATOMIC_RELEASE);
	return true;
}

/* Items in the ring now (either side; a snapshot). */
static inline uint32_t rxb_ring_count(const struct rxb_ring *r)
{
	return __atomic_load_n(&r->head, __ATOMIC_ACQUIRE) -
	       __atomic_load_n(&r->tail, __ATOMIC_ACQUIRE);
}

#endif /* RXB_RING_H_ */
```

## src/rxb_seq.h
```c
/*
 * SPDX-License-Identifier: GPL-3.0-or-later
 *
 * Sequence accounting of the consumer: gaps (lost packets and gap events), duplicates (the
 * previous packet again), packets out of order (an older number than the previous one: the late
 * arrival of a packet counted as lost, so lost minus ooo is the net loss) and restarts (a number
 * more than RXB_SEQ_RESTART behind: the sender began again, counting from its own number; the
 * accounting follows it without counting a loss). Plain C.
 */

#ifndef RXB_SEQ_H_
#define RXB_SEQ_H_

#include <stdbool.h>
#include <stdint.h>

/* Further behind than this is a sender that started again, not a late packet */
#define RXB_SEQ_RESTART 65536

struct rxb_seq_counts {
	uint32_t lost;	/* sequence numbers skipped */
	uint32_t gaps;	/* skips */
	uint32_t dups;
	uint32_t ooo;
	uint32_t restarts;
};

struct rxb_seq {
	bool have;		/* a first packet has set expected */
	uint32_t expected;	/* the next number */
	uint32_t first;		/* the first number of the run, last: the latest accepted */
	uint32_t last;
};

/* Forget the history: the next packet only sets the number to expect. */
static inline void rxb_seq_reset(struct rxb_seq *s)
{
	s->have = false;
	s->expected = 0U;
}

static inline void rxb_seq_track(struct rxb_seq *s, uint32_t seq, struct rxb_seq_counts *c)
{
	int32_t d;

	if (!s->have) {
		s->have = true;
		s->expected = seq + 1U;
		s->first = seq;
		s->last = seq;
		return;
	}
	d = (int32_t)(seq - s->expected);
	if (d == 0) {
		s->expected++;
		s->last = seq;
	} else if (d > 0) {
		c->lost += (uint32_t)d;
		c->gaps++;
		s->expected = seq + 1U;
		s->last = seq;
	} else if (d == -1) {
		c->dups++;
	} else if (d < -RXB_SEQ_RESTART) {
		c->restarts++;
		s->expected = seq + 1U;
		s->first = seq;
		s->last = seq;
	} else {
		c->ooo++;
	}
}

#endif /* RXB_SEQ_H_ */
```

## src/shell.c
```c
/*
 * SPDX-License-Identifier: GPL-3.0-or-later
 *
 * The "rxb" shell command:
 *   rxb start [full]   zero the counters and take frames (full: check every payload byte)
 *   rxb stop
 *   rxb stat           rates since the last stat, totals since start, driver and MAC counters
 */

#include <string.h>

#include <zephyr/kernel.h>
#include <zephyr/drivers/ethernet/eth_dwmac_fast.h>
#include <zephyr/net/ethernet.h>
#include <zephyr/sys/barrier.h>
#include <zephyr/net/net_if.h>
#include <zephyr/shell/shell.h>

#include "rxb.h"
#include "rxb_proto.h"

/* A thread below everything per CPU: the share of the CPU the receive leaves. */
#define MAX_CPUS 2
#define SPIN_STACK 1024
/* The MMC counters kept as the start's baseline (the board's list has 20) */
#define MAX_MMC 32
#define MMC_RX_PREFIX "RX_"
#define MS_PER_S 1000

static K_THREAD_STACK_ARRAY_DEFINE(spin_stack, MAX_CPUS, SPIN_STACK);
static struct k_thread spin_thread[MAX_CPUS];
/* 64 bit: the low word alone wraps within a minute or two. Written by the spinner only. */
static volatile uint32_t spins_lo[MAX_CPUS], spins_hi[MAX_CPUS];
static uint64_t idle_per_s[MAX_CPUS], last_spins[MAX_CPUS];
static int64_t last_cpu_ms;
static unsigned int ncpu;

static const struct device *volatile eth_dev;
static struct net_if *eth_iface;

/* Baselines of the last start, and the last stat */
static struct dwmac_rx_stats base_ds, last_ds;
static uint32_t base_mmc[MAX_MMC];
static struct rxb_snap last_snap;
static int64_t last_ms;

static void spin_fn(void *a, void *b, void *c)
{
	unsigned int n = (unsigned int)(uintptr_t)a;

	ARG_UNUSED(b);
	ARG_UNUSED(c);
	for (;;) {
		if (++spins_lo[n] == 0U) {
			spins_hi[n]++;
		}
	}
}

static uint64_t spins_read(unsigned int n)
{
	uint32_t hi, lo;

	do {
		hi = spins_hi[n];
		lo = spins_lo[n];
	} while (hi != spins_hi[n]);
	return ((uint64_t)hi << 32) | lo;
}

void rxb_shell_init(const struct device *eth, struct net_if *iface)
{
	uint64_t before[MAX_CPUS];

	ncpu = MIN(arch_num_cpus(), (unsigned int)MAX_CPUS);
	for (unsigned int k = 0; k < ncpu; k++) {
		k_thread_create(&spin_thread[k], spin_stack[k], SPIN_STACK, spin_fn,
				(void *)(uintptr_t)k, NULL, NULL, K_LOWEST_APPLICATION_THREAD_PRIO, 0,
				K_FOREVER);
#if defined(CONFIG_SMP) && defined(CONFIG_SCHED_CPU_MASK)
		if (ncpu > 1 && k_thread_cpu_pin(&spin_thread[k], (int)k) != 0) {
			printk("rxbench: cannot pin the load thread %u\n", k);
		}
#endif
		k_thread_start(&spin_thread[k]);
	}
	/* idle: what the spinners get per second, measured here at boot: the board is quiet then,
	 * so "CPU free" is relative to an idle CPU (a start under load would read too low)
	 */
	for (unsigned int k = 0; k < ncpu; k++) {
		before[k] = spins_read(k);
	}
	k_msleep(MS_PER_S);
	for (unsigned int k = 0; k < ncpu; k++) {
		last_spins[k] = spins_read(k);
		idle_per_s[k] = last_spins[k] - before[k];
	}
	last_cpu_ms = k_uptime_get();
	/* the commands work from here on */
	eth_iface = iface;
	barrier_dmem_fence_full();
	eth_dev = eth;
}

/* Free CPU of each core since the last call, in percent. */
static void cpu_free(uint32_t *per_cpu)
{
	int64_t now = k_uptime_get();

	for (unsigned int k = 0; k < ncpu; k++) {
		uint64_t s = spins_read(k), d = s - last_spins[k];
		uint64_t want = idle_per_s[k] * (uint64_t)(now - last_cpu_ms) / MS_PER_S;

		last_spins[k] = s;
		per_cpu[k] = want == 0U ? 0U : (uint32_t)MIN(d * 100U / want, 100ULL);
	}
	last_cpu_ms = now;
}

/* The vendor (MMC) counters of the MAC: the RX ones, each as it counted since the baseline. */
static void mmc_read(uint32_t *out, const char **keys, unsigned int max, unsigned int *n)
{
	const struct ethernet_api *api = eth_dev->api;
	struct net_stats_eth *st;

	*n = 0U;
	if (api->get_stats_type == NULL) {
		return;
	}
	st = api->get_stats_type(eth_dev, eth_iface, ETHERNET_STATS_TYPE_VENDOR);
	if (st == NULL || st->vendor == NULL) {
		return;
	}
	for (unsigned int i = 0; i < max && st->vendor[i].key != NULL; i++) {
		out[i] = st->vendor[i].value;
		if (keys != NULL) {
			keys[i] = st->vendor[i].key;
		}
		*n = i + 1U;
	}
}

static void print_addrs(const struct shell *sh)
{
	char s[NET_INET6_ADDRSTRLEN];

	if (eth_iface->config.ip.ipv6 != NULL) {
		for (int k = 0; k < NET_IF_MAX_IPV6_ADDR; k++) {
			struct net_if_addr *a = &eth_iface->config.ip.ipv6->unicast[k];

			if (a->is_used && net_addr_ntop(NET_AF_INET6, &a->address.in6_addr, s,
							sizeof(s)) != NULL) {
				shell_print(sh, "  IPv6 %s", s);
			}
		}
	}
	if (eth_iface->config.ip.ipv4 != NULL) {
		for (int k = 0; k < NET_IF_MAX_IPV4_ADDR; k++) {
			struct net_if_addr *a = &eth_iface->config.ip.ipv4->unicast[k].ipv4;

			if (a->is_used && net_addr_ntop(NET_AF_INET, &a->address.in_addr, s,
							sizeof(s)) != NULL) {
				shell_print(sh, "  IPv4 %s", s);
			}
		}
	}
}

/* The shell is there before main() has set the bench up (the network config holds it up). */
static bool not_started(const struct shell *sh)
{
	if (eth_dev != NULL) {
		return false;
	}
	shell_error(sh, "not started");
	return true;
}

static int cmd_start(const struct shell *sh, size_t argc, char **argv)
{
	bool full = argc > 1 && strcmp(argv[1], "full") == 0;
	unsigned int n;
	uint32_t cpu[MAX_CPUS];

	if (not_started(sh)) {
		return -EAGAIN;
	}
	if (argc > 1 && !full) {
		shell_error(sh, "usage: rxb start [full]");
		return -EINVAL;
	}
	rxb_start(full);
	dwmac_rx_stats_get(eth_dev, &base_ds);
	last_ds = base_ds;
	mmc_read(base_mmc, NULL, MAX_MMC, &n);
	cpu_free(cpu);
	rxb_snapshot(&last_snap);
	last_ms = k_uptime_get();
	shell_print(sh, "taking UDP to port %u (%s check); send to:", RXB_PORT,
		    full ? "full" : "sparse");
	print_addrs(sh);
	return 0;
}

static int cmd_stop(const struct shell *sh, size_t argc, char **argv)
{
	ARG_UNUSED(argc);
	ARG_UNUSED(argv);
	if (not_started(sh)) {
		return -EAGAIN;
	}
	rxb_stop();
	shell_print(sh, "stopped: port %u frames are dropped, not passed to the stack", RXB_PORT);
	return 0;
}

static uint32_t rate_x10(uint64_t bytes, int64_t ms)
{
	return ms <= 0 ? 0U : (uint32_t)(bytes * 8U * 10U / ((uint64_t)ms * 1000U));
}

static int cmd_stat(const struct shell *sh, size_t argc, char **argv)
{
	struct rxb_snap s;
	struct dwmac_rx_stats ds;
	uint32_t cpu[MAX_CPUS] = {0};
	uint32_t mmc[MAX_MMC];
	const char *keys[MAX_MMC];
	unsigned int nmmc;
	int64_t now = k_uptime_get(), dt = now - last_ms;
	uint64_t dp, df, dpl;
	uint32_t pps, mp, mf, d_irq, d_off;

	ARG_UNUSED(argc);
	ARG_UNUSED(argv);
	if (not_started(sh)) {
		return -EAGAIN;
	}
	cpu_free(cpu);
	rxb_snapshot(&s);
	dwmac_rx_stats_get(eth_dev, &ds);
	mmc_read(mmc, keys, MAX_MMC, &nmmc);

	dp = s.t.pkts - last_snap.t.pkts;
	df = s.t.frame_bytes - last_snap.t.frame_bytes;
	dpl = s.t.payload_bytes - last_snap.t.payload_bytes;
	pps = dt <= 0 ? 0U : (uint32_t)(dp * MS_PER_S / (uint64_t)dt);
	mp = rate_x10(dpl, dt);
	mf = rate_x10(df, dt);
	d_irq = ds.irqs - last_ds.irqs;
	d_off = ds.offered - last_ds.offered;

	shell_print(sh, "rxb: %s, %s check, %lld s since start", s.running ? "running" : "stopped",
		    s.full_check ? "full" : "sparse", (now - s.start_ms) / MS_PER_S);
	shell_print(sh, "  last %lld ms: %u.%u Mb/s UDP payload, %u.%u Mb/s frames, %u packets/s",
		    dt, mp / 10U, mp % 10U, mf / 10U, mf % 10U, pps);
	shell_print(sh, "  total: %llu packets, %llu payload bytes, bad %u",
		    s.t.pkts, s.t.payload_bytes, s.t.bad);
	shell_print(sh, "  sequence: lost %u in %u gaps, duplicates %u, out of order %u "
			"(net loss %d), sender restarts %u", s.t.seq.lost, s.t.seq.gaps,
		    s.t.seq.dups, s.t.seq.ooo, (int)s.t.seq.lost - (int)s.t.seq.ooo,
		    s.t.seq.restarts);
	shell_print(sh, "  numbers: first %u, latest %u, next expected %u", s.pos.first,
		    s.pos.last, s.pos.expected);
	shell_print(sh, "  hook: %u in the ring (IPv4 %u, IPv6 %u), ring full drops %u, "
			"dropped while stopped %u", s.h.taken, s.h.ip4, s.h.ip6, s.h.ring_full,
		    s.h.idle);
	shell_print(sh, "  ring: at most %u of %u waiting, consumer %u.%u us a packet",
		    s.ring_high, s.ring_slots, s.consumer_us_per_pkt_x10 / 10U,
		    s.consumer_us_per_pkt_x10 % 10U);
	shell_print(sh, "  interrupts: %u in the interval, %u.%u frames each; since start "
			"%u interrupts, %u frames",
		    d_irq, d_irq == 0U ? 0U : d_off * 10U / d_irq / 10U,
		    d_irq == 0U ? 0U : d_off * 10U / d_irq % 10U, ds.irqs - base_ds.irqs,
		    ds.offered - base_ds.offered);
	shell_print(sh, "  pool: refills found it empty %u, MAC missed frames %u, "
			"MAC FIFO overflows %u (since start)", ds.starved - base_ds.starved,
		    ds.missed - base_ds.missed, ds.fifo_overflow - base_ds.fifo_overflow);
	shell_print(sh, "  CPU free %u %% on CPU 0, %u %% on CPU 1 (since the last stat, so a mean "
			"over the interval, idle part included)", cpu[0],
		    ncpu > 1 ? cpu[1] : 0U);
	for (unsigned int i = 0; i < nmmc; i++) {
		if (strncmp(keys[i], MMC_RX_PREFIX, strlen(MMC_RX_PREFIX)) == 0) {
			shell_print(sh, "  MMC %s %u", keys[i], mmc[i] - base_mmc[i]);
		}
	}
	last_snap = s;
	last_ds = ds;
	last_ms = now;
	return 0;
}

SHELL_STATIC_SUBCMD_SET_CREATE(rxb_cmds,
	SHELL_CMD_ARG(start, NULL, "[full]: zero the counters and take frames", cmd_start, 1, 1),
	SHELL_CMD(stop, NULL, "stop counting", cmd_stop),
	SHELL_CMD(stat, NULL, "rates, counts and counters", cmd_stat),
	SHELL_SUBCMD_SET_END);
SHELL_CMD_REGISTER(rxb, &rxb_cmds, "receive bench: start [full] | stop | stat", NULL);
```
