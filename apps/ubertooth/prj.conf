## CMakeLists.txt
```
# SPDX-License-Identifier: GPL-3.0-or-later

cmake_minimum_required(VERSION 3.20.0)

find_package(Zephyr REQUIRED HINTS $ENV{ZEPHYR_BASE})
project(esp_sdr_ubertooth)

include(${CMAKE_CURRENT_LIST_DIR}/../common/common.cmake)

target_sources(app PRIVATE
  src/gfsk_demod.c
  src/gfsk_mod.c
  src/main.c
  src/shell.c
  src/ubt_clock.c
  src/ubt_ctrl.c
  src/ubt_dev.c
  src/ubt_le.c
  src/ubt_mode.c
  src/ubt_plat.c
  src/ubt_pie.c
  src/ubt_queue.c
  src/ubt_radio.c
  src/ubt_regs.c
  src/ubt_rssi.c
  src/ubt_rx_run.c
  src/ubt_specan.c
  src/ubt_specan_run.c
  src/ubt_tx.c
  src/ubt_tx_run.c
  src/ubt_usb.c
  src/upstream/bluetooth_le.c)

# Per-sample loops of the DSP.
set_source_files_properties(src/ubt_specan.c src/gfsk_mod.c src/gfsk_demod.c src/ubt_le.c PROPERTIES COMPILE_OPTIONS "-O3")

# Only the ESP32-S3 16 bit FFT kernel of esp-dsp: its IDF scaffolding stays out (as in apps/link).
set(ESP_DSP_DIR "${WEST_TOPDIR}/modules/lib/esp-dsp")
set(ESP_DSP_FFT "${ESP_DSP_DIR}/modules/fft/fixed/dsps_fft2r_sc16_aes3.S")
if(NOT EXISTS "${ESP_DSP_FFT}")
  message(FATAL_ERROR "esp-dsp not found at ${ESP_DSP_DIR} (west project esp-dsp)")
endif()
target_sources(app PRIVATE "${ESP_DSP_FFT}")
set_source_files_properties(${ESP_DSP_FFT} PROPERTIES
  COMPILE_DEFINITIONS CONFIG_IDF_TARGET_ESP32S3=1
  INCLUDE_DIRECTORIES "${ESP_DSP_DIR}/modules/fft/include")
```

## Kconfig
```
# SPDX-License-Identifier: GPL-3.0-or-later

mainmenu "ESP-SDR Ubertooth"

choice APP_UBERTOOTH_USB_ID
	prompt "USB identity"
	default APP_UBERTOOTH_USB_ID_UBERTOOTH
	help
	  The Ubertooth host tools open only 1d50:6000, 1d50:6002 and ffff:0004.
	  1d50:6002 is Great Scott Gadgets' Ubertooth One: use it on a bench to run the
	  unmodified tools, not in a product. DFU mode keeps the project ID (2fe3:ffff).

config APP_UBERTOOTH_USB_ID_UBERTOOTH
	bool "Ubertooth One (1d50:6002)"

config APP_UBERTOOTH_USB_ID_PROJECT
	bool "Project ID (2fe3:0005): the host tools need a patch to find it"

endchoice

config APP_UBERTOOTH_API_VERSION
	hex "USB API version reported as bcdDevice"
	default 0x0107
	help
	  libubertooth refuses a device below its UBERTOOTH_API_VERSION and warns above it.

# The sample USB helper's identity follows the choice (defaults here win over its own).
config SAMPLE_USBD_VID
	default 0x1d50 if APP_UBERTOOTH_USB_ID_UBERTOOTH

config SAMPLE_USBD_PID
	default 0x6002 if APP_UBERTOOTH_USB_ID_UBERTOOTH
	default 0x0005 if APP_UBERTOOTH_USB_ID_PROJECT

rsource "../common/Kconfig"

# USB device identity (VID, PID, strings) for the sample USB helper.
source "samples/subsys/usb/common/Kconfig.sample_usbd"

source "Kconfig.zephyr"
```

## sample.yaml
```
sample:
  name: ESP-SDR Ubertooth
  description: >-
    Ubertooth One device firmware on the ESP32-S3 SDR: the USB protocol of the
    upstream host tools (ubertooth-util, -specan, -btle, ...)
common:
  tags: esp-sdr
  sysbuild: true
  platform_allow:
    - xiao_esp32s3/esp32s3/procpu
    - communicator_badge/esp32s3/procpu
  integration_platforms:
    - xiao_esp32s3/esp32s3/procpu
tests:
  # Needs a board and the upstream host tools: see the README.
  sample.esp_sdr.ubertooth:
    build_only: true
```

## prj.conf
```kconfig
# The Wi-Fi driver brings the radio up at boot; nothing may scan or connect.
CONFIG_NETWORKING=y
CONFIG_WIFI=y
CONFIG_ESP32_WIFI_STA_POWER_SAVE_NONE=y
# No IP traffic: the network stack only carries the Wi-Fi driver, minimal (fewer buffers than
# osmosdr: the transmit library and the Ubertooth modes need the internal RAM).
CONFIG_NET_IPV6=n
CONFIG_NET_IPV4=y
CONFIG_NET_PKT_RX_COUNT=4
CONFIG_NET_PKT_TX_COUNT=4
CONFIG_NET_BUF_RX_COUNT=4
CONFIG_NET_BUF_TX_COUNT=4
CONFIG_NET_RX_STACK_SIZE=1024

CONFIG_ESP_SDR=y
# Continuous receive: three dump banks, so the DRAM image ends below 0x3fcb0000.
CONFIG_ESP_SDR_RING=y
CONFIG_ESP_SDR_RING_BOX4=y
CONFIG_ESP_SDR_RX_DECIM=n
# Transmit: the DAC stream (gapless generator playback), buffers above the capture bank.
CONFIG_ESP_SDR_TX=y
CONFIG_ESP_SDR_TX_DAC_HIGH_RAM=y

# Minimal logging prints at once through printk: no logging thread, no message buffer (internal RAM
# below the ring banks is full; the app logs only from threads, never from the ring).
CONFIG_LOG=y
CONFIG_LOG_MODE_MINIMAL=y

CONFIG_FPU=y
CONFIG_FPU_SHARING=y
CONFIG_MAIN_STACK_SIZE=1536
CONFIG_ISR_STACK_SIZE=1024

CONFIG_SMP=y
CONFIG_SCHED_CPU_MASK=y

# USB device on the OTG port: the Ubertooth vendor interface first, the shell on CDC-ACM and
# DFU with sysbuild/MCUboot behind it (src/ubt_usb.c orders them).
CONFIG_USB_DEVICE_STACK_NEXT=y
CONFIG_SAMPLE_USBD_PRODUCT="ESP-SDR Ubertooth One"
CONFIG_USBD_LOG_LEVEL_WRN=y
CONFIG_UDC_DRIVER_LOG_LEVEL_WRN=y
CONFIG_USBD_THREAD_STACK_SIZE=2048
CONFIG_UDC_DWC2_STACK_SIZE=1280
CONFIG_USBD_CDC_ACM_CLASS=y
CONFIG_USBD_CDC_ACM_LOG_LEVEL_OFF=y
CONFIG_CDC_ACM_SERIAL_INITIALIZE_AT_BOOT=n

CONFIG_SHELL=y
CONFIG_KERNEL_SHELL=y
CONFIG_LOG_BACKEND_UART=n
CONFIG_SHELL_STACK_SIZE=2560
CONFIG_SHELL_CMD_BUFF_SIZE=128
CONFIG_SHELL_HISTORY=n
CONFIG_DEVICE_SHELL=n
CONFIG_DATE_SHELL=n
CONFIG_DEVMEM_SHELL=y
CONFIG_NET_L2_WIFI_SHELL=n

CONFIG_HWINFO=y
CONFIG_GPIO=y
CONFIG_REBOOT=y

# Internal RAM: three 64 KiB dump banks must fit. The Wi-Fi heap goes to the 8 MB octal PSRAM.
CONFIG_ESP_SPIRAM=y
CONFIG_SPIRAM_MODE_OCT=y
CONFIG_ESP_WIFI_HEAP_SPIRAM=y
CONFIG_ESP32_WIFI_STATIC_RX_BUFFER_NUM=4
CONFIG_ESP32_WIFI_MGMT_SBUF_NUM=8
CONFIG_ESP32_WIFI_EVENT_TASK_STACK_SIZE=1024
CONFIG_NET_MGMT_EVENT_STACK_SIZE=1024
CONFIG_HEAP_MEM_POOL_IGNORE_MIN=y
CONFIG_HEAP_MEM_POOL_SIZE=17408
CONFIG_SYS_HEAP_RUNTIME_STATS=y

CONFIG_RESET_ON_FATAL_ERROR=y
CONFIG_APP_LIVENESS_WATCHDOG=y
```

## boards/communicator_badge_procpu.overlay
```dts
/*
 * SPDX-License-Identifier: GPL-3.0-or-later
 */

/ {
	chosen {
		zephyr,console = &cdc_acm_uart0;
		zephyr,shell-uart = &cdc_acm_uart0;
	};
};

zephyr_udc0: &usb_otg {
	status = "okay";

	/* Console, shell and logs while OTG owns the USB port. */
	cdc_acm_uart0: cdc_acm_uart0 {
		compatible = "zephyr,cdc-acm-uart";
		label = "ESP-SDR Ubertooth shell";
	};
};
```

## socs/esp32s3_procpu.overlay
```dts
/*
 * SPDX-License-Identifier: GPL-3.0-or-later
 */

#define APP_SHELL_LABEL "ESP-SDR Ubertooth shell"
#include "../../common/boards/s3_cdc_shell.dtsi"
```

## src/main.c
```c
/*
 * SPDX-License-Identifier: GPL-3.0-or-later
 *
 * Ubertooth One device firmware on the ESP32-S3 SDR: the USB protocol of the
 * upstream host tools, the radio work on the ring receive and the DAC.
 */

#include <zephyr/app_version.h>
#include <zephyr/kernel.h>
#include <zephyr/logging/log.h>

#include "app_cpu.h"
#include "app_usb.h"
#include "ubt_plat.h"

LOG_MODULE_REGISTER(ubertooth, LOG_LEVEL_INF);

int main(void)
{
	printk("ubertooth %s\n", APP_VERSION_STRING);
	/* Before USB starts: its controller interrupt lands on the CPU that allocates it. */
	app_cpu_pin_system_threads(0);
	if (ubt_init() != 0) {
		LOG_ERR("init failed");
		return 0;
	}
	if (app_usb_init() != 0) {
		LOG_ERR("usb init failed");
	}
	/* Again for the threads started since (usbd, UDC). */
	k_sleep(K_MSEC(500));
	app_cpu_pin_system_threads(0);
	return 0;
}
```

## src/gfsk_demod.c
```c
/*
 * SPDX-License-Identifier: GPL-3.0-or-later
 *
 * 1 Msym/s GFSK demodulator, see gfsk_demod.h for the design.
 *
 * Indexes are sample numbers of the 4 MS/s stream (wrapping at 2^32). The full path works in
 * groups of 4 samples starting at a multiple of 4 (one symbol period): the sample loop (hot())
 * does the FIR, the discriminator and its running sum into a ring, and the power of each group;
 * run_groups() then does the per group logic (detector, burst edge, the decision cursor).
 */

#include <string.h>

#include "gfsk_demod.h"
#include "ubt_attr.h"

#ifdef GFSK_TUNABLE
#define TUNE(f, def) (gfsk_tune.f)
struct gfsk_tune gfsk_tune = {
	.disc = 2, .win = 2, .dd_k = 5, .nseed = 4, .seed_skip = 9, .el_period = 32,
	.el_shift = 2, .el_stride = 1, .sq_shift = 2, .toff = 3, .floor_up = 12,
};
#else
#define TUNE(f, def) (def)
#endif

#define DISC      TUNE(disc, 2)
#define WIN       TUNE(win, 2)
#define DD_K      TUNE(dd_k, 5)
#define NSEED     TUNE(nseed, 4)
#define SEED_SKIP TUNE(seed_skip, 9)
#define EL_PERIOD TUNE(el_period, 32)
#define EL_SHIFT  TUNE(el_shift, 2)
#define EL_STRIDE TUNE(el_stride, 1)
#define SQ_SHIFT  TUNE(sq_shift, 2)
#define TOFF      TUNE(toff, 3)
#define FLOOR_UP  TUNE(floor_up, 12)

#define RM (GFSK_RING - 1U)
#define PM (GFSK_PRING - 1U)

/* Groups without signal before a rise counts as a new burst (two groups up confirm it). */
#define IDLE_RESET 8U
/* The cursor stays this many samples ahead of the burst start estimate. */
#define LEAD_IN 8U
/* Lock threshold over the tracked noise floor: x6, 7.8 dB. */
#define FLOOR_MUL 6U
/* Power compensation for the boxcar's roll-off at the deviation, in pwr counts. */
#define PWR_COMP_BLE 1
#define PWR_COMP_BR  0

_Static_assert((GFSK_RING & (GFSK_RING - 1U)) == 0U &&
		       GFSK_RING >= 4U * (GFSK_LAT_SYMS + GFSK_CHUNK) + 12U,
	       "ring holds the look-ahead and a chunk");
_Static_assert((GFSK_PRING & (GFSK_PRING - 1U)) == 0U &&
		       GFSK_PRING >= GFSK_LAT_SYMS + GFSK_CHUNK + 4U,
	       "power ring holds the look-ahead and a chunk");
_Static_assert(GFSK_HIST >= GFSK_PRE_SAMPLES + 12U, "history covers the replay");
_Static_assert(GFSK_PRE_SAMPLES % 4U == 0U, "the replay is whole groups");

/* log2(1 + (m + 0.5) / 64) * 256 */
static const uint8_t log2_lut[64] = {
	3,   9,   14,  20,  25,  30,  36,  41,  46,  51,  56,  61,  66,  71,  75,  80,
	85,  89,  94,  98,  103, 107, 111, 116, 120, 124, 128, 132, 136, 140, 144, 148,
	152, 155, 159, 163, 167, 170, 174, 178, 181, 185, 188, 192, 195, 198, 202, 205,
	208, 212, 215, 218, 221, 224, 228, 231, 234, 237, 240, 243, 246, 249, 252, 255,
};

/* 10^(r / 20) * 2^15 */
static const uint32_t pow10_lut[20] = {
	32768,  36781,  41285,  46341,  52016,  58386,  65536,  73562,  82570,  92682,
	104032, 116772, 131072, 147123, 165140, 185364, 208064, 233544, 262144, 294245,
};

uint8_t gfsk_pwr_from_s(uint32_t s)
{
	unsigned int lz;
	uint32_t l;
	int32_t p;

	if (s == 0U) {
		return 0;
	}
	lz = (unsigned int)__builtin_clz(s);
	/* log2(s) in Q8: the exponent and the six bits after the leading one. */
	l = ((31U - lz) << 8) + log2_lut[((s << lz) >> 25) & 63U];
	/* 20 log10(s) + 25.4 = 6.0206 log2(s) + 25.4 in half dB steps relative to s = 2^29. */
	p = (int32_t)((l * 1541U + 1664780U + 32768U) >> 16);
	return (uint8_t)(p > 255 ? 255 : p);
}

uint32_t gfsk_s_from_pwr(uint8_t pwr)
{
	int32_t v = (int32_t)pwr - 200;
	int32_t qd = v >= 0 ? v / 20 : -((-v + 19) / 20);
	uint64_t s = (uint64_t)pow10_lut[v - 20 * qd] << 14;

	for (; qd > 0; qd--) {
		s *= 10U;
	}
	for (; qd < 0; qd++) {
		s /= 10U;
	}
	return s > UINT32_MAX ? UINT32_MAX : (uint32_t)s;
}

static inline uint8_t pwr_of(const struct gfsk_demod *d, uint32_t s)
{
	int p = gfsk_pwr_from_s(s) + (d->mod == GFSK_BLE ? PWR_COMP_BLE : PWR_COMP_BR);

	return (uint8_t)(p > 255 ? 255 : p);
}

struct emit {
	struct gfsk_sym *out;
	size_t cap, n;
};

static inline void emit_sym(struct emit *em, uint32_t t, unsigned int bit, uint8_t pwr)
{
	if (em->n < em->cap) {
		em->out[em->n].t = t;
		em->out[em->n].bit = (uint8_t)bit;
		em->out[em->n].pwr = pwr;
		em->n++;
	}
}

static inline uint32_t align_up4(uint32_t x)
{
	return (x + 3U) & ~3U;
}

/* Smallest index >= x whose low two bits are ph. */
static inline uint32_t align_ph(uint32_t x, unsigned int ph)
{
	return x + ((ph - x) & 3U);
}

/* Sample k of the stream relative to the buffer start; negative k reads the history. */
static inline int32_t xs(const int16_t *hist, const int16_t *buf, int32_t k)
{
	return k >= 0 ? buf[k] : hist[(int32_t)GFSK_HIST + k];
}

static inline uint32_t power_of(int32_t zi, int32_t zq)
{
	return (((uint32_t)zi * (uint32_t)zi) + ((uint32_t)zq * (uint32_t)zq)) >> 1;
}

/* z[k] = x[k] + j x[k-1] - x[k-2] - j x[k-3], straight from the samples. */
static void fir_at(const struct gfsk_demod *d, const int16_t *i, const int16_t *q, int32_t k,
		   int32_t *zi, int32_t *zq)
{
	int32_t i0 = xs(d->hi, i, k), q0 = xs(d->hq, q, k);
	int32_t i1 = xs(d->hi, i, k - 1), q1 = xs(d->hq, q, k - 1);
	int32_t i2 = xs(d->hi, i, k - 2), q2 = xs(d->hq, q, k - 2);
	int32_t i3 = xs(d->hi, i, k - 3), q3 = xs(d->hq, q, k - 3);

	*zi = i0 - q1 - i2 + q3;
	*zq = q0 + i1 - q2 - i3;
}

void gfsk_demod_init(struct gfsk_demod *d, enum gfsk_modulation mod)
{
	memset(d, 0, sizeof(*d));
	d->mod = (uint8_t)mod;
	d->always = 1;
	d->hold = 1;
	gfsk_demod_reset(d);
}

void gfsk_demod_reset(struct gfsk_demod *d)
{
	/* The configuration sits before n in the struct. */
	size_t keep = offsetof(struct gfsk_demod, n);

	memset((uint8_t *)d + keep, 0, sizeof(*d) - keep);
	d->ph = 3;
	d->open = d->always ? 1U : 0U;
	d->hold_cnt = d->hold;
}

void gfsk_demod_set_squelch(struct gfsk_demod *d, uint8_t pwr_threshold, uint16_t hold_syms,
			    bool always_emit)
{
	d->pwr_thr = pwr_threshold;
	d->hold = hold_syms < 1U ? 1U : hold_syms;
	d->always = (always_emit || pwr_threshold == 0U) ? 1U : 0U;
	if (pwr_threshold == 0U) {
		d->s_thr = d->s_close = d->s_gate = 0;
	} else {
		d->s_thr = gfsk_s_from_pwr(pwr_threshold);
		d->s_close = d->s_thr >> 1;
		d->s_gate = d->s_thr >> 1;
	}
	if (d->always && !d->open) {
		d->open = 1;
		d->front_ok = 0;
	}
	d->hold_cnt = d->hold;
}

uint8_t gfsk_demod_level(const struct gfsk_demod *d)
{
	return pwr_of(d, d->savg);
}

uint8_t gfsk_demod_noise_floor(const struct gfsk_demod *d)
{
	return pwr_of(d, d->floor);
}

int32_t gfsk_demod_cfo_hz(const struct gfsk_demod *d)
{
	/* The mean deviation of a modulated carrier is about 0.9 of the peak. */
	int32_t dev_hz = d->mod == GFSK_BLE ? 225000 : 144000;
	int32_t half = (d->m0 >> 1) - (d->m1 >> 1), mid = (d->m0 >> 1) + (d->m1 >> 1);

	if (!d->seeded || half <= 0) {
		return 0;
	}
	return (int32_t)(-((int64_t)dev_hz * mid) / half);
}

uint32_t gfsk_demod_horizon(const struct gfsk_demod *d)
{
	if (d->open && d->cur_valid) {
		return d->cur - (uint32_t)TOFF - 2U;
	}
	return d->f - GFSK_PRE_SAMPLES - 8U;
}

/* ---------------------------------------------------------------------------------------- */
/* Sampling phase, slicing                                                                  */
/* ---------------------------------------------------------------------------------------- */

/* Window sum of the discriminator ending at index c. */
static inline int32_t wsum(const struct gfsk_demod *d, uint32_t c)
{
	return (int32_t)(d->cring[c & RM] - d->cring[(c - (uint32_t)WIN) & RM]);
}

/*
 * A burst starts at about d->edge. Every packet begins with alternating symbols (the
 * preamble, and for BR its first sync bit), so the window sums of consecutive symbols differ by
 * twice the eye opening at the right phase and by less at the others: the largest difference
 * sets the phase. The mean of the sums at that phase is the middle between the two levels
 * whatever the carrier offset, and their mean distance from it the distance to each level.
 */
static void acquire(struct gfsk_demod *d)
{
	uint32_t g0 = d->edge >> 2, g, from, best_a = 0, c0, pf, half;
	unsigned int best = 0;
	int32_t mean = 0, dev = 0;
	int n = (d->mod == GFSK_BLE ? NSEED : NSEED - 1), w[8];

	/* The burst started at the first group with half the power it settles at. */
	pf = (d->pring[(g0 + 3U) & PM] >> 2) + (d->pring[(g0 + 4U) & PM] >> 2) +
	     (d->pring[(g0 + 5U) & PM] >> 2) + (d->pring[(g0 + 6U) & PM] >> 2);
	half = pf >> 1;
	for (g = g0 - 1U; g != g0 + 3U && d->pring[g & PM] < half; g++) {
	}
	from = (g << 2) + (uint32_t)SEED_SKIP;
	if ((int32_t)(from - d->start - 4U) < 0) {
		from = d->start + 4U;
	}
	n = n > 8 ? 8 : n;
	for (unsigned int p = 0; p < 4U; p++) {
		uint32_t a = 0, c = align_ph(from, p);
		int32_t prev = wsum(d, c);

		for (int j = 1; j < n; j++) {
			int32_t x = wsum(d, c + 4U * (uint32_t)j);
			int32_t dx = x - prev;

			a += (uint32_t)(dx < 0 ? -dx : dx) >> 4;
			prev = x;
		}
		if (a > best_a) {
			best_a = a;
			best = p;
		}
	}
	d->ph = (uint8_t)best;
	c0 = align_ph(from, best);
	for (int j = 0; j < n; j++) {
		w[j] = wsum(d, c0 + 4U * (uint32_t)j);
		mean += w[j] / n;
	}
	for (int j = 0; j < n; j++) {
		int32_t x = w[j] - mean;

		dev += (x < 0 ? -x : x) / n;
	}
	d->m0 = mean + dev;
	d->m1 = mean - dev;
	d->el_e = 0;
	d->el_a = 0;
	d->el_cnt = (uint8_t)EL_PERIOD;
	d->seeded = 1;
}

/*
 * The symbols at the cursor while its window ends at or before @p last: per symbol the window
 * sum against the middle of the two levels, the level the decision belongs to follows it, and
 * (while @p early: the samples after the window are there) the eye opening one sample later
 * against one sample earlier moves the sampling phase when it is clearly better on one side.
 */
static void slice_batch(struct gfsk_demod *d, struct emit *em, uint32_t last, bool early)
{
	uint32_t cur = d->cur;
	unsigned int ph = d->ph;
	int32_t m0 = d->m0, m1 = d->m1, thr = (m0 >> 1) + (m1 >> 1);
	unsigned int cnt = d->el_cnt;
	int32_t el_e = d->el_e;
	uint32_t el_a = d->el_a, en = em->n;
	const uint32_t *cr = d->cring;
	const uint8_t *wr = d->wring;
	struct gfsk_sym *out = em->out;

	while ((int32_t)(last - cur) >= 0) {
		int32_t w;
		unsigned int bit, sh;
		uint8_t pw;

		if (!d->seeded && (int32_t)(cur + LEAD_IN - d->edge) >= 0) {
			d->m0 = m0;
			d->m1 = m1;
			acquire(d);
			ph = d->ph;
			m0 = d->m0;
			m1 = d->m1;
			cnt = d->el_cnt;
			el_e = 0;
			el_a = 0;
			thr = (m0 >> 1) + (m1 >> 1);
		}
		/* Align to the sampling phase: a step of -1 to +2 samples. */
		sh = (ph - cur) & 3U;
		cur = sh == 3U ? cur - 1U : cur + sh;
		w = (int32_t)(cr[cur & RM] - cr[(cur - (uint32_t)WIN) & RM]);
		/* e = -|z|^2 sin(theta): a positive deviation is negative. */
		bit = w < thr ? 1U : 0U;
		if (bit != 0U) {
			m1 += (w - m1) >> DD_K;
		} else {
			m0 += (w - m0) >> DD_K;
		}
		if (early && EL_PERIOD != 0) {
			/* The eye opening one sample later against one sample earlier. */
			int32_t wl = (int32_t)(cr[(cur + 1U) & RM] - cr[(cur + 1U - (uint32_t)WIN) & RM]);
			int32_t we = (int32_t)(cr[(cur - 1U) & RM] - cr[(cur - 1U - (uint32_t)WIN) & RM]);
			int32_t dl = (wl - we) >> 4;
			int32_t ow = (w - thr) >> 4;

			el_e += bit != 0U ? -dl : dl;
			el_a += (uint32_t)(ow < 0 ? -ow : ow);
			if (--cnt == 0U) {
				int32_t lim = (int32_t)(el_a >> EL_SHIFT);

				cnt = (unsigned int)EL_PERIOD;
				if (el_e > lim) {
					ph = (ph + 1U) & 3U;
				} else if (el_e < -lim) {
					ph = (ph - 1U) & 3U;
				}
				el_e = 0;
				el_a = 0;
			}
		}
		thr = (m0 >> 1) + (m1 >> 1);
		pw = wr[(((cur + 1U) >> 2) - 1U) & PM];
		if (en < em->cap) {
			out[en].t = cur - (uint32_t)TOFF;
			out[en].bit = (uint8_t)bit;
			out[en].pwr = pw;
			en++;
		}
		cur += 4U;
	}
	d->cur = cur;
	d->ph = (uint8_t)ph;
	d->m0 = m0;
	d->m1 = m1;
	d->el_cnt = (uint8_t)cnt;
	d->el_e = el_e;
	d->el_a = el_a;
	d->sliced |= (uint8_t)(en != em->n);
	em->n = en;
}

/* Emit every symbol whose window the processed samples cover. */
static void flush_pending(struct gfsk_demod *d, struct emit *em)
{
	if (d->cur_valid) {
		slice_batch(d, em, d->f - 3U, false);
	}
	d->cur_valid = 0;
}

/* ---------------------------------------------------------------------------------------- */
/* Full path                                                                                */
/* ---------------------------------------------------------------------------------------- */

/* Start the full path at index f0 (a multiple of 4), from the raw samples before it. */
static void front_start(struct gfsk_demod *d, const int16_t *i, const int16_t *q, uint32_t base,
			uint32_t f0)
{
	uint32_t first = base - d->hist_n;
	int32_t k, zi, zq;

	if ((int32_t)(f0 - (first + 7U)) < 0) {
		f0 = align_up4(first + 7U);
	}
	k = (int32_t)(f0 - base);
	for (int j = 1; j <= 4; j++) {
		fir_at(d, i, q, k - j, &zi, &zq);
		if (j == 1) {
			d->zi = zi;
			d->zq = zq;
			d->a1i = zi >> 2;
			d->a1q = zq >> 2;
		} else if (j == 2) {
			d->a2i = zi >> 2;
			d->a2q = zq >> 2;
		}
#ifdef GFSK_TUNABLE
		d->ah_i[(f0 - (uint32_t)j) & 3U] = zi >> 2;
		d->ah_q[(f0 - (uint32_t)j) & 3U] = zq >> 2;
#endif
	}
	d->cs = 0;
	d->cring[(f0 - 1U) & RM] = 0;
	d->f = d->lg = d->start = f0;
	d->off = (uint8_t)IDLE_RESET;
	d->run = 0;
	d->seeded = 0;
	d->cur_valid = 0;
	d->need_cursor = 1;
	d->sliced = 0;
	d->s_init = 0;
	d->front_ok = 1;
}

/*
 * The sample loop: ng groups from the buffer position pi, pq (which is at least 4 samples into
 * the stream), starting at the index d->f, a multiple of 4. Per sample the FIR z[n] = j z[n-1] +
 * x[n] - x[n-4], the delay-2 discriminator Im(z z[n-2]*) of z >> 2 (negative for a positive
 * deviation) and its running sum into the ring; per group the power. The discriminator history
 * alternates between two register pairs by the parity of the index.
 */
#ifndef GFSK_TUNABLE
UBT_HOT static void hot(struct gfsk_demod *d, const int16_t *pi, const int16_t *pq, unsigned int ng)
{
	int32_t zi = d->zi, zq = d->zq;
	int32_t r0i = d->a2i, r0q = d->a2q, r1i = d->a1i, r1q = d->a1q;
	uint32_t cs = d->cs, f = d->f;

#define STEP(PH, RI, RQ)                                         \
	do {                                                     \
		int32_t ni = (pi[PH] - pi[(PH) - 4]) - zq;       \
		int32_t nq = (pq[PH] - pq[(PH) - 4]) + zi;       \
		int32_t ai = ni >> 2, aq = nq >> 2;              \
		zi = ni;                                         \
		zq = nq;                                         \
		cs += (uint32_t)(aq * (RI) - ai * (RQ));         \
		cr[PH] = cs;                                     \
		RI = ai;                                         \
		RQ = aq;                                         \
	} while (0)

	while (ng-- != 0U) {
		uint32_t *cr = &d->cring[f & RM];

		STEP(0, r0i, r0q);
		STEP(1, r1i, r1q);
		STEP(2, r0i, r0q);
		STEP(3, r1i, r1q);
		d->pring[(f >> 2) & PM] = power_of(zi, zq);
		pi += 4;
		pq += 4;
		f += 4U;
	}
#undef STEP
	d->zi = zi;
	d->zq = zq;
	d->a2i = r0i;
	d->a2q = r0q;
	d->a1i = r1i;
	d->a1q = r1q;
	d->cs = cs;
	d->f = f;
}

/* One sample of the same, any alignment. */
static void step1(struct gfsk_demod *d, int32_t xi, int32_t xq, int32_t xi4, int32_t xq4)
{
	uint32_t f = d->f;
	int32_t ni = (xi - xi4) - d->zq, nq = (xq - xq4) + d->zi;
	int32_t ai = ni >> 2, aq = nq >> 2;
	int32_t *ri = (f & 1U) != 0U ? &d->a1i : &d->a2i, *rq = (f & 1U) != 0U ? &d->a1q : &d->a2q;

	d->zi = ni;
	d->zq = nq;
	d->cs += (uint32_t)(aq * *ri - ai * *rq);
	d->cring[f & RM] = d->cs;
	*ri = ai;
	*rq = aq;
	d->f = f + 1U;
	if (((f + 1U) & 3U) == 0U) {
		d->pring[(f >> 2) & PM] = power_of(ni, nq);
	}
}
#else
/* The tunable build keeps the discriminator history in memory to vary its delay. */
static void step1(struct gfsk_demod *d, int32_t xi, int32_t xq, int32_t xi4, int32_t xq4)
{
	uint32_t f = d->f;
	int32_t ni = (xi - xi4) - d->zq, nq = (xq - xq4) + d->zi;
	int32_t ai = ni >> 2, aq = nq >> 2, e;
	int32_t pi = d->ah_i[(f - (uint32_t)DISC) & 3U];
	int32_t pq = d->ah_q[(f - (uint32_t)DISC) & 3U];

	d->zi = ni;
	d->zq = nq;
	switch (DISC) {
	case 1:
		e = ai * pi + aq * pq;
		break;
	case 2:
		e = aq * pi - ai * pq;
		break;
	case 3:
		e = -(ai * pi + aq * pq);
		break;
	default:
		e = -(aq * pi - ai * pq);
		break;
	}
	d->ah_i[f & 3U] = ai;
	d->ah_q[f & 3U] = aq;
	d->cs += (uint32_t)e;
	d->cring[f & RM] = d->cs;
	d->f = f + 1U;
	if (((f + 1U) & 3U) == 0U) {
		d->pring[(f >> 2) & PM] = power_of(ni, nq);
	}
}
#endif

/*
 * The groups the sample loop completed: the detector and the burst edge per group, then the
 * decisions the cursor can take. Returns true when the squelch closes (d->f is then the first
 * sample not processed).
 */
static bool run_groups(struct gfsk_demod *d, struct emit *em)
{
	uint32_t lg = d->lg, f = d->f, savg = d->savg, floor = d->floor, sgate = d->s_gate;
	uint32_t pend = d->pend, sbase = d->sbase;
	unsigned int run = d->run, off = d->off;
	bool closing = false;
	uint8_t pw_c = d->pw_c;

	while ((int32_t)(f - lg) >= 4) {
		uint32_t g = lg >> 2, p = d->pring[g & PM], savg_prev = savg;
		bool on;

		lg += 4U;
		if (!d->s_init) {
			savg = floor = p;
			d->s_init = 1;
		} else {
			savg = (uint32_t)((int32_t)savg + (((int32_t)(p - savg)) >> SQ_SHIFT));
		}
		if ((g & 3U) == 0U) {
			pw_c = pwr_of(d, savg);
		}
		d->wring[g & PM] = pw_c;

		/* Burst edge: two groups above the gate level after a pause or a step up. */
		if (d->pwr_thr == 0U) {
			/* No squelch: the gate follows the tracked noise floor. */
			if (p < 4U * floor) {
				floor += (uint32_t)((int32_t)(p - floor) >> 6);
			} else {
				floor += (floor >> FLOOR_UP) + 1U;
			}
			sgate = floor > UINT32_MAX / FLOOR_MUL ? UINT32_MAX : floor * FLOOR_MUL;
		}
		on = p >= sgate;
		if (on) {
			run = run < 255U ? run + 1U : run;
			if (run == 1U) {
				pend = lg - 4U;
				sbase = savg_prev;
			} else if (run == 2U) {
				if (off >= IDLE_RESET || p > 4U * sbase) {
					d->edge = pend;
					d->seeded = 0;
					if (d->cur_valid && !d->sliced) {
						uint32_t c = align_ph(pend - LEAD_IN, d->ph);

						if ((int32_t)(c - d->cur) > 0) {
							d->cur = c;
						}
					}
				}
				off = 0;
			}
		} else {
			run = 0;
			off = off < 255U ? off + 1U : off;
		}

		/* Squelch hold (not while replaying the pre-roll). */
		if (!d->always && (int32_t)(lg - d->replay_end) >= 0) {
			if (savg >= d->s_close) {
				d->hold_cnt = d->hold;
			} else if (d->hold_cnt <= 1U) {
				closing = true;
				break;
			} else {
				d->hold_cnt--;
			}
		}
	}
	d->lg = lg;
	d->savg = savg;
	d->floor = floor;
	d->s_gate = sgate;
	d->pend = pend;
	d->sbase = sbase;
	d->run = (uint8_t)run;
	d->off = (uint8_t)off;
	d->pw_c = pw_c;

	/* Decision cursor. */
	if (d->need_cursor && (int32_t)(lg - 1U - d->start) >= 7) {
		d->cur = align_ph(d->start + 4U, d->ph);
		d->cur_valid = 1;
		d->need_cursor = 0;
	}
	if (closing) {
		d->f = lg;
		return true;
	}
	if (d->cur_valid) {
		slice_batch(d, em, lg - 1U - 4U * GFSK_LAT_SYMS, true);
	}
	return false;
}

/* Returns true when the squelch closed (d->f is then the first sample not processed). */
static bool front_run(struct gfsk_demod *d, const int16_t *i, const int16_t *q, uint32_t base,
		      size_t n, struct emit *em)
{
	int32_t k = (int32_t)(d->f - base);
	const int32_t kend = (int32_t)n;

	while (k < kend) {
#ifndef GFSK_TUNABLE
		if ((d->f & 3U) == 0U && k >= 4 && kend - k >= 4) {
			unsigned int ng = (unsigned int)((kend - k) / 4);

			ng = ng > GFSK_CHUNK ? GFSK_CHUNK : ng;
			hot(d, i + k, q + k, ng);
			k += 4 * (int32_t)ng;
		} else
#endif
		{
			step1(d, xs(d->hi, i, k), xs(d->hq, q, k), xs(d->hi, i, k - 4),
			      xs(d->hq, q, k - 4));
			k++;
			if ((d->f & 3U) != 0U && k < kend) {
				continue;
			}
		}
		if (run_groups(d, em)) {
			return true;
		}
	}
	return false;
}

/* ---------------------------------------------------------------------------------------- */
/* Closed path                                                                              */
/* ---------------------------------------------------------------------------------------- */

/* Returns true when the detector opened (d->f is then the first sample after the group). */
UBT_HOT static bool closed_scan(struct gfsk_demod *d, const int16_t *i, const int16_t *q,
				uint32_t base, size_t n)
{
	uint32_t idx = d->f + ((3U - d->f) & 3U);
	int32_t kk = (int32_t)(idx - base);
	const int32_t kend = (int32_t)n;
	const int32_t lo = 3 - (int32_t)d->hist_n;
	uint32_t savg = d->savg;
	const uint32_t thr = d->s_thr;
	bool init = d->s_init;

	for (; kk < kend; kk += 4) {
		int32_t zi, zq;
		uint32_t p;

		if (kk < lo) {
			continue;
		}
		if (kk >= 3) {
			zi = i[kk] - q[kk - 1] - i[kk - 2] + q[kk - 3];
			zq = q[kk] + i[kk - 1] - q[kk - 2] - i[kk - 3];
		} else {
			fir_at(d, i, q, kk, &zi, &zq);
		}
		p = power_of(zi, zq);
		if (!init) {
			savg = p;
			init = true;
		} else {
			savg = (uint32_t)((int32_t)savg + (((int32_t)(p - savg)) >> SQ_SHIFT));
		}
		if (savg >= thr) {
			d->savg = savg;
			d->s_init = 1;
			d->f = base + (uint32_t)kk + 1U;
			return true;
		}
	}
	d->savg = savg;
	d->s_init = init;
	d->f = base + (uint32_t)kk - 3U;
	return false;
}

static void save_history(struct gfsk_demod *d, const int16_t *i, const int16_t *q, size_t n)
{
	if (n >= GFSK_HIST) {
		memcpy(d->hi, i + n - GFSK_HIST, sizeof(d->hi));
		memcpy(d->hq, q + n - GFSK_HIST, sizeof(d->hq));
	} else if (n != 0U) {
		size_t keep = GFSK_HIST - n;

		memmove(d->hi, d->hi + n, keep * sizeof(d->hi[0]));
		memmove(d->hq, d->hq + n, keep * sizeof(d->hq[0]));
		memcpy(d->hi + keep, i, n * sizeof(d->hi[0]));
		memcpy(d->hq + keep, q, n * sizeof(d->hq[0]));
	}
	d->hist_n = (uint16_t)((size_t)d->hist_n + n > GFSK_HIST ? GFSK_HIST : d->hist_n + n);
}

size_t gfsk_demod_push(struct gfsk_demod *d, const int16_t *i, const int16_t *q, size_t n,
		       struct gfsk_sym *out, size_t out_cap)
{
	struct emit em = {.out = out, .cap = out_cap, .n = 0};
	uint32_t base = d->n;

	if (d->flushing) {
		flush_pending(d, &em);
		d->flushing = 0;
	}
	for (;;) {
		if (!d->open) {
			uint32_t trig;

			if (!closed_scan(d, i, q, base, n)) {
				break;
			}
			/* Replay the pre-roll through the full path. */
			trig = d->f;
			front_start(d, i, q, base, trig - GFSK_PRE_SAMPLES);
			d->open = 1;
			d->replay_end = trig;
			d->hold_cnt = d->hold;
		} else if (!d->front_ok) {
			front_start(d, i, q, base, align_up4(d->f));
		}
		if (!front_run(d, i, q, base, n, &em)) {
			break;
		}
		flush_pending(d, &em);
		d->open = 0;
	}
	save_history(d, i, q, n);
	d->n = base + (uint32_t)n;
	return em.n;
}

size_t gfsk_demod_flush(struct gfsk_demod *d, struct gfsk_sym *out, size_t out_cap)
{
	struct emit em = {.out = out, .cap = out_cap, .n = 0};

	if (d->open && d->front_ok) {
		flush_pending(d, &em);
		d->front_ok = 0;
		d->f = d->n;
	}
	return em.n;
}

void gfsk_demod_gap(struct gfsk_demod *d, uint32_t n_lost)
{
	d->n += n_lost;
	d->hist_n = 0;
	d->f = d->n;
	if (d->open) {
		d->flushing = 1;
		d->front_ok = 0;
	}
}
```

## src/gfsk_demod.h
```c
/*
 * SPDX-License-Identifier: GPL-3.0-or-later
 *
 * 1 Msym/s GFSK demodulator (Bluetooth BR and LE) for the 4 MS/s planar int16 stream of the
 * ring receiver (ESP_SDR_RING_DECIM_BOX4, subsample, shift_fs4; full scale 8192 per axis). The
 * wanted channel sits at +1 MHz in that stream (LO at f0 + 3 MHz). If the hardware turns out
 * to mirror the spectrum (channel at -1 MHz), pass the q array as @p i and the i array as
 * @p q: that conjugates the signal at no cost.
 *
 * Signal path, per sample: a 4-tap complex FIR with the taps (1, j, -1, -j) (the boxcar of 4
 * after the -1 MHz derotation, run as z[n] = j z[n-1] + x[n] - x[n-4]) puts nulls on every
 * multiple of 1 MHz from the channel: the LO spur at 0 Hz and the neighbours at +-1 MHz (BR)
 * or +-2 MHz (LE) fall into them. A delay-2 discriminator follows; its output is summed over
 * 2 samples around the symbol centre and sliced against the middle of the two levels it takes
 * (so a carrier offset is absorbed). tools/gfsk_sim.c holds the numbers behind these choices.
 *
 * Symbol timing: when the signal power rises (a burst), the sampling phase is picked from the
 * four candidates by the opening of the eye over the alternating preamble; afterwards an
 * early/late comparison moves it by one sample when the eye is better on one side (it follows
 * 100 ppm over a 3 ms packet). The decisions run GFSK_LAT_SYMS symbols behind the newest
 * sample, so the phase and the slicing levels of a packet's first symbols are estimated from
 * the symbols that follow them: the preamble is not lost to a lock time.
 *
 * Power: every symbol carries the smoothed in-channel power in the 0.5 dB steps of gfsk_sym.h,
 * relative to a complex tone of amplitude 8192 at the channel centre (0 dBFS, pwr 200). The
 * boxcar gain of 4 (power 16) is divided out; a modulated carrier reads up to 0.9 dB lower
 * (the boxcar rolls off towards the deviation), which PWR_COMP_BLE compensates.
 *
 * Squelch: an energy detector on the same power. Closed, only a cheap detector runs (one
 * FIR output per 4 samples) and no symbols are produced; when it opens, the last
 * GFSK_PRE_SAMPLES samples are replayed through the full path so that no preamble is lost.
 * "Always emit" keeps the full path running and produces a symbol per symbol period; the
 * threshold then only decides when the sampling phase and slicing levels are acquired anew (a
 * new burst).
 */

#ifndef GFSK_DEMOD_H_
#define GFSK_DEMOD_H_

#include <stdbool.h>
#include <stddef.h>
#include <stdint.h>

#include "gfsk_sym.h"

enum gfsk_modulation {
	GFSK_BLE = 0, /* h = 0.5, +-250 kHz */
	GFSK_BR = 1,  /* h about 0.32, +-160 kHz */
};

/* Decisions trail the newest sample by this many symbols (look-ahead of the estimates). */
#define GFSK_LAT_SYMS    12U
/* Samples replayed when the squelch opens (multiple of 4); history kept for it. */
#define GFSK_PRE_SAMPLES 40U
#define GFSK_HIST        64U
/* Rings: samples (power of two >= 4 * (LAT + chunk) + 12) and group powers (>= LAT + chunk + 4). */
#define GFSK_CHUNK       8U
#define GFSK_RING        128U
#define GFSK_PRING       32U

/*
 * Symbols one gfsk_demod_push() of n samples can emit at most: one per 4 samples, plus the
 * pipeline (look-ahead) flushed when a squelch closes or after a gap, plus the pre-roll replayed
 * when the squelch opens. The caller's out_cap must be at least this; gfsk_demod_flush() needs
 * GFSK_LAT_SYMS + GFSK_CHUNK + 2. Symbols beyond out_cap are dropped.
 */
#define GFSK_OUT_CAP(n) \
	((size_t)(n) / 4U + GFSK_LAT_SYMS + GFSK_CHUNK + GFSK_PRE_SAMPLES / 4U + 4U)

struct gfsk_demod {
	/* Configuration, kept by gfsk_demod_reset(). */
	uint8_t mod;
	uint8_t always;
	uint8_t pwr_thr;
	uint8_t pad;
	uint16_t hold;
	uint32_t s_thr, s_close;

	/* Stream. */
	uint32_t n;      /* index of the next sample the caller will push */
	uint32_t f;      /* index of the next sample to run through the active path */
	uint32_t lg;     /* first sample of the next group the group logic handles */
	uint32_t replay_end;
	uint32_t start;  /* first sample of the current run of the full path */
	uint16_t hist_n; /* valid raw samples in hi/hq (the ones before n) */
	uint8_t open;    /* the full path runs */
	uint8_t flushing;/* a gap happened: emit what is pending first */
	uint8_t front_ok;

	/* FIR and discriminator: z[f - 1], and z >> 2 at f - 1 and f - 2 (by parity of the index). */
	int32_t zi, zq, a1i, a1q, a2i, a2q;
#ifdef GFSK_TUNABLE
	int32_t ah_i[4], ah_q[4];
#endif
	uint32_t cs;          /* running sum of the discriminator, ring entry of f - 1 */

	/* Detector. */
	uint32_t savg, floor;
	uint32_t s_gate;
	uint16_t hold_cnt;
	uint8_t s_init;

	/* Burst edge: two groups above the gate after a pause start a new acquisition. */
	uint8_t off, run, pw_c;
	uint32_t pend;        /* first sample of the group that may start a burst */
	uint32_t sbase;       /* the smoothed power before it */
	uint32_t edge;        /* burst start estimate */

	/* Sampling phase: window ends at index & 3 == ph; the early/late sums. */
	uint8_t ph;
	uint8_t el_cnt, el_tog;
	int32_t el_e;
	uint32_t el_a;

	/* Slicing levels: the mean window sums decided as 0 and as 1. */
	int32_t m0, m1;
	uint8_t seeded;

	/* Decision cursor. */
	uint32_t cur;         /* window end index of the next symbol */
	uint8_t cur_valid, need_cursor, sliced;

	/* Histories. */
	uint32_t cring[GFSK_RING];
	uint32_t pring[GFSK_PRING]; /* power of each group, raw */
	uint8_t wring[GFSK_PRING];  /* the smoothed power of each group, pwr units */
	int16_t hi[GFSK_HIST], hq[GFSK_HIST];
};

/** Set up for @p mod; automatic lock threshold, always emitting (see gfsk_demod_set_squelch). */
void gfsk_demod_init(struct gfsk_demod *d, enum gfsk_modulation mod);

/** Forget the stream: the sample counter restarts at 0, the configuration is kept. */
void gfsk_demod_reset(struct gfsk_demod *d);

/**
 * @brief Squelch and lock threshold.
 *
 * @param pwr_threshold In-channel power (0.5 dB steps, gfsk_sym.h) the detector must reach to
 *        open; it closes after @p hold_syms symbols below 3 dB under it. 0: no squelch, always
 *        emit, with the lock threshold 8 dB above the noise floor the demodulator tracks itself.
 * @param hold_syms Symbols of power below the close level before the squelch closes (>= 1).
 * @param always_emit Emit a symbol every symbol period whether the detector is open or not
 *        (RX_SYMBOLS with carrier sense off); the threshold then only restarts the acquisition
 *        for a new burst (at pwr_threshold - 3 dB; with 0 at 8 dB above the noise floor).
 */
void gfsk_demod_set_squelch(struct gfsk_demod *d, uint8_t pwr_threshold, uint16_t hold_syms,
			    bool always_emit);

/**
 * @brief Run n samples (planar int16, full scale 8192) through the demodulator.
 *
 * Symbols appear GFSK_LAT_SYMS symbols late; gfsk_sym.t counts samples from the last reset
 * across all calls and stamps the sample at which the symbol was on the air.
 *
 * @param out_cap At least GFSK_OUT_CAP(n); symbols beyond it are dropped.
 * @return Symbols written.
 */
size_t gfsk_demod_push(struct gfsk_demod *d, const int16_t *i, const int16_t *q, size_t n,
		       struct gfsk_sym *out, size_t out_cap);

/** Emit the symbols still in the look-ahead (end of a stream, mode change). */
size_t gfsk_demod_flush(struct gfsk_demod *d, struct gfsk_sym *out, size_t out_cap);

/**
 * The ring dropped @p n_lost samples: the counter jumps over them so t stays right, the pending
 * symbols are emitted by the next push, and the filter and the estimates restart.
 */
void gfsk_demod_gap(struct gfsk_demod *d, uint32_t n_lost);

/** Smoothed in-channel power now, pwr units (noise floor when idle). */
uint8_t gfsk_demod_level(const struct gfsk_demod *d);

/** Tracked noise floor (the automatic lock threshold minus 8 dB), pwr units. */
uint8_t gfsk_demod_noise_floor(const struct gfsk_demod *d);

/**
 * Carrier offset of the last burst in Hz (positive: the signal is above its nominal frequency),
 * from the middle of the two levels against their distance; rough (+-25 %), for diagnostics
 * and an offset correction of the LO. 0 before the first burst.
 */
int32_t gfsk_demod_cfo_hz(const struct gfsk_demod *d);

/** Samples consumed so far (the index of the next one). */
static inline uint32_t gfsk_demod_now(const struct gfsk_demod *d)
{
	return d->n;
}

/**
 * Index (in the units of gfsk_sym.t) before which no further symbol will be emitted: all the
 * symbols with t below it have been emitted or never will be. For filling the idle time between
 * bursts when the squelch is closed.
 */
uint32_t gfsk_demod_horizon(const struct gfsk_demod *d);

/** Power measure S (8 A^2 for a tone of amplitude A) to pwr units, and back. */
uint8_t gfsk_pwr_from_s(uint32_t s);
uint32_t gfsk_s_from_pwr(uint8_t pwr);

#ifdef GFSK_TUNABLE
/* Parameters swept by tools/gfsk_sim.c; the defaults are the shipped ones. */
struct gfsk_tune {
	int disc;       /* 1 to 4: discriminator delay in samples */
	int win;        /* samples of the discriminator summed per symbol (1 to 4) */
	int dd_k;       /* time constant of the per level means, log2 symbols */
	int nseed;      /* symbols the acquisition looks at */
	int seed_skip;  /* ... starting this many samples after the burst start estimate */
	int el_period;  /* early/late samples (every other symbol) per decision (0: phase fixed) */
	int el_stride;  /* early/late on every el_stride-th symbol (1, 2 or 4) */
	int el_shift;   /* a step needs |E| > A >> el_shift */
	int sq_shift;   /* power smoothing */
	int toff;       /* t = window end - toff */
	int floor_up;   /* rise shift per group of the noise floor tracker */
};
extern struct gfsk_tune gfsk_tune;
#endif

#endif /* GFSK_DEMOD_H_ */
```

## src/gfsk_mod.h
```c
/*
 * SPDX-License-Identifier: GPL-3.0-or-later
 *
 * GFSK modulator for the transmit DAC (BT 0.5, 1 Msym/s) of the Ubertooth TX
 * modes: BLE advertising (h 0.5), BR (h about 0.32), TX_GENERIC and TX_TEST
 * with a CC2400 deviation.
 *
 * DAC conventions (derived from lib/ieee802154/ieee154_dsp.h and the
 * osmosdr transmit path):
 *  - Words are esp_sdr_tx_word() words at the 40 MS/s DAC rate: I in bits
 *    9:0, Q in bits 19:10, 10 bit two's complement. 40 samples per symbol.
 *  - A baseband phase that grows (I + jQ turning counter clockwise) puts the
 *    carrier above the LO. The wanted channel f0 is therefore sent with the LO
 *    GFSK_MOD_IF_HZ below it (esp_sdr_set_freq(f0 - 4)), as the 802.15.4
 *    driver does with LO_OFFSET_MHZ 4: the LO leakage then sits 4 MHz and the
 *    image 8 MHz away from the channel (osmosdr measured about 40 and 43 dB down).
 *    A 4 MHz IF is a whole number of periods (10 samples) per symbol period
 *    (40 samples). A bit 1 is the higher frequency (positive deviation).
 *  - The amplitude is a table property (gfsk_lut_init()), the envelope is
 *    constant: the analog TX compresses amplitude, so keep it moderate (the
 *    802.15.4 PHY uses 300 of 511) and set the output power with the TX gain
 *    step (esp_sdr_tx_set_gain()).
 *
 * Design: the phase of symbol s at sample k is
 *   IF(40 s + k) + D sum_{j<s-1} b_j + D (b[s-1] A[k] + b[s] B[k] + b[s+1] C[k])
 * with b = +-1 (0 outside a burst: carrier at the centre), D the phase per bit
 * (deviation / symbol rate, in turns) and A, B, C thirds of the integrated
 * Gaussian frequency pulse (three symbols long, truncated; the pulse is
 * centred on its own bit, so a symbol depends on its two neighbours). The
 * 3 bit history picks one of 8 rows of per sample phase steps (16 bit
 * fraction of a turn, IF included): the hot loop per sample is a load, an add,
 * a shift and mask, a table lookup and a store. The accumulator restarts at
 * every symbol from exact 32 bit values, so the words are a pure function of
 * the sample index: any chunking of fill(), and overlapping or repeated
 * gen() calls (the DAC filler asks for overlapping ranges, possibly from
 * both CPUs), give identical words. Only the tables are shared, read only.
 *
 * Memory: struct gfsk_tab 680 bytes per deviation and IF, struct gfsk_lut 4 << GFSK_LUT_BITS + 4
 * bytes (2 KB at the default 9 bits: error vector -49 dB against the ideal GFSK, below the DAC and
 * the analog chain; 8 bits: 1 KB, -44 dB; 10 bits: 4 KB, -53 dB), const Gaussian and quarter wave
 * tables about 760 bytes in flash. Code in IRAM (UBT_HOT): about 0.8 KB, the rest of the file may
 * stay in flash.
 *
 * Speed: Xtensa gcc -O2 compiles the steady state (gen_steady()) to 5.5 instructions per sample in
 * the unrolled sample loop and 46 per symbol around it, 6.7 per sample in all (a static count, one
 * cycle each is the estimate: 36 MS/s per 240 MHz core, 40 MS/s needs 267 MHz). The first block of
 * a DAC session (16380 samples) is therefore ready after 0.46 ms, a 22000 sample TX_GENERIC packet
 * needs 0.23 ms for the 8300 samples of its second block while the first plays for 0.36 ms. A BLE
 * advertising packet with ramps is at most 15360 samples, one bank.
 */

#ifndef GFSK_MOD_H_
#define GFSK_MOD_H_

#include <stdbool.h>
#include <stddef.h>
#include <stdint.h>

#include <esp_sdr/esp_sdr_tx.h>

/* Output rate and symbol timing. */
#define GFSK_MOD_RATE_HZ 40000000U
#define GFSK_MOD_SYM_HZ  1000000U
#define GFSK_MOD_SPS     (GFSK_MOD_RATE_HZ / GFSK_MOD_SYM_HZ)

/* The IF of the existing TX paths: LO = channel - 4 MHz, carrier at +4 MHz in the DAC words. */
#define GFSK_MOD_IF_HZ 4000000

/* The LO sits this far below the channel: esp_sdr_set_freq(channel - GFSK_MOD_LO_OFFSET_MHZ). */
#define GFSK_MOD_LO_OFFSET_MHZ ((unsigned int)(GFSK_MOD_IF_HZ / 1000000))

/* Default digital amplitude (of 511) and ramp. */
#define GFSK_MOD_AMP      300
#define GFSK_MOD_RAMP_MAX 255U

/* Deviations: the CC2400 MDMCTRL values 0x40, 0x29 and 0x57 (3906.25 Hz per step). */
#define GFSK_DEV_BLE_HZ     250000
#define GFSK_DEV_BR_HZ      160156
#define GFSK_DEV_GENERIC_HZ 339844

/* Size of the sine table, a power of two of 2^5 to 2^10 entries. */
#ifndef GFSK_LUT_BITS
#define GFSK_LUT_BITS 9U
#endif
#define GFSK_LUT_SIZE (1U << GFSK_LUT_BITS)

/* DAC word of a sample within +-511. */
static inline uint32_t gfsk_word(int32_t i, int32_t q)
{
	return esp_sdr_tx_word((int16_t)i, (int16_t)q);
}

/* Sine table: one DAC word per phase step, amplitude baked in. */
struct gfsk_lut {
	int16_t amp;
	uint32_t w[GFSK_LUT_SIZE];
};

/*
 * Fill @p lut with amp * exp(+j 2 pi i / size); @p conj mirrors the spectrum
 * (the 802.15.4 driver's tx_conj diagnostic). @p amp 1 to 511.
 */
void gfsk_lut_init(struct gfsk_lut *lut, int amp, bool conj);

/* Phase steps of one deviation and IF. */
struct gfsk_tab {
	/* Step after sample k of a symbol, history prev, cur, next (bit 2, 1, 0), 1/65536 turn. */
	int16_t inc[8][GFSK_MOD_SPS];
	/* Phase at the symbol start for the history, 2^-32 turn. */
	int32_t phi0[8];
	/* Phase per bit and per output sample (IF), 2^-32 turn. */
	int32_t bit_step;
	int32_t if_inc;
};

/*
 * Tables for @p dev_hz peak deviation (long run of equal bits) and carrier
 * offset @p if_hz (+-19 MHz) from the LO. Integer arithmetic only.
 * CC2400 MDMCTRL[6:0] steps are 3906.25 Hz: see gfsk_dev_mdmctrl().
 */
void gfsk_tab_init(struct gfsk_tab *tab, int32_t dev_hz, int32_t if_hz);

/* Deviation of the CC2400 MDMCTRL register in Hz (bits 6:0 times 3906.25, rounded). */
static inline int32_t gfsk_dev_mdmctrl(uint16_t mdmctrl)
{
	return (int32_t)(((mdmctrl & 0x7fU) * 15625U + 2U) / 4U);
}

/* What follows the symbols of a burst: go to the centre frequency, or hold the last bit's. */
enum gfsk_end {
	GFSK_END_CENTRE,
	GFSK_END_HOLD,
};

enum gfsk_kind {
	/* Lead symbols, the bits, trail symbols; amplitude ramps at both ends. */
	GFSK_BURST,
	/* The bits as a periodic pattern (a loop bank): no ramps, bit -1 is the last, bit n the
	 * first. */
	GFSK_LOOP,
	/* Unmodulated carrier at the IF, @c nbits symbols long (period of a loop bank). */
	GFSK_CARRIER,
};

struct gfsk_burst {
	enum gfsk_kind kind;
	/* Bits, packed: bit i is (bits[i / 8] >> (i % 8)) & 1, or >> (7 - i % 8) for msb_first. */
	const uint8_t *bits;
	uint32_t nbits;
	bool msb_first;
	enum gfsk_end end;
	/* Unmodulated carrier symbols before and after the bits (burst only; trail 2 lets the pulse
	 * finish). */
	uint16_t lead, trail;
	/* Raised cosine amplitude ramp in samples at each end, 0 to GFSK_MOD_RAMP_MAX (burst only).
	 */
	uint16_t ramp;
};

struct gfsk_mod {
	const struct gfsk_tab *tab;
	const struct gfsk_lut *lut;
	struct gfsk_burst b;
	/* Samples of the burst, or the period of a loop or carrier. */
	uint32_t total;
	/* Next sample of gfsk_mod_fill(). */
	uint32_t pos;
	/* Grid steps of the ramp's cosine per ramp sample (Q16), see ramp_gain(). */
	uint32_t ramp_step;
};

/*
 * Prepare a burst. The bit array is not copied and must stay valid. Returns
 * the samples of the burst (period for loop and carrier), 0 on bad
 * arguments (no bits for a burst or loop, too many symbols).
 */
uint32_t gfsk_mod_start(struct gfsk_mod *m, const struct gfsk_tab *tab, const struct gfsk_lut *lut,
			const struct gfsk_burst *b);

/* @return The first sample of the first bit (lead symbols, in samples). */
static inline uint32_t gfsk_mod_data_start(const struct gfsk_mod *m)
{
	return m->b.kind == GFSK_BURST ? (uint32_t)m->b.lead * GFSK_MOD_SPS : 0U;
}

/*
 * DAC words for samples [index, index + n): an esp_sdr_tx_dac_gen_t body (the
 * words are a pure function of the index, @p m is not written). A burst is
 * zero (esp_sdr_tx_word(0, 0)) beyond its end, a loop or carrier wraps at the period.
 */
void gfsk_mod_gen(const struct gfsk_mod *m, uint32_t *dst, uint64_t index, uint32_t n);

/* gfsk_mod_gen() with the esp_sdr_tx_dac_gen_t signature; @p user is the struct gfsk_mod. */
void gfsk_mod_gen_cb(void *user, uint32_t *dst, uint64_t index, uint32_t n);

/*
 * The next @p n words from the cursor, which then advances. Returns the words
 * written: n, or fewer at the end of a burst (the rest of @p dst is untouched);
 * a loop and a carrier never end.
 */
size_t gfsk_mod_fill(struct gfsk_mod *m, uint32_t *dst, size_t n);

/* Back to the first sample. */
static inline void gfsk_mod_rewind(struct gfsk_mod *m)
{
	m->pos = 0;
}

/* @return Whether a burst has been read to its end by gfsk_mod_fill(). */
static inline bool gfsk_mod_done(const struct gfsk_mod *m)
{
	return m->b.kind == GFSK_BURST && m->pos >= m->total;
}

/*
 * Phase step table of a symbol with neighbours @p bp, @p bc, @p bn (-1, 0 or
 * +1 each): the row gfsk_tab_init() makes for the 8 binary histories, and what
 * a burst's lead and trail symbols use. Phase at the symbol start in @p phi0.
 */
void gfsk_tab_row(const struct gfsk_tab *tab, int bp, int bc, int bn, int16_t row[GFSK_MOD_SPS],
		  int32_t *phi0);

#endif /* GFSK_MOD_H_ */
```

## src/gfsk_sym.h
```c
/*
 * SPDX-License-Identifier: GPL-3.0-or-later
 *
 * The interface between the GFSK demodulator (gfsk_demod.c) and its consumers
 * (the BR symbol blocks in ubt_br.c, the BLE packet finder in ubt_le.c): one
 * hard-decision symbol per 1 Msym/s symbol period.
 */

#ifndef GFSK_SYM_H_
#define GFSK_SYM_H_

#include <stdint.h>

/* The 4 MS/s stream: 4 samples per symbol. */
#define GFSK_SAMPLES_PER_SYM 4U

struct gfsk_sym {
	/* Sample index of the stream (4 MS/s units, wraps at 2^32) at the decision instant. */
	uint32_t t;
	/* 1 for a positive frequency deviation (upstream: "a 1 is the higher frequency"). */
	uint8_t bit;
	/*
	 * Signal power of the symbol in 0.5 dB steps: 2 * (dBFS + 100), saturating at 0 and 255,
	 * dBFS relative to a full scale complex tone (int16 samples, 8192 peak per axis, 0 dBFS).
	 */
	uint8_t pwr;
};

#endif /* GFSK_SYM_H_ */
```

## src/ubt_attr.h
```c
/*
 * SPDX-License-Identifier: GPL-3.0-or-later
 *
 * Placement of the hot DSP loops: IRAM on the target (flash cache misses would
 * cost the 60 cycles per sample the receiver has), plain code on the host.
 */

#ifndef UBT_ATTR_H_
#define UBT_ATTR_H_

#if defined(__ZEPHYR__)
#include <esp_attr.h>
#define UBT_HOT IRAM_ATTR __attribute__((noinline))
#else
#define UBT_HOT
#endif

#endif /* UBT_ATTR_H_ */
```
