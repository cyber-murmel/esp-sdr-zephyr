## CMakeLists.txt
```
# SPDX-License-Identifier: GPL-3.0-or-later

cmake_minimum_required(VERSION 3.20.0)

find_package(Zephyr REQUIRED HINTS $ENV{ZEPHYR_BASE})
project(esp_sdr_ubertooth)

include(${CMAKE_CURRENT_LIST_DIR}/../common/common.cmake)

target_sources(app PRIVATE
  src/gfsk_demod.c
  src/gfsk_mod.c
  src/le_conn.c
  src/main.c
  src/shell.c
  src/ubt_br.c
  src/ubt_br_run.c
  src/ubt_clock.c
  src/ubt_ctrl.c
  src/ubt_dev.c
  src/ubt_le.c
  src/ubt_mode.c
  src/ubt_plat.c
  src/ubt_pie.c
  src/ubt_pie_copy.S
  src/gfsk_pie.S
  src/gfsk_slice.S
  src/gfsk_groups.S
  src/ubt_pack8.S
  src/ubt_queue.c
  src/ubt_radio.c
  src/ubt_regs.c
  src/ubt_rssi.c
  src/ubt_rx_run.c
  src/ubt_rx_sess.c
  src/ubt_specan.c
  src/ubt_specan_run.c
  src/ubt_tx.c
  src/ubt_tx_run.c
  src/ubt_usb.c
  src/upstream/bluetooth_le.c
  src/ubt_pack.c)

# Per-sample loops of the DSP.
set_source_files_properties(src/ubt_specan.c src/gfsk_mod.c src/ubt_le.c src/ubt_br.c
  PROPERTIES COMPILE_OPTIONS "-O3")
# The modulator's replay copy must stay a loop of word stores too.
set_property(SOURCE src/gfsk_mod.c APPEND PROPERTY COMPILE_OPTIONS "-fno-tree-loop-distribute-patterns")
# The demodulator's copy loops must stay loops: memcpy() here is the ROM's, a byte at a time.
set_source_files_properties(src/gfsk_demod.c
  PROPERTIES COMPILE_OPTIONS "-O3;-fno-tree-loop-distribute-patterns")
# The ring reader's int8 copy too (the rest of the file keeps the default -Os).
set_source_files_properties(src/ubt_radio.c
  PROPERTIES COMPILE_OPTIONS "-fno-tree-loop-distribute-patterns")

# The frozen reference demodulator for the bench's comparison, and the profiling split.
target_sources_ifdef(CONFIG_APP_UBERTOOTH_GFSK_REF app PRIVATE src/gfsk_ref.c)
if(CONFIG_APP_UBERTOOTH_GFSK_PROF)
  target_compile_definitions(app PRIVATE GFSK_PROF)
endif()

# Only the ESP32-S3 16 bit FFT kernel of esp-dsp: its IDF scaffolding stays out (as in apps/link).
set(ESP_DSP_DIR "${WEST_TOPDIR}/modules/lib/esp-dsp")
set(ESP_DSP_FFT "${ESP_DSP_DIR}/modules/fft/fixed/dsps_fft2r_sc16_aes3.S")
if(NOT EXISTS "${ESP_DSP_FFT}")
  message(FATAL_ERROR "esp-dsp not found at ${ESP_DSP_DIR} (west project esp-dsp)")
endif()
target_sources(app PRIVATE "${ESP_DSP_FFT}")
set_source_files_properties(${ESP_DSP_FFT} PROPERTIES
  COMPILE_DEFINITIONS CONFIG_IDF_TARGET_ESP32S3=1
  INCLUDE_DIRECTORIES "${ESP_DSP_DIR}/modules/fft/include")

# CPU 0's hot flash code as one block at a fixed instruction cache position (CONFIG_ESP_SDR_HOT_TEXT,
# lib/esp_sdr/place.cmake): the list of hot_text_s3.ld.
esp_sdr_hot_text(hot_text_s3.ld)

# The app's placement rules (place.h) apply to its own sources.
target_compile_definitions(app PRIVATE ESP_SDR_PLACE_SCOPE=ubertooth)
```

## Kconfig
```
# SPDX-License-Identifier: GPL-3.0-or-later

mainmenu "ESP-SDR Ubertooth"

choice APP_UBERTOOTH_USB_ID
	prompt "USB identity"
	default APP_UBERTOOTH_USB_ID_UBERTOOTH
	help
	  The Ubertooth host tools open only 1d50:6000, 1d50:6002 and ffff:0004.
	  1d50:6002 is Great Scott Gadgets' Ubertooth One: use it on a bench to run the
	  unmodified tools, not in a product. DFU mode keeps the project ID (2fe3:ffff).

config APP_UBERTOOTH_USB_ID_UBERTOOTH
	bool "Ubertooth One (1d50:6002)"

config APP_UBERTOOTH_USB_ID_PROJECT
	bool "Project ID (2fe3:0005): the host tools need a patch to find it"

endchoice

config APP_UBERTOOTH_API_VERSION
	hex "USB API version reported as bcdDevice"
	default 0x0107
	help
	  libubertooth refuses a device below its UBERTOOTH_API_VERSION and warns above it.

# The sample USB helper's identity follows the choice (defaults here win over its own).
config SAMPLE_USBD_VID
	default 0x1d50 if APP_UBERTOOTH_USB_ID_UBERTOOTH

config SAMPLE_USBD_PID
	default 0x6002 if APP_UBERTOOTH_USB_ID_UBERTOOTH
	default 0x0005 if APP_UBERTOOTH_USB_ID_PROJECT

config APP_UBERTOOTH_GFSK_REF
	bool "Reference demodulator for the bench"
	default y
	help
	  src/gfsk_ref.c, the demodulator as of commit 0918f8f, in flash, its state in PSRAM:
	  ubt rx bench runs it next to gfsk_demod on the same capture and compares every symbol
	  (the faster demodulator must match it bit for bit).

config APP_UBERTOOTH_GFSK_REPLAY
	bool "Replay precomputed symbols in the BLE transmit modes"
	default y
	help
	  At h = 0.5 (BLE advertising, TX_TEST with the LE modulation) the DAC filler copies a
	  symbol's 40 words from a table of 32 rows (8 bit histories, 4 start phases, 5 KB in the
	  sample ring's scratch, built at the start of each transmit mode) instead of computing
	  them: the words match the computed path (doc/modem/gfsk.md). Other deviations use the
	  computed path. "ubt tx bench" measures both.

config APP_UBERTOOTH_GFSK_PROF
	bool "Profile the demodulator's parts"
	help
	  Defines GFSK_PROF for the app: gfsk_demod.c counts the cycles of its parts (Xtensa
	  CCOUNT) and ubt rx bench prints them.

rsource "../common/Kconfig"

# USB device identity (VID, PID, strings) for the sample USB helper.
source "samples/subsys/usb/common/Kconfig.sample_usbd"

source "Kconfig.zephyr"
```

## sample.yaml
```
sample:
  name: ESP-SDR Ubertooth
  description: >-
    Ubertooth One device firmware on the ESP32-S3 SDR: the USB protocol of the
    upstream host tools (ubertooth-util, -specan, -btle, ...)
common:
  tags: esp-sdr
  sysbuild: true
  platform_allow:
    - xiao_esp32s3/esp32s3/procpu
    - communicator_badge/esp32s3/procpu
  integration_platforms:
    - xiao_esp32s3/esp32s3/procpu
tests:
  # Needs a board and the upstream host tools: see the README.
  sample.esp_sdr.ubertooth:
    build_only: true
  # The ring's profile of CPU 0 (esp_sdr_prof.h, the "prof" shell command).
  sample.esp_sdr.ubertooth.prof:
    build_only: true
    platform_allow:
      - xiao_esp32s3/esp32s3/procpu
    extra_args:
      - ubertooth_CONFIG_ESP_SDR_CPU_PROF=y
```

## prj.conf
```kconfig
# The radio without the Wi-Fi driver (lib/esp_sdr brings the PHY up), so no network stack. On the
# XIAO, following at gain 40 three rounds each (2026-11-13), the stream lost 0.0020 % against
# 0.0021 % with the driver, at the same noise floor and demodulator cycles; the internal RAM below
# the banks has 30 KB more room and the flash code is 267 KB smaller.
CONFIG_WIFI=n
CONFIG_ESP_SDR_PHY_ONLY=y

CONFIG_ESP_SDR=y
# Continuous receive: three dump banks, so the DRAM image ends below 0x3fcb0000.
CONFIG_ESP_SDR_RING=y
CONFIG_ESP_SDR_RING_BOX4=y
# The two-stage FIR is never used (box4 only): 2.9 KB of high RAM and some IRAM back.
CONFIG_ESP_SDR_RING_FIR=n
CONFIG_ESP_SDR_RX_DECIM=n
# Transmit: the DAC stream (gapless generator playback), buffers above the capture bank.
CONFIG_ESP_SDR_TX=y
CONFIG_ESP_SDR_TX_DAC_HIGH_RAM=y
# CPU 0's hottest flash code as one block at a fixed instruction cache position (hot_text_s3.ld).
CONFIG_ESP_SDR_HOT_TEXT=y
# The BLE modes' clip guard (ubt rx gain guard).
CONFIG_ESP_SDR_GAIN_GUARD=y

# Minimal logging prints at once through printk: no logging thread, no message buffer (internal RAM
# below the ring banks is full; the app logs only from threads, never from the ring).
CONFIG_LOG=y
CONFIG_LOG_MODE_MINIMAL=y

CONFIG_FPU=y
CONFIG_FPU_SHARING=y
# The PHY calibrates on main's stack (esp_sdr_init(); multiapp measured 1904 bytes).
CONFIG_MAIN_STACK_SIZE=2432
CONFIG_ISR_STACK_SIZE=1024

CONFIG_SMP=y
CONFIG_SCHED_CPU_MASK=y

# USB device on the OTG port: the Ubertooth vendor interface first, the shell on CDC-ACM and
# DFU with sysbuild/MCUboot behind it (src/ubt_usb.c orders them).
CONFIG_USB_DEVICE_STACK_NEXT=y
CONFIG_SAMPLE_USBD_PRODUCT="ESP-SDR Ubertooth One"
CONFIG_USBD_LOG_LEVEL_WRN=y
CONFIG_UDC_DRIVER_LOG_LEVEL_WRN=y
CONFIG_USBD_THREAD_STACK_SIZE=2048
CONFIG_UDC_DWC2_STACK_SIZE=1280
CONFIG_USBD_CDC_ACM_CLASS=y
CONFIG_USBD_CDC_ACM_LOG_LEVEL_OFF=y
CONFIG_CDC_ACM_SERIAL_INITIALIZE_AT_BOOT=n

CONFIG_SHELL=y
CONFIG_KERNEL_SHELL=y
CONFIG_LOG_BACKEND_UART=n
CONFIG_SHELL_STACK_SIZE=2560
CONFIG_SHELL_CMD_BUFF_SIZE=128
CONFIG_SHELL_HISTORY=n
CONFIG_DEVICE_SHELL=n
CONFIG_DATE_SHELL=n
CONFIG_DEVMEM_SHELL=y

CONFIG_HWINFO=y
CONFIG_GPIO=y
CONFIG_REBOOT=y

# Internal RAM: three 64 KiB dump banks must fit; the 8 MB octal PSRAM holds the captures.
CONFIG_ESP_SPIRAM=y
CONFIG_SPIRAM_MODE_OCT=y
# The system heap peaked at 2212 bytes (kernel heap after three following runs, 2026-11-13).
CONFIG_HEAP_MEM_POOL_IGNORE_MIN=y
CONFIG_HEAP_MEM_POOL_SIZE=4096
CONFIG_SYS_HEAP_RUNTIME_STATS=y

CONFIG_RESET_ON_FATAL_ERROR=y
CONFIG_APP_LIVENESS_WATCHDOG=y
```

## boards/communicator_badge_procpu.overlay
```dts
/*
 * SPDX-License-Identifier: GPL-3.0-or-later
 */

/ {
	chosen {
		zephyr,console = &cdc_acm_uart0;
		zephyr,shell-uart = &cdc_acm_uart0;
	};
};

zephyr_udc0: &usb_otg {
	status = "okay";

	/* Console, shell and logs while OTG owns the USB port. */
	cdc_acm_uart0: cdc_acm_uart0 {
		compatible = "zephyr,cdc-acm-uart";
		label = "ESP-SDR Ubertooth shell";
	};
};
```

## socs/esp32s3_procpu.overlay
```dts
/*
 * SPDX-License-Identifier: GPL-3.0-or-later
 */

#define APP_SHELL_LABEL "ESP-SDR Ubertooth shell"
#include "../../common/boards/s3_cdc_shell.dtsi"
```

## src/main.c
```c
/*
 * SPDX-License-Identifier: GPL-3.0-or-later
 *
 * Ubertooth One device firmware on the ESP32-S3 SDR: the USB protocol of the
 * upstream host tools, the radio work on the ring receive and the DAC.
 */

#include <zephyr/app_version.h>
#include <zephyr/kernel.h>
#include <zephyr/logging/log.h>

#include "app_cpu.h"
#include "app_usb.h"
#include "ubt_plat.h"

LOG_MODULE_REGISTER(ubertooth, LOG_LEVEL_INF);

int main(void)
{
	printk("ubertooth %s\n", APP_VERSION_STRING);
	/* Before USB starts: its controller interrupt lands on the CPU that allocates it. */
	app_cpu_pin_system_threads(0);
	if (ubt_init() != 0) {
		LOG_ERR("init failed");
		return 0;
	}
	if (app_usb_init() != 0) {
		LOG_ERR("usb init failed");
	}
	/* Again for the threads started since (usbd, UDC). */
	k_sleep(K_MSEC(500));
	app_cpu_pin_system_threads(0);
	return 0;
}
```

## src/gfsk_demod.h
```c
/*
 * SPDX-License-Identifier: GPL-3.0-or-later
 *
 * 1 Msym/s GFSK demodulator (Bluetooth BR and LE) for the 4 MS/s planar stream of the ring
 * receiver (ESP_SDR_RING_DECIM_BOX4 with shift_fs4: sums of 4, or every 4th pair) as the sample
 * ring stores it: 8 bits, the int16 stream >> 6. The wanted channel sits at DC in that stream,
 * the LO 4 MHz below it (at +1 MHz until 2026-11-12, see gfsk_ref.h).
 * If the hardware turns out to mirror the spectrum (the deviation inverted), pass the q plane as
 * @p i and the i plane as @p q: that conjugates the signal at no cost.
 *
 * It decides bit for bit as the reference gfsk_ref does on the int16 stream (x << 6) + 32, each
 * 8-bit sample at the middle of the floor's step that stored it: no bias at DC, where the channel
 * sits, and no zero level (rounding instead left the quiet in-channel noise of gain 40 all zeros)
 * (the demodulator as of commit 0918f8f and the changes to the algorithm gfsk_ref.h lists), cut into
 * the same pushes: its sample loop computes the same discriminator and powers in int8 units,
 * scaled back exactly.
 *
 * Signal path, per sample: the sum of 4 samples (computed ahead of the paths for a stretch of
 * the input, on the ESP32-S3 by the vector unit) puts nulls on every multiple of 1 MHz from the
 * channel: the neighbours at +-1 MHz (BR) or +-2 MHz (LE) fall into them. A delay-2
 * discriminator follows; its output is summed over
 * 2 samples around the symbol centre and sliced against the middle of the two levels it takes
 * (so a carrier offset is absorbed). tools/gfsk_sim.c holds the numbers behind these choices.
 *
 * Symbol timing: when the signal power rises (a burst), the sampling phase is picked from the
 * four candidates by the opening of the eye over the alternating preamble; afterwards an
 * early/late comparison moves it by one sample when the eye is better on one side (it follows
 * 100 ppm over a 3 ms packet). The decisions run GFSK_LAT_SYMS symbols behind the newest
 * sample, so the phase and the slicing levels of a packet's first symbols are estimated from
 * the symbols that follow them: the preamble is not lost to a lock time.
 *
 * Power: every symbol carries the smoothed in-channel power in the 0.5 dB steps of gfsk_sym.h,
 * relative to a complex tone of amplitude 8192 at the channel centre (0 dBFS, pwr 200). The
 * boxcar gain of 4 (power 16) is divided out; a modulated carrier reads up to 0.9 dB lower
 * (the boxcar rolls off towards the deviation), which PWR_COMP_BLE compensates.
 *
 * Squelch: an energy detector on the same power. Closed, only a cheap detector runs (one
 * FIR output per 4 samples) and no symbols are produced; when it opens, the last
 * GFSK_PRE_SAMPLES samples are replayed through the full path so that no preamble is lost.
 * "Always emit" keeps the full path running and produces a symbol per symbol period; the
 * threshold then only decides when the sampling phase and slicing levels are acquired anew (a
 * new burst).
 */

#ifndef GFSK_DEMOD_H_
#define GFSK_DEMOD_H_

#include <stdbool.h>
#include <stddef.h>
#include <stdint.h>

#include "gfsk_sym.h"

/* Decisions trail the newest sample by this many symbols (look-ahead of the estimates). */
#define GFSK_LAT_SYMS    12U
/* Samples replayed when the squelch opens (multiple of 4). */
#define GFSK_PRE_SAMPLES 40U
/* Rings: samples (power of two >= 4 * (LAT + chunk) + 12) and group powers (>= LAT + chunk + 4). */
#define GFSK_CHUNK       8U
#define GFSK_RING        128U
#define GFSK_PRING       32U
/*
 * The input of gfsk_demod_push(): GFSK_IN_HIST readable samples before the first (the replay
 * reaches 42 back, the FIR's block of 16 holding it up to 15 more and the vector unit's the 16
 * before that; a multiple of 16 keeps the reader's copy aligned), and on the ESP32-S3 GFSK_IN_TAIL
 * after the last (the vector unit computes whole blocks of 16).
 */
#define GFSK_IN_HIST     80U
#define GFSK_IN_TAIL     15U

/*
 * Symbols one gfsk_demod_push() of n samples can emit at most: one per 4 samples, plus the
 * pipeline (look-ahead) flushed when a squelch closes or after a gap, plus the pre-roll replayed
 * when the squelch opens. The caller's out_cap must be at least this; gfsk_demod_flush() needs
 * GFSK_LAT_SYMS + GFSK_CHUNK + 2. Symbols beyond out_cap are dropped.
 */
#define GFSK_OUT_CAP(n) \
	((size_t)(n) / 4U + GFSK_LAT_SYMS + GFSK_CHUNK + GFSK_PRE_SAMPLES / 4U + 4U)

struct gfsk_demod {
	/* Configuration, kept by gfsk_demod_reset(). */
	uint8_t mod;
	uint8_t always;
	uint8_t pwr_thr;
	uint8_t pad;
	uint16_t hold;
	uint32_t s_thr, s_close;

	/* Stream. */
	uint32_t n;      /* index of the next sample the caller will push */
	uint32_t f;      /* index of the next sample to run through the active path */
	uint32_t lg;     /* first sample of the next group the group logic handles */
	uint32_t replay_end;
	uint32_t start;  /* first sample of the current run of the full path */
	uint16_t hist_n; /* samples of the input before n since the last reset or gap, up to 64 */
	uint8_t open;    /* the full path runs */
	uint8_t flushing;/* a gap happened: emit what is pending first */
	uint32_t flush_f; /* ... from the samples before it: f where the gap began */
	uint8_t front_ok;

	uint32_t cs;          /* running sum of the discriminator, ring entry of f - 1 */

	/* Detector. */
	uint32_t savg, floor;
	uint32_t s_gate;
	uint16_t hold_cnt;
	uint8_t s_init;

	/*
	 * Burst edge: two groups above the gate after a pause or a step up start a new acquisition
	 * (a step up inside a run starts the run over).
	 */
	uint8_t off, run, pw_c;
	uint32_t pend;        /* first sample of the group that may start a burst */
	uint32_t sbase;       /* the smoothed power before it */
	uint32_t edge;        /* burst start estimate */

	/* Sampling phase: window ends at index & 3 == ph; the early/late sums. */
	uint8_t ph;
	uint8_t el_cnt, el_tog;
	int32_t el_e;
	uint32_t el_a;

	/* Slicing levels: the mean window sums decided as 0 and as 1. */
	int32_t m0, m1;
	uint8_t seeded;

	/* Decision cursor. */
	uint32_t cur;         /* window end index of the next symbol */
	uint8_t cur_valid, need_cursor, sliced;

	/* Histories. */
	uint32_t cring[GFSK_RING];
	uint32_t pring[GFSK_PRING]; /* power of each group, raw */
	uint8_t wring[GFSK_PRING];  /* the smoothed power of each group, pwr units */
};

/** Set up for @p mod; automatic lock threshold, always emitting (see gfsk_demod_set_squelch). */
void gfsk_demod_init(struct gfsk_demod *d, enum gfsk_modulation mod);

/** Forget the stream: the sample counter restarts at 0, the configuration is kept. */
void gfsk_demod_reset(struct gfsk_demod *d);

/**
 * @brief Squelch and lock threshold.
 *
 * @param pwr_threshold In-channel power (0.5 dB steps, gfsk_sym.h) the detector must reach to
 *        open; it closes after @p hold_syms symbols below 3 dB under it. 0: no squelch, always
 *        emit, with the lock threshold 8 dB above the noise floor the demodulator tracks itself.
 * @param hold_syms Symbols of power below the close level before the squelch closes (>= 1).
 * @param always_emit Emit a symbol every symbol period whether the detector is open or not
 *        (RX_SYMBOLS with carrier sense off); the threshold then only restarts the acquisition
 *        for a new burst (at pwr_threshold - 3 dB; with 0 at 8 dB above the noise floor).
 */
void gfsk_demod_set_squelch(struct gfsk_demod *d, uint8_t pwr_threshold, uint16_t hold_syms,
			    bool always_emit);

/**
 * @brief Run n samples (planar int8, the stream >> 6) through the demodulator.
 *
 * Symbols appear GFSK_LAT_SYMS symbols late; gfsk_sym.t counts samples from the last reset
 * across all calls and stamps the sample at which the symbol was on the air.
 *
 * @param i, q Stream sample gfsk_demod_now() and the n after it; the GFSK_IN_HIST bytes before
 *        them must be readable (the samples pushed before, where there are any: the history;
 *        after a reset or a gap they are garbage and never used). On the ESP32-S3 the vector
 *        unit computes the FIR when the address of every sample is its index modulo 16 (as the
 *        ring reader lays the planes out) and the GFSK_IN_TAIL bytes after the n samples are
 *        readable too; otherwise C does, bit for bit the same.
 * @param out_cap At least GFSK_OUT_CAP(n); symbols beyond it are dropped.
 * @return Symbols written.
 */
size_t gfsk_demod_push(struct gfsk_demod *d, const int8_t *i, const int8_t *q, size_t n,
		       struct gfsk_sym *out, size_t out_cap);

/**
 * The FIR and the discriminator as the vector unit computes them (ESP32-S3) against the same in
 * C, over 8 planes of pseudo-random and extreme samples from @p seed: the samples that differ
 * (0 without the unit).
 * Not while a push runs.
 */
uint32_t gfsk_demod_fir_check(uint32_t seed);

/**
 * The per group logic as the S3 runs it (gfsk_groups.S) against its C, over 4000 random states
 * from @p seed: the cases that differ (0 elsewhere). Not while a push runs.
 */
uint32_t gfsk_demod_groups_check(uint32_t seed);

/**
 * The slicer as the S3 runs an acquired burst (gfsk_slice.S) against its C, over 4000 random
 * states from @p seed: the cases that differ (0 elsewhere). Not while a push runs.
 */
uint32_t gfsk_demod_slice_check(uint32_t seed);

/** Emit the symbols still in the look-ahead (end of a stream, mode change). */
size_t gfsk_demod_flush(struct gfsk_demod *d, struct gfsk_sym *out, size_t out_cap);

/**
 * The ring dropped @p n_lost samples: the counter jumps over them so t stays right, the pending
 * symbols are emitted by the next push, and the filter and the estimates restart.
 */
void gfsk_demod_gap(struct gfsk_demod *d, uint32_t n_lost);

/** Smoothed in-channel power now, pwr units (noise floor when idle). */
uint8_t gfsk_demod_level(const struct gfsk_demod *d);

/** Tracked noise floor (the automatic lock threshold minus 8 dB), pwr units. */
uint8_t gfsk_demod_noise_floor(const struct gfsk_demod *d);

/**
 * Carrier offset of the last burst in Hz (positive: the signal is above its nominal frequency),
 * from the middle of the two levels against their distance; rough (+-25 %), for diagnostics
 * and an offset correction of the LO. 0 before the first burst.
 */
int32_t gfsk_demod_cfo_hz(const struct gfsk_demod *d);

/** Samples consumed so far (the index of the next one). */
static inline uint32_t gfsk_demod_now(const struct gfsk_demod *d)
{
	return d->n;
}

/**
 * Index (in the units of gfsk_sym.t) before which no further symbol will be emitted: all the
 * symbols with t below it have been emitted or never will be. For filling the idle time between
 * bursts when the squelch is closed.
 */
uint32_t gfsk_demod_horizon(const struct gfsk_demod *d);

/** Power measure S (8 A^2 for a tone of amplitude A) to pwr units, and back. */
uint8_t gfsk_pwr_from_s(uint32_t s);
uint32_t gfsk_s_from_pwr(uint8_t pwr);

#ifdef GFSK_PROF
/* Cycles in the parts of the full path (Xtensa CCOUNT), for profiling builds (ubt rx bench). */
struct gfsk_prof {
	uint32_t hot, groups, slice, front;
	/* Samples through the full path, and times the squelch closed. */
	uint32_t open, opens;
};
extern struct gfsk_prof gfsk_prof;
#endif

#endif /* GFSK_DEMOD_H_ */
```

## src/gfsk_demod_off.h
```c
/*
 * SPDX-License-Identifier: GPL-3.0-or-later
 *
 * Offsets of struct gfsk_demod's fields for the demodulator's assembly (gfsk_groups.S,
 * gfsk_slice.S); gfsk_demod.c checks every one of them against the struct at build time.
 */

#ifndef GFSK_DEMOD_OFF_H_
#define GFSK_DEMOD_OFF_H_

#define GD_MOD        0
#define GD_ALWAYS     1
#define GD_PWR_THR    2
#define GD_HOLD       4
#define GD_S_CLOSE    12
#define GD_F          20
#define GD_LG         24
#define GD_REPLAY_END 28
#define GD_SAVG       52
#define GD_FLOOR      56
#define GD_S_GATE     60
#define GD_HOLD_CNT   64
#define GD_S_INIT     66
#define GD_OFF        67
#define GD_RUN        68
#define GD_PW_C       69
#define GD_PEND       72
#define GD_SBASE      76
#define GD_EDGE       80
#define GD_PH         84
#define GD_EL_CNT     85
#define GD_EL_E       88
#define GD_EL_A       92
#define GD_M0         96
#define GD_M1         100
#define GD_SEEDED     104
#define GD_CUR        108
#define GD_CUR_VALID  112
#define GD_SLICED     114
#define GD_CRING      116
#define GD_PRING      628
#define GD_WRING      756

#endif /* GFSK_DEMOD_OFF_H_ */
```

## src/gfsk_mod.c
```c
/*
 * SPDX-License-Identifier: GPL-3.0-or-later
 *
 * GFSK modulator for the transmit DAC, see gfsk_mod.h for the design.
 */

#include "gfsk_mod.h"

#include <string.h>

#include "ubt_attr.h"

_Static_assert(GFSK_LUT_BITS >= 5 && GFSK_LUT_BITS <= 10,
	       "the sine table is cut from a 1024 point grid");
_Static_assert(GFSK_MOD_SPS == 40, "the Gaussian table has 40 points per symbol");

/* Phase accumulators run in 1/65536 turn; the table index is the top GFSK_LUT_BITS of them. */
#define ACC_SHIFT (16U - GFSK_LUT_BITS)
#define ACC_BIAS  (1U << (ACC_SHIFT - 1U))
#define LUT_MASK  (GFSK_LUT_SIZE - 1U)

/* Points of the sine grid the ramp and the table are cut from. */
#define GRID      1024U
#define GRID_QUAD (GRID / 4U)

/*
 * Integrated frequency pulse of a Gaussian filter with BT 0.5 and a rectangle
 * of one symbol, over three symbols (40 points each) centred on the bit,
 * normalised to rise from 0 to 1: Q15, symmetric about the middle
 * (g[i] + g[120 - i] = 32768). Generated with erfc(), see tools/txcheck.c.
 */
static const uint16_t gauss[3 * GFSK_MOD_SPS + 1] = {
	0,     0,     0,     0,     1,     1,     1,     2,     3,     4,     6,     8,     11,
	15,    20,    27,    35,    46,    60,    77,    99,    126,   159,   200,   249,   308,
	378,   461,   559,   673,   805,   956,   1130,  1326,  1547,  1795,  2070,  2373,  2706,
	3070,  3464,  3889,  4345,  4830,  5346,  5890,  6461,  7058,  7680,  8325,  8991,  9676,
	10378, 11096, 11827, 12569, 13321, 14080, 14845, 15614, 16384, 17154, 17923, 18688, 19447,
	20199, 20941, 21672, 22390, 23092, 23777, 24443, 25088, 25710, 26307, 26878, 27422, 27938,
	28423, 28879, 29304, 29698, 30062, 30395, 30698, 30973, 31221, 31442, 31638, 31812, 31963,
	32095, 32209, 32307, 32390, 32460, 32519, 32568, 32609, 32642, 32669, 32691, 32708, 32722,
	32733, 32741, 32748, 32753, 32757, 32760, 32762, 32764, 32765, 32766, 32767, 32767, 32767,
	32768, 32768, 32768, 32768,
};

/* 32768 sin(pi/2 i/256), i = 0 to 256. */
static const uint16_t qsin[GRID_QUAD + 1U] = {
	0,     201,   402,   603,   804,   1005,  1206,  1407,  1608,  1809,  2009,  2210,  2411,
	2611,  2811,  3012,  3212,  3412,  3612,  3812,  4011,  4211,  4410,  4609,  4808,  5007,
	5205,  5404,  5602,  5800,  5998,  6195,  6393,  6590,  6787,  6983,  7180,  7376,  7571,
	7767,  7962,  8157,  8351,  8546,  8740,  8933,  9127,  9319,  9512,  9704,  9896,  10088,
	10279, 10469, 10660, 10850, 11039, 11228, 11417, 11605, 11793, 11980, 12167, 12354, 12540,
	12725, 12910, 13095, 13279, 13463, 13646, 13828, 14010, 14192, 14373, 14553, 14733, 14912,
	15091, 15269, 15447, 15624, 15800, 15976, 16151, 16326, 16500, 16673, 16846, 17018, 17190,
	17361, 17531, 17700, 17869, 18037, 18205, 18372, 18538, 18703, 18868, 19032, 19195, 19358,
	19520, 19681, 19841, 20001, 20160, 20318, 20475, 20632, 20788, 20943, 21097, 21251, 21403,
	21555, 21706, 21856, 22006, 22154, 22302, 22449, 22595, 22740, 22884, 23028, 23170, 23312,
	23453, 23593, 23732, 23870, 24008, 24144, 24279, 24414, 24548, 24680, 24812, 24943, 25073,
	25202, 25330, 25457, 25583, 25708, 25833, 25956, 26078, 26199, 26320, 26439, 26557, 26674,
	26791, 26906, 27020, 27133, 27246, 27357, 27467, 27576, 27684, 27791, 27897, 28002, 28106,
	28209, 28311, 28411, 28511, 28610, 28707, 28803, 28899, 28993, 29086, 29178, 29269, 29359,
	29448, 29535, 29622, 29707, 29792, 29875, 29957, 30038, 30118, 30196, 30274, 30350, 30425,
	30499, 30572, 30644, 30715, 30784, 30853, 30920, 30986, 31050, 31114, 31177, 31238, 31298,
	31357, 31415, 31471, 31527, 31581, 31634, 31686, 31737, 31786, 31834, 31881, 31927, 31972,
	32015, 32058, 32099, 32138, 32177, 32214, 32251, 32286, 32319, 32352, 32383, 32413, 32442,
	32470, 32496, 32522, 32546, 32568, 32590, 32610, 32629, 32647, 32664, 32679, 32693, 32706,
	32718, 32729, 32738, 32746, 32753, 32758, 32762, 32766, 32767, 32768,
};

/* sin(2 pi g / 1024) in Q15 for any g (the quarter wave table mirrored). */
static int32_t sin_q15(uint32_t g)
{
	uint32_t quad = (g / GRID_QUAD) & 3U, r = g % GRID_QUAD;
	int32_t v = qsin[(quad & 1U) != 0U ? GRID_QUAD - r : r];

	return quad >= 2U ? -v : v;
}

/* amp * q / 32768 rounded half away from zero. */
static int32_t scale_q15(int32_t amp, int32_t q)
{
	int32_t p = (amp * (q < 0 ? -q : q) + 16384) >> 15;

	return q < 0 ? -p : p;
}

void gfsk_lut_init(struct gfsk_lut *lut, int amp, bool conj)
{
	if (amp < 1) {
		amp = 1;
	} else if (amp > 511) {
		amp = 511;
	}
	lut->amp = (int16_t)amp;
	for (uint32_t i = 0; i < GFSK_LUT_SIZE; i++) {
		uint32_t g = i * (GRID / GFSK_LUT_SIZE);
		int32_t c = scale_q15(amp, sin_q15(g + GRID_QUAD));
		int32_t s = scale_q15(amp, sin_q15(g));

		lut->w[i] = gfsk_word(c, conj ? -s : s);
	}
}

/* 1/65536 turn of a phase in 2^-32 turn, rounded (mod 1 turn). */
static inline uint16_t round16(uint32_t p)
{
	return (uint16_t)((p + 0x8000U) >> 16);
}

void gfsk_tab_row(const struct gfsk_tab *tab, int bp, int bc, int bn, int16_t row[GFSK_MOD_SPS],
		  int32_t *phi0)
{
	uint32_t f[GFSK_MOD_SPS + 1U];
	int64_t d = tab->bit_step;
	uint32_t p0 = 0;

	/* Phase of the pulses: prev, cur, next bit are the last, middle and first third. */
	for (uint32_t k = 0; k <= GFSK_MOD_SPS; k++) {
		int32_t g = bp * (int32_t)gauss[2U * GFSK_MOD_SPS + k] +
			    bc * (int32_t)gauss[GFSK_MOD_SPS + k] + bn * (int32_t)gauss[k];
		/* floor(d g / 2^15) modulo 2^32: the logical shift keeps the low 32 bits of the
		 * arithmetic one. */
		uint32_t ph = (uint32_t)((uint64_t)(d * g) >> 15);

		if (k == 0U) {
			p0 = ph;
		}
		/* Relative to the symbol start, the IF added. */
		f[k] = ph - p0 + k * (uint32_t)tab->if_inc;
	}
	for (uint32_t k = 0; k < GFSK_MOD_SPS; k++) {
		row[k] = (int16_t)(uint16_t)(round16(f[k + 1U]) - round16(f[k]));
	}
	*phi0 = (int32_t)p0;
}

void gfsk_tab_init(struct gfsk_tab *tab, int32_t dev_hz, int32_t if_hz)
{
	/* Below half a turn per bit, so that the products fit; a CC2400 reaches 496 kHz. */
	if (dev_hz < 0) {
		dev_hz = 0;
	} else if (dev_hz > 499999) {
		dev_hz = 499999;
	}
	tab->bit_step = (int32_t)(((int64_t)dev_hz << 32) / (int64_t)GFSK_MOD_SYM_HZ);
	{
		int64_t num = (int64_t)if_hz * 4294967296LL, half = (int64_t)GFSK_MOD_RATE_HZ / 2;

		tab->if_inc =
			(int32_t)((num + (num < 0 ? -half : half)) / (int64_t)GFSK_MOD_RATE_HZ);
	}
	for (int h = 0; h < 8; h++) {
		gfsk_tab_row(tab, (h & 4) != 0 ? 1 : -1, (h & 2) != 0 ? 1 : -1,
			     (h & 1) != 0 ? 1 : -1, tab->inc[h], &tab->phi0[h]);
	}
}

/* ----------------------------------------------------------------- burst */

uint32_t gfsk_mod_start(struct gfsk_mod *m, const struct gfsk_tab *tab, const struct gfsk_lut *lut,
			const struct gfsk_burst *b)
{
	uint64_t syms;

	m->tab = tab;
	m->lut = lut;
	m->b = *b;
	m->pos = 0;
	m->total = 0;
	m->ramp_step = 0;
	m->rows = NULL;
	if (b->kind != GFSK_BURST && b->kind != GFSK_LOOP && b->kind != GFSK_CARRIER) {
		return 0;
	}
	if (b->nbits == 0U || (b->kind != GFSK_CARRIER && b->bits == NULL)) {
		return 0;
	}
	syms = b->nbits;
	if (b->kind == GFSK_BURST) {
		syms += (uint64_t)b->lead + b->trail;
	} else {
		m->b.lead = 0;
		m->b.trail = 0;
		m->b.ramp = 0;
	}
	if (syms > (1U << 20)) {
		return 0;
	}
	m->total = (uint32_t)syms * GFSK_MOD_SPS;
	if (m->b.ramp > GFSK_MOD_RAMP_MAX) {
		m->b.ramp = GFSK_MOD_RAMP_MAX;
	}
	if (2U * m->b.ramp > m->total) {
		m->b.ramp = (uint16_t)(m->total / 2U);
	}
	if (m->b.ramp != 0U) {
		m->ramp_step = ((GRID / 4U) << 17) / m->b.ramp;
	}
	return m->total;
}

static inline unsigned int pop8(unsigned int v)
{
	v = v - ((v >> 1) & 0x55U);
	v = (v & 0x33U) + ((v >> 2) & 0x33U);
	return (v + (v >> 4)) & 0x0fU;
}

/* Bit i of the burst's array. */
static inline unsigned int bit_at(const struct gfsk_burst *b, uint32_t i)
{
	return ((unsigned int)b->bits[i >> 3] >> ((i & 7U) ^ (b->msb_first ? 7U : 0U))) & 1U;
}

/* Ones among the first @p d bits. */
static uint32_t ones_before(const struct gfsk_burst *b, uint32_t d)
{
	uint32_t full = d >> 3, rem = d & 7U, cnt = 0;

	for (uint32_t i = 0; i < full; i++) {
		cnt += pop8(b->bits[i]);
	}
	if (rem != 0U) {
		unsigned int v = b->bits[full];

		v &= b->msb_first ? (0xffU << (8U - rem)) & 0xffU : (1U << rem) - 1U;
		cnt += pop8(v);
	}
	return cnt;
}

/* Symbol i outside the bits of a burst, or the wrap of a loop. */
ESP_SDR_CODE(PACED_SAMPLE, sym_edge)
static int sym_edge(const struct gfsk_mod *m, int32_t i)
{
	const struct gfsk_burst *b = &m->b;

	if (b->kind == GFSK_LOOP) {
		int32_t n = (int32_t)b->nbits;

		i %= n;
		if (i < 0) {
			i += n;
		}
		return bit_at(b, (uint32_t)i) != 0U ? 1 : -1;
	}
	if (i >= (int32_t)b->lead && b->end == GFSK_END_HOLD) {
		return bit_at(b, b->nbits - 1U) != 0U ? 1 : -1;
	}
	return 0;
}

/* Symbol i of the burst: +1, -1, or 0 for the carrier outside the bits. */
static inline int sym_at(const struct gfsk_mod *m, int32_t i)
{
	uint32_t d = (uint32_t)(i - (int32_t)m->b.lead);

	if (d < m->b.nbits) {
		return bit_at(&m->b, d) != 0U ? 1 : -1;
	}
	return sym_edge(m, i);
}

/* Sum of the symbols before x. */
ESP_SDR_CODE(PACED_SAMPLE, sym_sum)
static int32_t sym_sum(const struct gfsk_mod *m, int32_t x)
{
	const struct gfsk_burst *b = &m->b;
	int32_t d = x - (int32_t)b->lead;
	uint32_t n;

	if (b->kind == GFSK_LOOP) {
		d = x;
	}
	if (d <= 0) {
		return 0;
	}
	n = (uint32_t)d < b->nbits ? (uint32_t)d : b->nbits;

	int32_t sum = 2 * (int32_t)ones_before(b, n) - (int32_t)n;

	if (b->kind == GFSK_BURST && (uint32_t)d > b->nbits && b->end == GFSK_END_HOLD) {
		sum += (int32_t)((uint32_t)d - b->nbits) *
		       (bit_at(b, b->nbits - 1U) != 0U ? 1 : -1);
	}
	return sum;
}

/* A phase step as an unsigned addend (sign extended, so the sum wraps modulo a turn). */
static inline uint32_t inc_of(int16_t v)
{
	return (uint32_t)(int32_t)v;
}

/* Samples of a symbol run, steady amplitude: the hot loop. */
UBT_HOT(PACED_SAMPLE, emit)
static void emit(const uint32_t *lut, uint32_t acc, const int16_t *row, uint32_t cnt,
			 uint32_t *dst)
{
	uint32_t k = 0;

	for (; k + 4U <= cnt; k += 4U) {
		uint32_t a0 = acc, a1 = a0 + inc_of(row[k]), a2 = a1 + inc_of(row[k + 1U]),
			 a3 = a2 + inc_of(row[k + 2U]);

		dst[k] = lut[(a0 >> ACC_SHIFT) & LUT_MASK];
		dst[k + 1U] = lut[(a1 >> ACC_SHIFT) & LUT_MASK];
		dst[k + 2U] = lut[(a2 >> ACC_SHIFT) & LUT_MASK];
		dst[k + 3U] = lut[(a3 >> ACC_SHIFT) & LUT_MASK];
		acc = a3 + inc_of(row[k + 3U]);
	}
	for (; k < cnt; k++) {
		dst[k] = lut[(acc >> ACC_SHIFT) & LUT_MASK];
		acc += inc_of(row[k]);
	}
}

/* A whole symbol of the steady data run: 40 samples, unrolled by 8 (5 loop passes). */
static inline __attribute__((always_inline)) void emit_symbol(const uint32_t *lut, uint32_t acc,
							      const int16_t *row, uint32_t *dst)
{
	for (uint32_t k = 0; k < GFSK_MOD_SPS; k += 8U) {
		uint32_t a1 = acc + inc_of(row[k]), a2 = a1 + inc_of(row[k + 1U]),
			 a3 = a2 + inc_of(row[k + 2U]), a4 = a3 + inc_of(row[k + 3U]),
			 a5 = a4 + inc_of(row[k + 4U]), a6 = a5 + inc_of(row[k + 5U]),
			 a7 = a6 + inc_of(row[k + 6U]);

		dst[k] = lut[(acc >> ACC_SHIFT) & LUT_MASK];
		dst[k + 1U] = lut[(a1 >> ACC_SHIFT) & LUT_MASK];
		dst[k + 2U] = lut[(a2 >> ACC_SHIFT) & LUT_MASK];
		dst[k + 3U] = lut[(a3 >> ACC_SHIFT) & LUT_MASK];
		dst[k + 4U] = lut[(a4 >> ACC_SHIFT) & LUT_MASK];
		dst[k + 5U] = lut[(a5 >> ACC_SHIFT) & LUT_MASK];
		dst[k + 6U] = lut[(a6 >> ACC_SHIFT) & LUT_MASK];
		dst[k + 7U] = lut[(a7 >> ACC_SHIFT) & LUT_MASK];
		acc = a7 + inc_of(row[k + 7U]);
	}
}

bool gfsk_rows_init(struct gfsk_rows *r, const struct gfsk_tab *tab, const struct gfsk_lut *lut)
{
	if (tab->bit_step != (1 << 30)) {
		return false;
	}
	for (uint32_t h = 0; h < 8U; h++) {
		for (uint32_t q = 0; q < 4U; q++) {
			/* gen_steady()'s start phase without the IF part, which is whole turns. */
			uint32_t acc =
				((((q << 30) + (uint32_t)tab->phi0[h]) >> 16) + ACC_BIAS);

			emit_symbol(lut->w, acc, tab->inc[h], r->w[h][q]);
		}
	}
	return true;
}

#if defined(__ZEPHYR__) && defined(CONFIG_SOC_SERIES_ESP32S3)
/*
 * As lib/ieee802154/ieee154_dsp.h (commit 7f60090): the vector unit may be used where the caller
 * (the DAC filler) enabled it on this CPU and holds interrupts off, as nothing saves its
 * registers.
 */
static inline bool vec_ok(void)
{
	uint32_t cp, ps;

	__asm__ volatile("rsr.cpenable %0" : "=r"(cp));
	__asm__ volatile("rsr.ps %0" : "=r"(ps));
	return (cp & (1U << 3)) != 0U && (ps & 0xfU) != 0U;
}

/* One symbol, 160 bytes, both pointers 16 byte aligned: ten 128-bit loads and stores. */
static inline __attribute__((always_inline)) void copy_sym_vec(uint32_t *dst, const uint32_t *src)
{
	__asm__ volatile("ee.vld.128.ip q0, %[s], 16\n\t"
			 "ee.vld.128.ip q1, %[s], 16\n\t"
			 "ee.vld.128.ip q2, %[s], 16\n\t"
			 "ee.vst.128.ip q0, %[d], 16\n\t"
			 "ee.vld.128.ip q3, %[s], 16\n\t"
			 "ee.vst.128.ip q1, %[d], 16\n\t"
			 "ee.vld.128.ip q0, %[s], 16\n\t"
			 "ee.vst.128.ip q2, %[d], 16\n\t"
			 "ee.vld.128.ip q1, %[s], 16\n\t"
			 "ee.vst.128.ip q3, %[d], 16\n\t"
			 "ee.vld.128.ip q2, %[s], 16\n\t"
			 "ee.vst.128.ip q0, %[d], 16\n\t"
			 "ee.vld.128.ip q3, %[s], 16\n\t"
			 "ee.vst.128.ip q1, %[d], 16\n\t"
			 "ee.vld.128.ip q0, %[s], 16\n\t"
			 "ee.vst.128.ip q2, %[d], 16\n\t"
			 "ee.vst.128.ip q3, %[d], 16\n\t"
			 "ee.vst.128.ip q0, %[d], 16\n\t"
			 : [s] "+r"(src), [d] "+r"(dst)
			 :
			 : "memory");
}
#else
static inline bool vec_ok(void)
{
	return false;
}

static inline void copy_sym_vec(uint32_t *dst, const uint32_t *src)
{
	(void)dst;
	(void)src;
}
#endif

/* One symbol as groups of 4 plain word stores (a memcpy call costs more than the copy). */
static inline __attribute__((always_inline)) void copy_sym(uint32_t *dst, const uint32_t *src)
{
	for (uint32_t k = 0; k < GFSK_MOD_SPS; k += 4U) {
		uint32_t w0 = src[k], w1 = src[k + 1U], w2 = src[k + 2U], w3 = src[k + 3U];

		dst[k] = w0;
		dst[k + 1U] = w1;
		dst[k + 2U] = w2;
		dst[k + 3U] = w3;
	}
}

/* gen_steady() from the rows: pick by history and the quarter turn of the start phase, copy. */
UBT_HOT(PACED_SAMPLE, gen_replay)
static void gen_replay(const struct gfsk_mod *m, uint32_t *dst, uint32_t s, uint32_t nsym,
		       int32_t sum)
{
	const struct gfsk_burst *b = &m->b;
	const bool vec = vec_ok() && ((uintptr_t)dst & 15U) == 0U;
	uint32_t d = s - b->lead, q = (uint32_t)sum & 3U;
	unsigned int h = (bit_at(b, d - 1U) << 2) | (bit_at(b, d) << 1) | bit_at(b, d + 1U);

	while (nsym-- > 0U) {
		const uint32_t *src = m->rows->w[h][q];

		if (vec) {
			copy_sym_vec(dst, src);
		} else {
			copy_sym(dst, src);
		}
		dst += GFSK_MOD_SPS;
		/* The symbol before this one's neighbours joins the sum. */
		q = (q + ((h & 4U) != 0U ? 1U : 3U)) & 3U;
		d++;
		if (nsym > 0U) {
			h = ((h << 1) & 6U) | bit_at(b, d + 1U);
		}
	}
}

/*
 * @p nsym whole symbols from symbol @p s of a burst, every one with its neighbours inside the bits
 * and clear of the ramps: the loop that matters, with the state in registers. @p sum is the sum
 * of the symbols before s - 1.
 */
UBT_HOT(PACED_SAMPLE, gen_steady)
static void gen_steady(const struct gfsk_mod *m, uint32_t *dst, uint32_t s, uint32_t nsym,
			       int32_t sum)
{
	const struct gfsk_tab *tab = m->tab;
	const struct gfsk_burst *b = &m->b;
	const uint32_t *lut = m->lut->w;
	const uint32_t step = (uint32_t)tab->bit_step,
		       ifstep = GFSK_MOD_SPS * (uint32_t)tab->if_inc;
	uint32_t d = s - b->lead, ifb = s * ifstep, bs = step * (uint32_t)sum;
	unsigned int h = (bit_at(b, d - 1U) << 2) | (bit_at(b, d) << 1) | bit_at(b, d + 1U);

	while (nsym-- > 0U) {
		uint32_t acc = ((ifb + bs + (uint32_t)tab->phi0[h]) >> 16) + ACC_BIAS;

		emit_symbol(lut, acc, tab->inc[h], dst);
		dst += GFSK_MOD_SPS;
		ifb += ifstep;
		/* The symbol before this one's neighbours joins the sum. */
		bs += (h & 4U) != 0U ? step : -step;
		d++;
		if (nsym > 0U) {
			h = ((h << 1) & 6U) | bit_at(b, d + 1U);
		}
	}
}

/* Raised cosine gain of ramp sample r (0 to ramp - 1), Q15. */
static int32_t ramp_gain(const struct gfsk_mod *m, uint32_t r)
{
	uint32_t g = ((2U * r + 1U) * m->ramp_step) >> 17;

	return (32768 - sin_q15(g + GRID_QUAD)) >> 1;
}

/* A symbol run inside a ramp: samples [u, u + cnt) of the burst, per sample gain. */
UBT_HOT(PACED_SAMPLE, emit_ramp)
static void emit_ramp(const struct gfsk_mod *m, uint32_t acc, const int16_t *row,
			      uint32_t cnt, uint32_t u, uint32_t *dst)
{
	uint32_t ramp = m->b.ramp, down = m->total - ramp;

	for (uint32_t k = 0; k < cnt; k++, u++) {
		uint32_t w = m->lut->w[(acc >> ACC_SHIFT) & LUT_MASK];

		if (u < ramp || u >= down) {
			int32_t g = ramp_gain(m, u < ramp ? u : m->total - 1U - u);
			int32_t i = (int32_t)(w << 22) >> 22, q = (int32_t)(w << 12) >> 22;

			w = gfsk_word((i * g + 16384) >> 15, (q * g + 16384) >> 15);
		}
		dst[k] = w;
		acc += inc_of(row[k]);
	}
}

/* Words for samples [pos, pos + n) of a burst, loop or carrier, pos + n <= total. */
ESP_SDR_CODE(PACED_CHUNK, gen_range)
static void gen_range(const struct gfsk_mod *m, uint32_t *dst, uint32_t pos, uint32_t n)
{
	const struct gfsk_tab *tab = m->tab;
	const bool carrier = m->b.kind == GFSK_CARRIER;
	uint32_t s = pos / GFSK_MOD_SPS, t = pos % GFSK_MOD_SPS;
	uint32_t ifb = s * GFSK_MOD_SPS * (uint32_t)tab->if_inc;
	int bp = 0, bc = 0, bn = 0;
	int32_t sum = 0;
	int16_t zero_row[GFSK_MOD_SPS];
	int32_t zero_phi0 = 0;

	if (carrier) {
		gfsk_tab_row(tab, 0, 0, 0, zero_row, &zero_phi0);
	} else {
		bp = sym_at(m, (int32_t)s - 1);
		bc = sym_at(m, (int32_t)s);
		bn = sym_at(m, (int32_t)s + 1);
		sum = sym_sum(m, (int32_t)s - 1);
		if (m->b.kind == GFSK_LOOP && s == 0U) {
			/* The periodic past nets to zero before bit 0: the sum up to bit -2 drops
			 * bit -1. */
			sum = -bp;
		}
	}
	/* Symbols s_a to s_b - 1 of a burst have all their neighbours in the bits and no ramp in
	 * them. */
	uint32_t s_a = 1, s_b = 0;

	if (m->b.kind == GFSK_BURST) {
		s_a = (uint32_t)m->b.lead + 1U;
		s_b = (uint32_t)m->b.lead + m->b.nbits - 1U;
		if (m->b.ramp != 0U) {
			uint32_t up = (m->b.ramp + GFSK_MOD_SPS - 1U) / GFSK_MOD_SPS;
			uint32_t down = (m->total - m->b.ramp) / GFSK_MOD_SPS;

			s_a = s_a > up ? s_a : up;
			s_b = s_b < down ? s_b : down;
		}
	}
	while (n > 0U) {
		uint32_t cnt = GFSK_MOD_SPS - t < n ? GFSK_MOD_SPS - t : n;
		const int16_t *row;
		int16_t tmp[GFSK_MOD_SPS];
		int32_t phi0;
		uint32_t acc;

		if (t == 0U && n >= GFSK_MOD_SPS && s >= s_a && s < s_b) {
			uint32_t nsym = n / GFSK_MOD_SPS < s_b - s ? n / GFSK_MOD_SPS : s_b - s;

			if (m->rows != NULL) {
				gen_replay(m, dst, s, nsym, sum);
			} else {
				gen_steady(m, dst, s, nsym, sum);
			}
			dst += nsym * GFSK_MOD_SPS;
			pos += nsym * GFSK_MOD_SPS;
			n -= nsym * GFSK_MOD_SPS;
			s += nsym;
			ifb += nsym * GFSK_MOD_SPS * (uint32_t)tab->if_inc;
			if (n > 0U) {
				/* Back to the general path: its state from the symbols at the new
				 * place. */
				bp = sym_at(m, (int32_t)s - 1);
				bc = sym_at(m, (int32_t)s);
				bn = sym_at(m, (int32_t)s + 1);
				sum = sym_sum(m, (int32_t)s - 1);
			}
			continue;
		}
		if (carrier) {
			row = zero_row;
			phi0 = zero_phi0;
		} else if (bp != 0 && bc != 0 && bn != 0) {
			unsigned int h =
				(bp > 0 ? 4U : 0U) | (bc > 0 ? 2U : 0U) | (bn > 0 ? 1U : 0U);

			row = tab->inc[h];
			phi0 = tab->phi0[h];
		} else {
			gfsk_tab_row(tab, bp, bc, bn, tmp, &phi0);
			row = tmp;
		}
		acc = ((ifb + (uint32_t)tab->bit_step * (uint32_t)sum + (uint32_t)phi0) >> 16) +
		      ACC_BIAS;
		for (uint32_t k = 0; k < t; k++) {
			acc += inc_of(row[k]);
		}
		row += t;
		if (m->b.ramp != 0U && (pos < m->b.ramp || pos + cnt > m->total - m->b.ramp)) {
			emit_ramp(m, acc, row, cnt, pos, dst);
		} else {
			emit(m->lut->w, acc, row, cnt, dst);
		}
		dst += cnt;
		pos += cnt;
		n -= cnt;
		t = 0;
		s++;
		ifb += GFSK_MOD_SPS * (uint32_t)tab->if_inc;
		if (!carrier) {
			sum += bp;
			bp = bc;
			bc = bn;
			bn = sym_at(m, (int32_t)s + 1);
		}
	}
}

UBT_HOT(PACED_CHUNK, gfsk_mod_gen)
void gfsk_mod_gen(const struct gfsk_mod *m, uint32_t *dst, uint64_t index, uint32_t n)
{
	if (m->b.kind != GFSK_BURST) {
		uint32_t pos = (uint32_t)(index % m->total);

		while (n > 0U) {
			uint32_t cnt = m->total - pos < n ? m->total - pos : n;

			gen_range(m, dst, pos, cnt);
			dst += cnt;
			n -= cnt;
			pos = 0;
		}
		return;
	}
	if (index >= m->total) {
		memset(dst, 0, (size_t)n * sizeof(*dst));
		return;
	}
	if (index + n > m->total) {
		uint32_t cnt = m->total - (uint32_t)index;

		gen_range(m, dst, (uint32_t)index, cnt);
		memset(dst + cnt, 0, (size_t)(n - cnt) * sizeof(*dst));
		return;
	}
	gen_range(m, dst, (uint32_t)index, n);
}

ESP_SDR_CODE(PACED_CHUNK, gfsk_mod_gen_cb)
void gfsk_mod_gen_cb(void *user, uint32_t *dst, uint64_t index, uint32_t n)
{
	gfsk_mod_gen(user, dst, index, n);
}

size_t gfsk_mod_fill(struct gfsk_mod *m, uint32_t *dst, size_t n)
{
	if (m->b.kind == GFSK_BURST) {
		if (m->pos >= m->total) {
			return 0;
		}
		if (n > m->total - m->pos) {
			n = m->total - m->pos;
		}
	}
	for (size_t done = 0; done < n;) {
		size_t chunk = n - done > 0x40000000U ? 0x40000000U : n - done;

		gfsk_mod_gen(m, dst + done, m->pos, (uint32_t)chunk);
		m->pos = m->b.kind == GFSK_BURST
				 ? m->pos + (uint32_t)chunk
				 : (uint32_t)(((uint64_t)m->pos + chunk) % m->total);
		done += chunk;
	}
	return n;
}
```

## src/gfsk_sym.h
```c
/*
 * SPDX-License-Identifier: GPL-3.0-or-later
 *
 * The interface between the GFSK demodulator (gfsk_demod.c) and its consumers
 * (the BR symbol blocks in ubt_br.c, the BLE packet finder in ubt_le.c): one
 * hard-decision symbol per 1 Msym/s symbol period.
 */

#ifndef GFSK_SYM_H_
#define GFSK_SYM_H_

#include <stdint.h>

/* The 4 MS/s stream: 4 samples per symbol. */
#define GFSK_SAMPLES_PER_SYM 4U

enum gfsk_modulation {
	GFSK_BLE = 0, /* h = 0.5, +-250 kHz */
	GFSK_BR = 1,  /* h about 0.32, +-160 kHz */
};

struct gfsk_sym {
	/* Sample index of the stream (4 MS/s units, wraps at 2^32) at the decision instant. */
	uint32_t t;
	/* 1 for a positive frequency deviation (upstream: "a 1 is the higher frequency"). */
	uint8_t bit;
	/*
	 * Signal power of the symbol in 0.5 dB steps: 2 * (dBFS + 100), saturating at 0 and 255,
	 * dBFS relative to a full scale complex tone (int16 samples, 8192 peak per axis, 0 dBFS).
	 */
	uint8_t pwr;
};

#endif /* GFSK_SYM_H_ */
```

## src/ubt_attr.h
```c
/*
 * SPDX-License-Identifier: GPL-3.0-or-later
 *
 * Placement of the receive path's code and data by usage category (esp_sdr_place.h; the app's
 * rules in place.h). UBT_HOT(cat, fn): a function placed by its category and never inlined into a
 * caller placed elsewhere; on the host, plain code.
 */

#ifndef UBT_ATTR_H_
#define UBT_ATTR_H_

#include <esp_sdr/esp_sdr_place.h>

#if defined(__ZEPHYR__)
#define UBT_HOT(cat, fn) ESP_SDR_CODE(cat, fn) __attribute__((noinline))
#else
#define UBT_HOT(cat, fn)
#endif

#endif /* UBT_ATTR_H_ */
```
