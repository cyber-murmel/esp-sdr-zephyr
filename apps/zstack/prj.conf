## CMakeLists.txt
```
# SPDX-License-Identifier: GPL-3.0-or-later

cmake_minimum_required(VERSION 3.20.0)

find_package(Zephyr REQUIRED HINTS $ENV{ZEPHYR_BASE})
project(esp_sdr_zstack)

target_sources(app PRIVATE
  src/main.c
  src/nv_store.c
  src/radio_c6.c
  src/transport.c)
```

## Kconfig
```
# SPDX-License-Identifier: GPL-3.0-or-later

mainmenu "zstack: Zigbee coordinator with the Z-Stack ZNP serial protocol"

config ZSTACK_RX_BUF
	int "Receive buffer in bytes"
	default 1024

config ZSTACK_TX_BUF
	int "Transmit buffer in bytes"
	default 2048
	help
	  Frames for the host wait here for the USB endpoint; a frame that does not fit
	  is dropped whole.

config ZSTACK_IDLE_MS
	int "Idle gap that drops a partial frame, in ms"
	default 100

config ZSTACK_NV_REC_MAX
	int "Largest NV item that is stored in flash, in bytes"
	default 2048

source "Kconfig.zephyr"
```

## sample.yaml
```
sample:
  name: Z-Stack
  description: >-
    A Zigbee coordinator that speaks the Z-Stack 3.x ZNP serial protocol, for
    zigbee2mqtt and zigpy-znp
common:
  tags:
    - esp-sdr
    - zigbee
  platform_allow:
    - xiao_esp32c6/esp32c6/hpcore
    - why2025_badge/esp32c6/hpcore
  integration_platforms:
    - xiao_esp32c6/esp32c6/hpcore
tests:
  # Needs a host: see README.
  sample.esp_sdr.zstack:
    build_only: true
```

## prj.conf
```kconfig
CONFIG_ZIGBEE_ZNP=y
CONFIG_ENTROPY_GENERATOR=y

# The host link is USB-Serial-JTAG (interrupt driven, socs/); the console is UART0.
CONFIG_SERIAL=y
CONFIG_UART_INTERRUPT_DRIVEN=y

# NV items survive resets in the storage partition.
CONFIG_FLASH=y
CONFIG_FLASH_MAP=y
CONFIG_NVS=y
CONFIG_HWINFO=y

# The radio driver's frames are net_pkts; no IP on top.
CONFIG_NETWORKING=y
CONFIG_NET_IPV6=n
CONFIG_NET_IPV4=n
CONFIG_NET_PKT_RX_COUNT=8
CONFIG_NET_PKT_TX_COUNT=2
CONFIG_NET_BUF_RX_COUNT=16
CONFIG_NET_BUF_TX_COUNT=4
CONFIG_NET_BUF_DATA_SIZE=128

CONFIG_LOG=y
CONFIG_LOG_MODE_DEFERRED=y
CONFIG_MAIN_STACK_SIZE=3072
```

## boards/xiao_esp32c6_hpcore.conf
```kconfig
# Native radio in raw mode: no L2, the app drives the radio API.
CONFIG_NET_L2_IEEE802154=n
CONFIG_IEEE802154=y
CONFIG_IEEE802154_RAW_MODE=y

# The chip antenna is the default. For the U.FL coax port add
# -DCONFIG_XIAO_ESP32C6_EXT_ANTENNA=y to the build.
```

## socs/esp32c6_hpcore.conf
```kconfig
# Native radio in raw mode: no L2, the app drives the radio API.
CONFIG_NET_L2_IEEE802154=n
CONFIG_IEEE802154=y
CONFIG_IEEE802154_RAW_MODE=y
```

## boards/xiao_esp32c6_hpcore.overlay
```dts
/*
 * SPDX-License-Identifier: GPL-3.0-or-later
 *
 * USB-Serial-JTAG carries the ZNP protocol, so the console moves to UART0 (D6 TX, D7 RX).
 */

/ {
	chosen {
		zephyr,console = &uart0;
		zephyr,shell-uart = &uart0;
		zephyr,zstack-uart = &usb_serial;
	};
};
```

## socs/esp32c6_hpcore.overlay
```dts
/*
 * SPDX-License-Identifier: GPL-3.0-or-later
 *
 * USB-Serial-JTAG carries the ZNP protocol, so the console moves to UART0 (on the XIAO D6 TX,
 * D7 RX).
 */

/ {
	chosen {
		zephyr,console = &uart0;
		zephyr,shell-uart = &uart0;
		zephyr,zstack-uart = &usb_serial;
	};
};
```

## src/main.c
```c
/*
 * SPDX-License-Identifier: GPL-3.0-or-later
 *
 * Z-Stack coordinator: a Zigbee network processor behind the Z-Stack 3.x ZNP serial protocol.
 */
#include <string.h>

#include <zephyr/drivers/hwinfo.h>
#include <zephyr/kernel.h>
#include <zephyr/logging/log.h>

#include <zigbee/zb_stack.h>

#include "zstack.h"

LOG_MODULE_REGISTER(zstack, LOG_LEVEL_INF);

static struct znp_nv nv;
static struct znp znp;
static struct zb_stack stack;

K_THREAD_STACK_DEFINE(mac_stack, 4096);

/* EUI-64 from the factory MAC (FFFE in the middle), little endian as ZNP carries it. */
static void ext_addr(uint8_t out[8])
{
	uint8_t mac[8] = {0};
	ssize_t n = hwinfo_get_device_id(mac, sizeof(mac));
	uint8_t eui[8];

	if (n >= 6) {
		eui[0] = mac[0];
		eui[1] = mac[1];
		eui[2] = mac[2];
		eui[3] = 0xFF;
		eui[4] = 0xFE;
		eui[5] = mac[3];
		eui[6] = mac[4];
		eui[7] = mac[5];
	} else {
		memcpy(eui, mac, 8);
	}
	for (int i = 0; i < 8; i++) {
		out[i] = eui[7 - i];
	}
}

int main(void)
{
	struct znp_config cfg = {
		.tx = transport_tx,
		.nv = &nv,
	};
	const struct zb_radio_ops *radio;
	uint8_t eui[8];

	znp_nv_init(&nv, NULL);
	if (nv_store_init(&nv) != 0) {
		LOG_ERR("NV store unavailable, items will not persist");
	}
	ext_addr(eui);
	memcpy(cfg.ext_addr, eui, sizeof(eui));
	radio = radio_c6_init(&stack.mac);
	if (radio == NULL) {
		LOG_ERR("802.15.4 radio not ready");
		return -1;
	}
	znp_init(&znp, &cfg);
	zb_stack_init(&stack, &znp, &nv, radio, NULL, eui, mac_stack,
		      K_THREAD_STACK_SIZEOF(mac_stack), K_PRIO_PREEMPT(4));
	transport_start(&znp);
	znp_send_reset_ind(&znp, ZNP_RESET_POWER_UP);
	LOG_INF("ZNP up, IEEE %02x%02x%02x%02x%02x%02x%02x%02x, %s", eui[7], eui[6], eui[5], eui[4],
		eui[3], eui[2], eui[1], eui[0], stack.net.formed ? "network restored" : "no network");

	for (;;) {
		k_sleep(K_SECONDS(1));
		if (znp_nv_dirty(&nv)) {
			znp_nv_flush(&nv);
		}
	}
	return 0;
}
```

## src/nv_store.c
```c
/*
 * SPDX-License-Identifier: GPL-3.0-or-later
 *
 * NV store backend: one NVS entry per slot (id slot + 1), holding the item key and data.
 */
#include <errno.h>
#include <string.h>

#include <zephyr/device.h>
#include <zephyr/drivers/flash.h>
#include <zephyr/kvss/nvs.h>
#include <zephyr/kernel.h>
#include <zephyr/logging/log.h>
#include <zephyr/storage/flash_map.h>

#include "zstack.h"

LOG_MODULE_REGISTER(nv_store, LOG_LEVEL_INF);

#define STORAGE_ID   PARTITION_ID(storage_partition)
#define KEY_BYTES    5
#define REC_MAX      (KEY_BYTES + CONFIG_ZSTACK_NV_REC_MAX)

static struct nvs_fs fs;
/* Only the main loop and the reset hook use it, never at the same time. */
static uint8_t rec[REC_MAX];

static int store(void *ctx, uint16_t slot, const struct znp_nv_key *key, const void *data,
		 uint16_t len)
{
	ARG_UNUSED(ctx);

	if (len == 0U) {
		return nvs_delete(&fs, slot + 1U);
	}
	if (len > CONFIG_ZSTACK_NV_REC_MAX) {
		LOG_WRN("NV item %02x/%04x/%04x of %u bytes is too large to store", key->sys,
			key->item, key->sub, len);
		return -EFBIG;
	}
	rec[0] = key->sys;
	mt_put_u16(&rec[1], key->item);
	mt_put_u16(&rec[3], key->sub);
	memcpy(&rec[KEY_BYTES], data, len);

	int r = nvs_write(&fs, slot + 1U, rec, KEY_BYTES + len);

	return r < 0 ? r : 0;
}

int nv_store_init(struct znp_nv *nv)
{
	struct flash_pages_info page;
	int ret, restored = 0;

	fs.flash_device = PARTITION_DEVICE(storage_partition);
	fs.offset = PARTITION_OFFSET(storage_partition);
	if (!device_is_ready(fs.flash_device)) {
		return -ENODEV;
	}
	ret = flash_get_page_info_by_offs(fs.flash_device, fs.offset, &page);
	if (ret != 0) {
		return ret;
	}
	fs.sector_size = page.size;
	fs.sector_count = PARTITION_SIZE(storage_partition) / page.size;
	ret = nvs_mount(&fs);
	if (ret != 0) {
		LOG_ERR("nvs_mount: %d", ret);
		return ret;
	}

	for (int slot = 0; slot < CONFIG_ZNP_NV_ITEMS; slot++) {
		ssize_t n = nvs_read(&fs, slot + 1, rec, sizeof(rec));

		if (n <= KEY_BYTES) {
			continue;
		}
		struct znp_nv_key key = {
			.sys = rec[0], .item = mt_get_u16(&rec[1]), .sub = mt_get_u16(&rec[3])};

		if (znp_nv_restore(nv, slot, key, &rec[KEY_BYTES], n - KEY_BYTES) == 0) {
			restored++;
		}
	}
	LOG_INF("NV store: %d items restored", restored);
	nv->be = (struct znp_nv_backend){.store = store};
	return 0;
}
```

## src/radio_c6.c
```c
/*
 * SPDX-License-Identifier: GPL-3.0-or-later
 *
 * The ESP32-C6 native 802.15.4 radio as a zb_radio: Zephyr's ieee802154_radio_api in raw mode
 * plus the few HAL calls the driver does not expose. Its gotchas: changes reach the hardware at
 * the next start/tx/ed; the driver has no CSMA backoff or retries; promiscuous mode stops the
 * hardware ACKs.
 */
#include <errno.h>
#include <string.h>

#include <zephyr/device.h>
#include <zephyr/kernel.h>
#include <zephyr/net/ieee802154_radio.h>
#include <zephyr/net/net_pkt.h>

#include <esp_ieee802154.h>

#include "zstack.h"

#define FCS_LEN 2U
/* Slack on top of the scan time before an energy detect is given up. */
#define ED_SLACK_MS 500

static const struct device *const radio = DEVICE_DT_GET(DT_CHOSEN(zephyr_ieee802154));
static const struct ieee802154_radio_api *api;
static struct zb_mac *rx_mac;

static K_SEM_DEFINE(ed_done, 0, 1);
static int16_t ed_result;

NET_BUF_POOL_DEFINE(tx_pool, 1, ZB_MAC_MAX_FRAME, 0, NULL);

/*
 * Raw mode hands every frame here, on the driver's own thread (1 KiB stack): copy it out and
 * return. The last two bytes of the packet are RSSI and LQI where the FCS was.
 */
int net_recv_data(struct net_if *iface, struct net_pkt *pkt)
{
	static uint8_t buf[ZB_MAC_MAX_FRAME + FCS_LEN];
	size_t len = net_pkt_get_len(pkt);
	uint8_t lqi = net_pkt_ieee802154_lqi(pkt);
	int8_t rssi = (int8_t)net_pkt_ieee802154_rssi_dbm(pkt);

	ARG_UNUSED(iface);
	net_pkt_cursor_init(pkt);
	if (len > FCS_LEN && len <= sizeof(buf) && net_pkt_read(pkt, buf, len) == 0 &&
	    rx_mac != NULL) {
		zb_mac_rx(rx_mac, buf, (uint8_t)(len - FCS_LEN), lqi, rssi);
	}
	net_pkt_unref(pkt);
	return 0;
}

enum net_verdict ieee802154_handle_ack(struct net_if *iface, struct net_pkt *pkt)
{
	ARG_UNUSED(iface);
	ARG_UNUSED(pkt);
	return NET_OK;
}

static int c6_set_channel(void *ctx, uint8_t ch)
{
	ARG_UNUSED(ctx);
	return api->set_channel(radio, ch);
}

static int c6_set_ids(void *ctx, uint16_t pan, uint16_t short_addr, const uint8_t ext[8])
{
	struct ieee802154_filter f;
	uint8_t ieee[8];
	int r;

	ARG_UNUSED(ctx);
	memcpy(ieee, ext, sizeof(ieee));
	f.pan_id = pan;
	r = api->filter(radio, true, IEEE802154_FILTER_TYPE_PAN_ID, &f);
	f.short_addr = short_addr;
	r |= api->filter(radio, true, IEEE802154_FILTER_TYPE_SHORT_ADDR, &f);
	f.ieee_addr = ieee;
	r |= api->filter(radio, true, IEEE802154_FILTER_TYPE_IEEE_ADDR, &f);
	return r != 0 ? -EIO : 0;
}

static int c6_set_mode(void *ctx, bool coordinator, bool promiscuous)
{
	struct ieee802154_config cfg = {.promiscuous = promiscuous};
	int r;

	ARG_UNUSED(ctx);
	r = api->configure(radio, IEEE802154_CONFIG_PROMISCUOUS, &cfg);
	r |= esp_ieee802154_set_coordinator(coordinator);
	return r != 0 ? -EIO : 0;
}

static int c6_set_txpower(void *ctx, int8_t dbm)
{
	ARG_UNUSED(ctx);
	return api->set_txpower(radio, dbm);
}

static int c6_start(void *ctx)
{
	ARG_UNUSED(ctx);
	return api->start(radio);
}

static int c6_tx(void *ctx, const uint8_t *f, size_t n, bool csma)
{
	struct net_pkt *pkt;
	struct net_buf *buf;
	int r;

	ARG_UNUSED(ctx);
	/* Drivers take the frame as one buffer; the packet is only a handle for this one. */
	buf = net_buf_alloc(&tx_pool, K_MSEC(100));
	if (buf == NULL) {
		return -ENOMEM;
	}
	net_buf_add_mem(buf, f, n);
	pkt = net_pkt_alloc(K_MSEC(100));
	if (pkt == NULL) {
		net_buf_unref(buf);
		return -ENOMEM;
	}
	r = api->tx(radio, csma ? IEEE802154_TX_MODE_CSMA_CA : IEEE802154_TX_MODE_DIRECT, pkt, buf);
	net_pkt_unref(pkt);
	net_buf_unref(buf);
	return r;
}

/* Runs on the system workqueue; in raw mode @p dev is NULL. */
static void ed_cb(const struct device *dev, int16_t max_ed)
{
	ARG_UNUSED(dev);
	ed_result = max_ed;
	k_sem_give(&ed_done);
}

static int c6_ed(void *ctx, uint16_t ms, int8_t *dbm)
{
	int r;

	ARG_UNUSED(ctx);
	k_sem_reset(&ed_done);
	r = api->ed_scan(radio, ms, ed_cb);
	if (r != 0) {
		return r;
	}
	if (k_sem_take(&ed_done, K_MSEC(ms + ED_SLACK_MS)) != 0) {
		return -ETIMEDOUT;
	}
	*dbm = (int8_t)ed_result;
	return 0;
}

static const struct zb_radio_ops c6_ops = {
	.set_channel = c6_set_channel,
	.set_ids = c6_set_ids,
	.set_mode = c6_set_mode,
	.set_txpower = c6_set_txpower,
	.start = c6_start,
	.tx = c6_tx,
	.ed = c6_ed,
};

const struct zb_radio_ops *radio_c6_init(struct zb_mac *mac)
{
	if (!device_is_ready(radio)) {
		return NULL;
	}
	api = radio->api;
	rx_mac = mac;
	return &c6_ops;
}
```

## src/transport.c
```c
/*
 * SPDX-License-Identifier: GPL-3.0-or-later
 *
 * The host link: USB-Serial-JTAG through Zephyr's interrupt driven UART API. Bytes go
 * through ring buffers; a thread feeds the ZNP and drops a partial frame after an idle gap.
 */
#include <zephyr/device.h>
#include <zephyr/drivers/uart.h>
#include <zephyr/kernel.h>
#include <zephyr/logging/log.h>
#include <zephyr/sys/ring_buffer.h>

#include "zstack.h"

LOG_MODULE_REGISTER(transport, LOG_LEVEL_INF);

#define USB_PACKET 64

static const struct device *const uart = DEVICE_DT_GET(DT_CHOSEN(zephyr_zstack_uart));

RING_BUF_DECLARE(rx_rb, CONFIG_ZSTACK_RX_BUF);
RING_BUF_DECLARE(tx_rb, CONFIG_ZSTACK_TX_BUF);
static K_SEM_DEFINE(rx_sem, 0, 1);
static struct znp *znp;
static uint32_t rx_dropped, tx_dropped;

static void uart_isr(const struct device *dev, void *user)
{
	ARG_UNUSED(user);

	uart_irq_update(dev);
	while (uart_irq_is_pending(dev)) {
		if (uart_irq_rx_ready(dev)) {
			uint8_t buf[USB_PACKET];
			int n = uart_fifo_read(dev, buf, sizeof(buf));

			if (n > 0) {
				if ((uint32_t)ring_buf_put(&rx_rb, buf, n) != (uint32_t)n) {
					rx_dropped++;
				}
				k_sem_give(&rx_sem);
			}
		}
		if (uart_irq_tx_ready(dev)) {
			uint8_t buf[USB_PACKET];
			uint32_t n = ring_buf_peek(&tx_rb, buf, sizeof(buf));

			if (n == 0U) {
				uart_irq_tx_disable(dev);
				continue;
			}
			n = uart_fifo_fill(dev, buf, n);
			ring_buf_consume(&tx_rb, n);
		}
	}
}

void transport_tx(void *user, const uint8_t *buf, size_t len)
{
	ARG_UNUSED(user);

	/* Whole frames only: a cut one would put the host's parser out of step. */
	if (ring_buf_space_get(&tx_rb) < len) {
		tx_dropped++;
		return;
	}
	ring_buf_put(&tx_rb, buf, len);
	uart_irq_tx_enable(uart);
}

static void rx_thread(void *a, void *b, void *c)
{
	uint8_t buf[USB_PACKET];
	uint32_t n;

	for (;;) {
		if (k_sem_take(&rx_sem, K_MSEC(CONFIG_ZSTACK_IDLE_MS)) != 0) {
			znp_rx_idle(znp);
			continue;
		}
		while ((n = ring_buf_get(&rx_rb, buf, sizeof(buf))) > 0U) {
			znp_rx(znp, buf, n);
		}
	}
}

K_THREAD_STACK_DEFINE(rx_stack, 3072);
static struct k_thread rx_thread_data;

void transport_start(struct znp *z)
{
	znp = z;
	if (!device_is_ready(uart)) {
		LOG_ERR("host link %s not ready", uart->name);
		return;
	}
	uart_irq_callback_user_data_set(uart, uart_isr, NULL);
	uart_irq_rx_enable(uart);
	k_thread_create(&rx_thread_data, rx_stack, K_THREAD_STACK_SIZEOF(rx_stack), rx_thread, NULL,
			NULL, NULL, K_PRIO_PREEMPT(5), 0, K_NO_WAIT);
	k_thread_name_set(&rx_thread_data, "znp_rx");
}
```

## src/zstack.h
```c
/*
 * SPDX-License-Identifier: GPL-3.0-or-later
 */
#ifndef ZSTACK_H_
#define ZSTACK_H_

#include <zigbee/zb_mac.h>
#include <zigbee/zb_radio.h>
#include <zigbee/znp.h>

/* Host link (USB-Serial-JTAG). transport_tx() is the ZNP's tx callback. */
void transport_start(struct znp *z);
void transport_tx(void *user, const uint8_t *buf, size_t len);

/* The ESP32-C6 radio for the MAC; NULL if the device is missing. */
const struct zb_radio_ops *radio_c6_init(struct zb_mac *mac);

/* Flash backend of the NV store: mounts, loads stored items, then flush() persists. */
int nv_store_init(struct znp_nv *nv);

#endif /* ZSTACK_H_ */
```
