/*
 * SPDX-License-Identifier: GPL-3.0-or-later
 *
 * The 16 MB flash of an ESP32-P4 board (the WHY2025 badge, the ESP32-P4-Function-EV-Board):
 * MCUboot at 0x2000 and the application in the lower 8 MB (Espressif's 8 MB table: two 3840 KiB
 * slots), the upper 8 MB the FAT volume. The application and MCUboot
 * (sysbuild/mcuboot_p4.overlay) share it.
 */

&flash0 {
	/delete-node/ partitions;
};

#include <espressif/partitions_0x2000_default_8M.dtsi>

&flash0 {
	partitions {
		fat_partition: partition@800000 {
			compatible = "zephyr,mapped-partition";
			label = "fat";
			reg = <0x800000 DT_SIZE_M(8)>;
		};
	};
};
