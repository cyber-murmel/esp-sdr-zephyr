/*
 * SPDX-License-Identifier: GPL-3.0-or-later
 *
 * The VIEWE ESP32-S31 board: the 800x480 display and its touch screen; the REPL on the CH340
 * (UART0); the radio on the chip.
 */

/ {
	/* The FAT volume "FLASH", mounted at /FLASH:. */
	fat_disk: fat_disk {
		compatible = "zephyr,flash-disk";
		partition = <&fat_partition>;
		disk-name = "FLASH";
		cache-size = <4096>;
	};

	fstab {
		compatible = "zephyr,fstab";

		flash_fs: flash_fs {
			compatible = "zephyr,fstab,fatfs";
			mount-point = "/FLASH:";
			disk-access;
		};
	};
};

#include "partitions_p4.dtsi"
