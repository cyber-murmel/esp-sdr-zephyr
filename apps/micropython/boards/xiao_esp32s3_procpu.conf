## boards/badgeteam/mch2022_rp2040/Kconfig.defconfig
```kconfig
# SPDX-License-Identifier: GPL-3.0-or-later

if BOARD_MCH2022_RP2040

if I2C_DW

config I2C_DW_CLOCK_SPEED
	default 125

endif # I2C_DW

config USB_SELF_POWERED
	default n

endif # BOARD_MCH2022_RP2040
```

## boards/badgeteam/mch2022_rp2040/Kconfig.mch2022_rp2040
```kconfig
# SPDX-License-Identifier: GPL-3.0-or-later

config BOARD_MCH2022_RP2040
	select SOC_RP2040
```

## boards/badgeteam/mch2022_rp2040/board.yml
```yaml
board:
  name: mch2022_rp2040
  full_name: MCH2022 badge (RP2040 coprocessor)
  vendor: badgeteam
  socs:
    - name: rp2040
```

## boards/badgeteam/mch2022_rp2040/mch2022_rp2040_defconfig
```kconfig
CONFIG_SERIAL=y
CONFIG_GPIO=y
CONFIG_USE_DT_CODE_PARTITION=y
CONFIG_BUILD_OUTPUT_BIN=y
CONFIG_BUILD_OUTPUT_HEX=y
CONFIG_BUILD_OUTPUT_UF2=y
CONFIG_RESET=y
CONFIG_CLOCK_CONTROL=y
# Entered from the badge's bootloader.
CONFIG_INIT_ARCH_HW_AT_BOOT=y
```

## drivers/esdr_fpga/Kconfig
```kconfig
# SPDX-License-Identifier: GPL-3.0-or-later

config ESDR_FPGA
	bool "esp-sdr gateware on the MCH2022 badge's iCE40"
	default y
	depends on DT_HAS_ESDR_MCH2022_FPGA_ENABLED
	select SPI
	select GPIO
	select MFD
	# Frames of up to 64 KiB: wait for them, do not spin.
	imply SPI_ESP32_INTERRUPT
	help
	  Loads the iCE40UP5K through the RP2040 (CRESET, CDONE) and SPI3, and talks to the
	  gateware in gateware/ over the same SPI port.

if ESDR_FPGA

config ESDR_FPGA_INIT_PRIORITY
	int "Init priority"
	default 81
	help
	  After the RP2040 MFD (80), before the display (85).

config ESDR_FPGA_IMAGE
	string "Bitstream to embed and load at boot"
	help
	  Path of a bitstream built from gateware/ (python -m esdr_fpga.build). Empty: nothing is
	  loaded at boot; esdr_fpga_load() can still configure the FPGA later.

config ESDR_FPGA_IMAGE_EMBEDDED
	bool
	default y if ESDR_FPGA_IMAGE != ""

module = ESDR_FPGA
module-str = esdr_fpga
source "subsys/logging/Kconfig.template.log_config"

endif

config MIPI_DBI_ESDR_FPGA
	bool "Panel behind the MCH2022 badge's FPGA"
	default y
	depends on DT_HAS_ESDR_MCH2022_FPGA_DBI_ENABLED
	depends on ESDR_FPGA
	select MIPI_DBI
	help
	  A MIPI-DBI controller that sends the display driver's commands and pixels through the
	  gateware to the ILI9341's 8080 bus, or straight over SPI when no gateware is loaded.

config MIPI_DBI_ESDR_FPGA_INIT_PRIORITY
	int "Init priority of the panel controller"
	default 82
	depends on MIPI_DBI_ESDR_FPGA
	help
	  After the FPGA (81), before the display (85).
```

## dts/bindings/mipi-dbi/esdr,mch2022-fpga-dbi.yaml
```yaml
# SPDX-License-Identifier: GPL-3.0-or-later

description: |
  The MCH2022 badge's ILI9341 behind the iCE40. With the gateware loaded, LCD_MODE goes high,
  the FPGA drives the panel's 8080 bus and the driver's commands and pixels travel as DBI
  frames over the FPGA's SPI port. Without it, the panel stays on the ESP32's SPI bus
  (4-wire, D/C on a GPIO), as zephyr,mipi-dbi-spi drives it.

compatible: "esdr,mch2022-fpga-dbi"

include: mipi-dbi-controller.yaml

properties:
  fpga:
    type: phandle
    required: true
    description: The esdr,mch2022-fpga node.

  spi-dev:
    type: phandle
    required: true
    description: The SPI bus the panel sits on without the FPGA (its CS in cs-gpios).

  dc-gpios:
    type: phandle-array
    required: true
    description: D/C on the ESP32 (IO33); floats while the FPGA drives WR on the same line.

  reset-gpios:
    type: phandle-array
    required: true
    description: Panel reset, driven by the ESP32 (IO25) in both modes.

  lcd-mode-gpios:
    type: phandle-array
    required: true
    description: |
      LCD_MODE (IO26): high hands the panel to the FPGA's 8080 bus (IM0 high) and cuts the
      ESP32's SCK off the panel.
```

## dts/bindings/misc/esdr,mch2022-fpga.yaml
```yaml
# SPDX-License-Identifier: GPL-3.0-or-later

description: |
  esp-sdr gateware (gateware/) on the MCH2022 badge's iCE40UP5K: a child of the board's
  lattice,ice40-fpga node, which configures the FPGA. The configuration port doubles as the
  gateware's SPI slave.

compatible: "esdr,mch2022-fpga"

properties:
  frequency:
    type: int
    required: true
    description: SPI clock for frames; the parent's is the configuration port's, at most 25 MHz.

  irq-gpios:
    type: phandle-array
    description: FPGA interrupt, active low (ESP32 IO39).

  read-frequency:
    type: int
    default: 20000000
    description: |
      SPI clock for reads. MISO comes through the GPIO matrix; at 40 MHz the HAL inserts a
      timing dummy bit, below 26.7 MHz it does not.
```
