## lib/esp_sdr/Kconfig
```kconfig
# SPDX-License-Identifier: GPL-3.0-or-later

config ESP_SDR_PHY_ONLY
	bool "Radio without the Wi-Fi driver (ESP32-C6)"
	depends on SOC_SERIES_ESP32C6 && !WIFI_ESP32
	help
	  Brings the PHY up through the HAL's esp_phy_enable() instead of the
	  Wi-Fi driver, and links only the PHY and RF test libraries. Frees
	  the Wi-Fi driver's code, its heap and its share of SRAM blocks 0
	  and 1 (the gapless ring takes block 1), and drops the blob's
	  periodic receive glitch.

config ESP_SDR
	bool "ESP-SDR raw I/Q receiver"
	depends on SOC_SERIES_ESP32S3 || SOC_SERIES_ESP32C6 || SOC_SERIES_ESP32C5 || \
		   SOC_SERIES_ESP32
	depends on WIFI_ESP32 || ESP_SDR_PHY_ONLY
	# The bank and heap limits assume no APPCPU image in SRAM.
	depends on !SOC_ENABLE_APPCPU
	help
	  Burst capture of raw baseband I/Q samples from the Wi-Fi receiver,
	  ported from ESPARGOS esp-sdr. Reserves an SRAM bank for the capture
	  engine (64 KiB on the S3, the 128 KiB block 2 on the C6). The
	  ESP32-C6 captures at 80 MS/s only, and streams continuously,
	  CPU-paced (ESP_SDR_PACED). The ESP32-C5 receives at 80 to 4 MS/s
	  into its 128 KiB block 1, which splits the image around it, streams
	  like the C6 or gapless through the diagnostic bus (ESP_SDR_DIAG),
	  and loops waveforms through its DAC engine (ESP_SDR_REPLAY). The
	  ESP32 receives bursts at 80, 40 and 16 MS/s into 64 KiB of SRAM1,
	  which needs ESP32_REGION_1_NOINIT off.

if ESP_SDR

config ESP_SDR_RFTEST
	bool "Espressif RF test library (fixed RX gain, TX power steps)"
	default y
	# No blob for the ESP32, which forces its gain without it.
	depends on !SOC_SERIES_ESP32
	help
	  Links force_rx_gain(), force_tx_gain() and force_txon_mode() from
	  Espressif's librftest.a, fetched with "west blobs fetch
	  esp-sdr-zephyr". Without it the receiver runs on the hardware AGC
	  only and transmit keeps the PHY's own power setting.

config ESP_SDR_RX_DC_REMOVE
	bool "Receive DC taken off paced streams"
	depends on SOC_SERIES_ESP32C6 || SOC_SERIES_ESP32C5
	default y
	help
	  esp_sdr_rx_paced_start() measures the receive chain's DC with the
	  IQ estimator (32768 inputs, 2.5 ms with the settling) and every
	  sample has it taken off: without it the DC stands some 45 dB over
	  the noise floor at the stream's centre.

config ESP_SDR_RX_DECIM
	bool "Decimated capture"
	default y
	help
	  esp_sdr_rx_capture_decimated(): a full capture filtered and
	  decimated by a third order CIC, for narrow band streams.
	  esp_sdr_rx_capture_folded(): the same capture folded (decimated in
	  frequency, aliasing the whole band down) instead of filtered, for a
	  wideband power/occupancy survey. Apps that work at the native rate
	  can leave it out.

config ESP_SDR_PACED
	bool "CPU-paced streaming (ESP32-C6, ESP32-C5)"
	default y
	depends on (SOC_SERIES_ESP32C6 || SOC_SERIES_ESP32C5) && ESP_SDR_RFTEST
	help
	  esp_sdr_rx_paced_*() and esp_sdr_tx_paced_*(): continuous receive
	  through the modem's IQ estimator and continuous transmit through the
	  TX DC value register, paced by the CPU from the caller's loop.

config ESP_SDR_TRIG
	bool "Triggered 80 MS/s snapshots (ESP32-C6)"
	default y
	depends on SOC_SERIES_ESP32C6 && ESP_SDR_PACED
	help
	  esp_sdr_trig_*(): the dump engine as a 205 us ring in SRAM block 2,
	  frozen once the power the IQ estimator sums over the 80 MHz input
	  rises past a threshold, so a snapshot holds a burst and what came
	  before it.

config ESP_SDR_GAPLESS
	bool "Gapless 80 MS/s ring over two SRAM blocks (ESP32-C6)"
	depends on SOC_SERIES_ESP32C6 && ESP_SDR_PHY_ONLY && ESP_SDR_PACED
	help
	  esp_sdr_gapless_*(): the dump engine runs without a stop while the
	  CPU switches it between SRAM blocks 1 and 2 (upstream's ring, after
	  h0m3us3r/eSpDR), with marker words proving every unit boundary;
	  the CPU reads the block the engine is not writing. The image must
	  fit SRAM block 0, which in practice needs ESP_SDR_PHY_ONLY.

config ESP_SDR_GAPLESS_STAGE_KB
	int "Gapless staging ring, KiB"
	depends on ESP_SDR_GAPLESS
	default 48
	range 8 96
	help
	  Kept windows are copied raw from the ring's blocks into this ring
	  in SRAM block 3 before they are packed: a block is readable for one
	  unit (154 us) only, the copy is cheap, and the packing then has no
	  deadline. The upper halves of blocks 1 and 2 (the ring takes the
	  lower ones) add 2 x 64 KiB once their canaries hold. What the CPU
	  can copy per unit, not this size, bounds a whole burst.

config ESP_SDR_DIAG
	bool "Gapless receive through the modem diagnostic bus (ESP32-C5)"
	depends on SOC_SERIES_ESP32C5 && ESP_SDR_PACED
	help
	  esp_sdr_diag_run(): the dump engine runs free, the GPIO matrix loops
	  the modem diagnostic bus back into the PARLIO receiver, and a GDMA
	  ring in SRAM bank 1 collects 4 bits of I and 4 bits of Q at 40 MS/s
	  without the CPU. Drives 8 pads as outputs while it runs. Takes the
	  bank of the capture engine and the radio for the whole run.

config ESP_SDR_REPLAY
	bool "Loop replay through the DAC engine (ESP32-C5)"
	depends on SOC_SERIES_ESP32C5 && ESP_SDR_PACED
	help
	  esp_sdr_replay_*(): the modem DAC engine plays up to 16383 words
	  out of the dump bank at 80 or 40 MS/s, once, a number of times or
	  endlessly, without the CPU. Periodic content only: the engine owns
	  the bank while it plays.

config ESP_SDR_BANK1
	bool "Reserve a second dump bank"
	depends on SOC_SERIES_ESP32S3
	help
	  Reserves SRAM bank 1 (0x3fcc0000) next to the capture bank, for
	  two-bank loop playback (esp_sdr_tx_loop_*()) and for captures into
	  either bank (esp_sdr_rx_capture_bank()). Costs another 64 KiB of
	  internal RAM.

config ESP_SDR_RING
	bool "Continuous ring receive"
	depends on SOC_SERIES_ESP32S3
	select ESP_SDR_BANK1
	help
	  esp_sdr_ring_run(): the dump engine in circular mode, rotated
	  through SRAM banks 0 to 2, and a two-stage decimating FIR on the
	  vector unit: gapless I/Q at 16 MS/s divided by 64 to 1024. Reserves
	  SRAM bank 0 (0x3fcb0000) besides banks 1 and 2, another 64 KiB of
	  internal RAM: the whole DRAM image must end below 0x3fcb0000.

config ESP_SDR_RING_BOX4
	bool "Ring decimation by 4 (boxcar, for 2 MHz wide signals)"
	depends on ESP_SDR_RING
	help
	  ESP_SDR_RING_DECIM_BOX4: -fs/4 mix and a boxcar of 4 (or every 4th
	  pair) instead of the FIR chain, for signals such as IEEE 802.15.4 at
	  4 MS/s. About 1 KiB of IRAM, which on the S3 comes out of the same
	  SRAM as the DRAM image: leave it out where that is tight.

config ESP_SDR_RING_RAW
	bool "Ring without decimation (the unpacked 16 MS/s stream to the sink)"
	depends on ESP_SDR_RING
	help
	  ESP_SDR_RING_DECIM_RAW: the sink gets the whole stream as int16
	  pairs in chunks of up to 512, with 64 pairs of history in front,
	  for a consumer on the other CPU.

config ESP_SDR_RING_FIR
	bool "Ring decimation by 64 to 1024 (the two-stage FIR)"
	depends on ESP_SDR_RING
	default y
	help
	  ESP_SDR_RING_DECIM_MIN to ESP_SDR_RING_DECIM_MAX. An image that
	  runs the ring only raw or by 4 can leave the filter out: about
	  1 KiB of IRAM, which on the S3 comes out of the same SRAM as the
	  DRAM image.

config ESP_SDR_CHANCAP
	bool "Channelized burst capture"
	depends on ESP_SDR_RING && ESP_SPIRAM && SMP && SCHED_CPU_MASK
	select ESP_SDR_RING_RAW
	help
	  esp_sdr_chancap_start(): the ring without decimation into a
	  hand-over ring in SRAM bank 2, a channelizer (filter bank or
	  decimator bank) and a detector per channel on the other CPU, one
	  I/Q capture per packet per channel from a PSRAM slab to a callback
	  thread. Design: doc/chancap.md.

if ESP_SDR_CHANCAP

config ESP_SDR_CHANCAP_SIMD
	bool "Vector unit kernels for the 8-channel filter bank"
	default y
	help
	  The branch sums, twiddles and the DFT of an 8-channel bank on the
	  PIE (esp_sdr_chancap_pie.S), bit-exact with the C reference; other
	  geometries and the decimator bank run the C code.

config ESP_SDR_CHANCAP_SLAB_KB
	int "Capture slab in PSRAM, KiB"
	default 512
	help
	  Split at start into buffers of max_capture_us samples each.

config ESP_SDR_CHANCAP_QUEUE
	int "Finished captures waiting for the callback thread"
	default 32

config ESP_SDR_CHANCAP_RING_CPU
	int "CPU of the ring loop; the channelizer and callback run on the other"
	range 0 1
	default 1

config ESP_SDR_CHANCAP_DSP_PRIORITY
	int "Preemptive priority of the channelizer thread (the callback thread one below)"
	range 1 13
	default 1
	help
	  The highest preemptive priority: above the Wi-Fi driver's tasks (3
	  to 7), the USB stack's threads (8), the shell and the logging thread
	  (14). The channelizer is the real-time work of its CPU and must not
	  wait behind any of them, as the hand-over ring holds about 400 us.
	  It sleeps a tick whenever it has caught up and after an overrun, so
	  lower threads run even when the band is busier than it keeps up
	  with. The callback thread runs one priority lower: finished
	  captures leave while the channelizer sleeps. Nothing cooperative may
	  run on the channelizer's CPU: the chancap images set
	  CONFIG_SYSTEM_WORKQUEUE_PRIORITY=11 (the CDC-ACM class's work queue
	  takes it too), CONFIG_USBD_THREAD_PREEMPTIBLE and
	  CONFIG_UDC_DWC2_THREAD_PREEMPTIBLE, as each of those held the CPU
	  for hundreds of microseconds per USB transfer burst.

config ESP_SDR_CHANCAP_RING_STACK_SIZE
	int "Ring thread stack (internal RAM above the capture bank)"
	default 1536

config ESP_SDR_CHANCAP_DSP_STACK_SIZE
	int "Channelizer thread stack (internal RAM above the capture bank)"
	default 3072

config ESP_SDR_CHANCAP_OUT_STACK_SIZE
	int "Callback thread stack (internal RAM above the capture bank)"
	default 2048

endif # ESP_SDR_CHANCAP

config ESP_SDR_TX
	bool "Transmit streaming through the DAC"
	depends on SOC_SERIES_ESP32S3 && ESP_SPIRAM && ESP_SDR_RFTEST
	select ESP_SDR_BANK1
	help
	  esp_sdr_tx_start(), esp_sdr_tx_write() and esp_sdr_tx_stop():
	  input samples buffered in PSRAM and interpolated to the 40 MS/s
	  DAC rate in a player thread, played gapless from two banks; and
	  esp_sdr_tx_dac_play_gen() for generated waveforms. Needs PSRAM and
	  the RF test library, without which the MAC never turns the
	  transmitter on.

if ESP_SDR_TX

config ESP_SDR_TX_DAC_RING_SAMPLES
	int "Input ring size in samples (PSRAM, 4 bytes each, power of two)"
	default 262144

config ESP_SDR_TX_DAC_PREBUF_MS
	int "Input buffered before playback starts, in ms"
	default 20

config ESP_SDR_TX_DAC_SIMD
	bool "Interpolate with the ESP32-S3 vector unit"
	default y
	help
	  Four DAC words per instruction group (src/esp_sdr_pie.S). The
	  vector registers are not saved by Zephyr, so only the filler
	  threads may use them, with the scheduler locked meanwhile.

config ESP_SDR_TX_DAC_HIGH_RAM
	bool "DAC stream buffers and thread stacks above the capture bank"
	help
	  Puts the input staging buffer and the player and filler stacks
	  (about 7 KiB) in ESP_SDR_HIGH_RAM instead of the DRAM image, for
	  apps whose image must end below the ring banks.

config ESP_SDR_TX_DAC_STACK_SIZE
	int "Player and filler thread stack size"
	default 2048

config ESP_SDR_TX_DAC_PRIORITY
	int "Player thread priority"
	default 8
	help
	  Below the network and transmit receive threads, above the fillers:
	  it only copies ready blocks and restarts the DAC.

config ESP_SDR_TX_DAC_FILLER_PRIORITY
	int "Filler thread priority"
	default 5
	help
	  The leader fills one block per bank pass and sleeps until its switch
	  time, so it can sit above the application threads: any thread that
	  preempts it on its CPU for longer than the block tail (51 us) makes
	  the DAC restart.

config ESP_SDR_TX_DAC_LEADER_CPU
	int "CPU of the leading filler"
	range 0 1
	default 1
	help
	  The leader fills every block when the vector unit is available, the
	  other filler only helps the C fallback. Put the leader on the CPU
	  that is idle while transmitting: a transmit session holds the radio,
	  so receive capture waits and its processing CPU is free.

endif # ESP_SDR_TX

config ESP_SDR_TEMP
	bool "Die temperature for the crystal calibration"
	default y if ESP32_TEMP
	depends on SENSOR && $(dt_alias_enabled,die-temp0)
	help
	  esp_sdr_get_temp_dc() reads the chip's temperature sensor (the
	  devicetree alias die-temp0: apps/common/dietemp.overlay enables
	  it). The calibration records the temperature with each
	  measurement, and a correction fitted over several temperatures
	  follows it whenever the radio tunes.

config ESP_SDR_CALSTORE
	bool "Crystal calibration in Zephyr settings"
	depends on SETTINGS
	help
	  esp_sdr_cal_load(), esp_sdr_cal_save() and esp_sdr_cal_clear() keep
	  the crystal correction under the settings key "esp_sdr/cal", and
	  esp_sdr_init() applies the stored one before it first tunes. The
	  app chooses the settings backend: apps/common/calstore.conf and
	  calstore.overlay set up the file backend on a FAT volume in
	  the storage partition.

config ESP_SDR_LTE_CAL
	bool "Crystal calibration against an LTE cell"
	depends on ESP_SDR_RX_DECIM
	help
	  esp_sdr_lte_calibrate(): finds an LTE downlink, decodes its cell
	  from the synchronization signals and measures the crystal's error
	  from the carrier (include/esp_sdr/esp_sdr_lte.h). Takes heap for
	  its work memory while it runs (ESP_SDR_LTE_CAL_FFT); on the C6,
	  whose captures are 0.2 ms, 34 KiB of the SRAM above the capture
	  bank, statically, and a few KiB of heap.

if ESP_SDR_LTE_CAL

config ESP_SDR_LTE_CAL_FFT
	int "Largest transform of the estimator"
	default 2048
	range 1024 4096
	help
	  Points of the correlation transform, a power of two: a capture at
	  2 MS/s may be this long less a symbol (2048: 0.95 ms, holding one
	  synchronization signal pair). The work memory is 36 bytes a point
	  (2048: 72 KiB); 4096 doubles the capture where the chip captures
	  that long (S3 1 ms at most, C5 up to 4 ms).

config HEAP_MEM_POOL_ADD_SIZE_ESP_SDR_LTE_CAL
	int
	default 4096 if SOC_SERIES_ESP32C6
	default 81920 if ESP_SDR_LTE_CAL_FFT <= 2048
	default 155648

endif # ESP_SDR_LTE_CAL

module = ESP_SDR
module-str = esp_sdr
source "subsys/logging/Kconfig.template.log_config"

endif # ESP_SDR
```
