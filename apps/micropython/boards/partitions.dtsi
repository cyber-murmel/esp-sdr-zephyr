/*
 * SPDX-License-Identifier: GPL-3.0-or-later
 *
 * Flash layout of this application, for the application and its MCUboot
 * (sysbuild/mcuboot.overlay), which must agree on it: Espressif's 4 MB default
 * table (two 1792 KiB slots, MicroPython with LVGL needs more than the
 * 1344 KiB of the XIAO ESP32S3's AMP table) instead of the board's table,
 * whose APP CPU slots go unused (the S3 runs SMP), and the 4 MB above it as the
 * FAT volume "FLASH", on any S3 board with at least 8 MB of flash. The volume
 * stays where apps/multiapp keeps it.
 */

&flash0 {
	/delete-node/ partitions;
};

#include <espressif/partitions_0x0_default_4M.dtsi>

&flash0 {
	partitions {
		fat_partition: partition@400000 {
			compatible = "zephyr,mapped-partition";
			label = "fat";
			reg = <0x400000 DT_SIZE_M(4)>;
		};
	};
};
