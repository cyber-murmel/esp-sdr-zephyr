/*
 * SPDX-License-Identifier: GPL-3.0-or-later
 *
 * MCUboot on the WHY2025 badge's ESP32-P4 (sysbuild.cmake picks this file there): the
 * application's flash layout, the boot partition its code partition.
 */

#include "../boards/partitions_why2025_p4.dtsi"

/ {
	chosen {
		zephyr,code-partition = &boot_partition;
	};
};
