## CMakeLists.txt
```
# SPDX-License-Identifier: GPL-3.0-or-later

cmake_minimum_required(VERSION 3.20.0)

find_package(Zephyr REQUIRED HINTS $ENV{ZEPHYR_BASE})
project(wpan)

# The ESP32-S3 software radio: USB shell and DFU on the OTG port.
if(CONFIG_USB_DEVICE_STACK_NEXT)
  include(${CMAKE_CURRENT_LIST_DIR}/../common/common.cmake)
endif()

target_sources(app PRIVATE src/main.c)
target_sources_ifdef(CONFIG_WPAN_SNIFFER app PRIVATE src/sniffer.c src/sniffer_line.c)
# Header-only helpers (app_shell.h) on every board.
target_include_directories(app PRIVATE ${CMAKE_CURRENT_LIST_DIR}/../common/include)
```

## Kconfig
```
# SPDX-License-Identifier: GPL-3.0-or-later

mainmenu "wpan: IEEE 802.15.4 test shell"

config WPAN_SNIFFER
	bool "Sniffer mode: the Zephyr sample's line format and `sniffer` shell commands"
	default y
	help
	  Streams every received frame as `psdu: <hex> power: <dBm> lqi: <n> time: <us>` on the
	  shell that ran `sniffer start`, so the sample's Wireshark extcap works against wpan.

config WPAN_SNIFFER_QUEUE
	int "Frames the sniffer queues between the radio thread and the shell"
	default 16
	range 2 64
	depends on WPAN_SNIFFER
	help
	  Each entry takes 144 bytes.

config WPAN_C6_CHIP_ANTENNA
	bool "XIAO ESP32C6: power the RF switch and select the chip antenna"
	depends on BOARD_XIAO_ESP32C6_ESP32C6_HPCORE && !XIAO_ESP32C6_EXT_ANTENNA
	help
	  The XIAO C6's RF switch (DT node rf_switch) is only driven by the board's board.c, which
	  is built only with XIAO_ESP32C6_EXT_ANTENNA. Without it the switch stays unpowered and
	  the radio leaks out weakly (LQI 5-7, about -90 dBm at desk distance). main() then powers
	  the switch and selects the chip antenna itself.

# ESP32-S3 builds: USB shell and DFU (common/), as the other apps.
rsource "../common/Kconfig"
source "samples/subsys/usb/common/Kconfig.sample_usbd"

source "Kconfig.zephyr"
```

## sample.yaml
```
sample:
  name: wpan
  description: >-
    802.15.4 frame generator and receiver on any Zephyr 802.15.4 radio in raw
    mode, to compare the esp-sdr software radio with a native one
common:
  tags: esp-sdr
  platform_allow:
    - xiao_esp32c6/esp32c6/hpcore
    - why2025_badge/esp32c6/hpcore
  integration_platforms:
    - xiao_esp32c6/esp32c6/hpcore
tests:
  # Two radios on one channel: see README.
  sample.esp_sdr.wpan:
    build_only: true
```

## prj.conf
```kconfig
CONFIG_NETWORKING=y
CONFIG_NET_PKT_RX_COUNT=16
CONFIG_NET_PKT_TX_COUNT=4
CONFIG_NET_BUF_RX_COUNT=32
CONFIG_NET_BUF_TX_COUNT=8
CONFIG_NET_BUF_DATA_SIZE=128

CONFIG_SHELL=y
CONFIG_LOG=y
CONFIG_LOG_MODE_DEFERRED=y
CONFIG_MAIN_STACK_SIZE=2048

# The shell's interrupt-driven backend refills the transport one TX ring at a time. With the
# default 8 bytes, a ~130 byte sniffer line took ~17 rounds through CDC-ACM's work queue, and the
# S3 printed only 161 of 199 frames at 100 frames/s. The C6's USB-Serial-JTAG kept up.
CONFIG_SHELL_BACKEND_SERIAL_TX_RING_BUFFER_SIZE=1024
```

## boards/why2025_badge_esp32c6_hpcore.conf
```kconfig
# Native radio in raw mode: no L2, the app drives the radio API and receives every frame.
CONFIG_NET_L2_IEEE802154=n
CONFIG_IEEE802154=y
CONFIG_IEEE802154_RAW_MODE=y
```

## boards/xiao_esp32s3_procpu.conf
```kconfig
# The esp-sdr software radio. The Wi-Fi driver brings the radio up at boot;
# nothing may scan or connect.
CONFIG_WIFI=y
CONFIG_ESP32_WIFI_STA_POWER_SAVE_NONE=y
CONFIG_NET_RX_STACK_SIZE=1024
CONFIG_NET_L2_WIFI_SHELL=n

CONFIG_ESP_SDR=y
CONFIG_ESP_SDR_RX_DECIM=n
CONFIG_ESP_SDR_TX=y
CONFIG_ESP_SDR_TX_DAC=y
CONFIG_ESP_SDR_TX_DAC_HIGH_RAM=y
CONFIG_ESP_SDR_IEEE802154=y

CONFIG_FPU=y
CONFIG_FPU_SHARING=y
CONFIG_SMP=y
CONFIG_SCHED_CPU_MASK=y

# Internal RAM: two dump banks. The Wi-Fi heap goes to the octal PSRAM.
CONFIG_ESP_SPIRAM=y
CONFIG_SPIRAM_MODE_OCT=y
CONFIG_ESP_WIFI_HEAP_SPIRAM=y
CONFIG_ESP32_WIFI_STATIC_RX_BUFFER_NUM=4
CONFIG_ESP32_WIFI_MGMT_SBUF_NUM=8
CONFIG_ESP32_WIFI_EVENT_TASK_STACK_SIZE=1024
CONFIG_NET_MGMT_EVENT_STACK_SIZE=1024
CONFIG_HEAP_MEM_POOL_IGNORE_MIN=y
# Peak 15464 bytes measured with CONFIG_SYS_HEAP_RUNTIME_STATS (`wpan mem`).
CONFIG_HEAP_MEM_POOL_SIZE=16128

# USB device on the OTG port: shell on CDC-ACM, DFU with sysbuild/MCUboot.
CONFIG_USB_DEVICE_STACK_NEXT=y
CONFIG_SAMPLE_USBD_PRODUCT="ESP-SDR 802.15.4"
CONFIG_SAMPLE_USBD_PID=0x0005
CONFIG_USBD_LOG_LEVEL_WRN=y
CONFIG_UDC_DRIVER_LOG_LEVEL_WRN=y
CONFIG_USBD_THREAD_STACK_SIZE=2048
CONFIG_UDC_DWC2_STACK_SIZE=1280
CONFIG_USBD_CDC_ACM_CLASS=y
# CDC-ACM carries the console and the shell: its own logging must stay off (it would log to
# itself), which usbd_cdc_acm.c otherwise enforces with a #warning that -Werror makes fatal.
CONFIG_USBD_CDC_ACM_LOG_LEVEL_OFF=y
CONFIG_CDC_ACM_SERIAL_INITIALIZE_AT_BOOT=n
CONFIG_LOG_BACKEND_UART=n
# Measured high-water marks (`kernel thread stacks`) under traffic: shell 1952 of 2048,
# logging 544 of 1024 with frame printing off, ISR stacks 512 of 2048. Frame printing
# (`wpan set print 1`) runs in the logging thread, the shell backend in the shell thread.
CONFIG_SHELL_STACK_SIZE=2560
CONFIG_LOG_PROCESS_THREAD_STACK_SIZE=1536
CONFIG_ISR_STACK_SIZE=1536
CONFIG_SHELL_BACKEND_SERIAL_LOG_MESSAGE_QUEUE_SIZE=256
CONFIG_KERNEL_SHELL=y

CONFIG_RESET_ON_FATAL_ERROR=y
CONFIG_APP_LIVENESS_WATCHDOG=y

# 802.15.4 packet fields for the software radio, without the L2.
CONFIG_IEEE802154=y
CONFIG_NET_L2_IEEE802154=n

# Gapless receive: three dump banks, so the DRAM image ends below 0x3fcb0000.
CONFIG_ESP_SDR_RING=y
CONFIG_NET_PKT_RX_COUNT=4
CONFIG_NET_BUF_RX_COUNT=6
CONFIG_NET_BUF_TX_COUNT=1
CONFIG_NET_PKT_TX_COUNT=2
CONFIG_MAIN_STACK_SIZE=1536
CONFIG_LOG_BUFFER_SIZE=448
CONFIG_SHELL_CMD_BUFF_SIZE=96
CONFIG_SHELL_HISTORY=n
CONFIG_DEVICE_SHELL=n
CONFIG_DATE_SHELL=n


# CDC-ACM waits forever for the host to take a notification, which it only
# does while the port is open: off the system work queue, which feeds the
# liveness watchdog. The idle stacks (288 B used) pay for its stack.
CONFIG_USBD_CDC_ACM_WORKQUEUE=y
CONFIG_USBD_CDC_ACM_STACK_SIZE=1024
CONFIG_IDLE_STACK_SIZE=512
CONFIG_NET_BUF_DATA_SIZE=96
CONFIG_BASE64=y
CONFIG_HWINFO=y
```

## socs/esp32c6_hpcore.conf
```kconfig
# Native radio in raw mode: no L2, the app drives the radio API and receives every frame.
CONFIG_NET_L2_IEEE802154=n
CONFIG_IEEE802154=y
CONFIG_IEEE802154_RAW_MODE=y
CONFIG_NET_PKT_TIMESTAMP=y
```

## socs/esp32s3_procpu.conf
```kconfig
# The esp-sdr software radio without the Wi-Fi driver: lib/esp_sdr brings the PHY up (on the shell
# thread, at the first `wpan on`). Against the driver (2026-11-15, three rounds, both channels):
# 982 of 1200 C6 frames against 999, some 25 KB more internal RAM below the banks, and with
# IPI_OPTIMIZE (lib/esp_sdr/Kconfig) no interrupt windows in the ring but the tick's.
CONFIG_WIFI=n
CONFIG_ESP_SDR_PHY_ONLY=y
CONFIG_NET_RX_STACK_SIZE=1024

CONFIG_ESP_SDR=y
CONFIG_ESP_SDR_RX_DECIM=n
# The ring runs by 4 only (the 802.15.4 driver, wpan bench): no two-stage FIR, about 1 KiB of
# IRAM back.
CONFIG_ESP_SDR_RING_FIR=n
CONFIG_ESP_SDR_TX=y
CONFIG_ESP_SDR_TX_DAC_HIGH_RAM=y
CONFIG_ESP_SDR_IEEE802154=y

CONFIG_FPU=y
CONFIG_FPU_SHARING=y
CONFIG_SMP=y
CONFIG_SCHED_CPU_MASK=y

# Internal RAM: two dump banks.
CONFIG_ESP_SPIRAM=y
CONFIG_SPIRAM_MODE_OCT=y
CONFIG_HEAP_MEM_POOL_IGNORE_MIN=y
# Peak 15464 bytes measured with CONFIG_SYS_HEAP_RUNTIME_STATS (`wpan mem`).
CONFIG_HEAP_MEM_POOL_SIZE=16128

# USB device on the OTG port: shell on CDC-ACM, DFU with sysbuild/MCUboot.
CONFIG_USB_DEVICE_STACK_NEXT=y
CONFIG_SAMPLE_USBD_PRODUCT="ESP-SDR 802.15.4"
CONFIG_SAMPLE_USBD_PID=0x0005
CONFIG_USBD_LOG_LEVEL_WRN=y
CONFIG_UDC_DRIVER_LOG_LEVEL_WRN=y
CONFIG_USBD_THREAD_STACK_SIZE=2048
CONFIG_UDC_DWC2_STACK_SIZE=1280
CONFIG_USBD_CDC_ACM_CLASS=y
# CDC-ACM carries the console and the shell: its own logging must stay off (it would log to
# itself), which usbd_cdc_acm.c otherwise enforces with a #warning that -Werror makes fatal.
CONFIG_USBD_CDC_ACM_LOG_LEVEL_OFF=y
CONFIG_CDC_ACM_SERIAL_INITIALIZE_AT_BOOT=n
CONFIG_LOG_BACKEND_UART=n
# Measured high-water marks (`kernel thread stacks`) under traffic: shell 1952 of 2048,
# logging 544 of 1024 with frame printing off, ISR stacks 512 of 2048. Frame printing
# (`wpan set print 1`) runs in the logging thread, the shell backend in the shell thread.
CONFIG_SHELL_STACK_SIZE=2560
CONFIG_LOG_PROCESS_THREAD_STACK_SIZE=1536
# Twice the measured 512 (80 % rule): room in the image for the PSRAM-safe atomics
# and the ACK path's priority change (IRAM).
CONFIG_ISR_STACK_SIZE=1024
CONFIG_SHELL_BACKEND_SERIAL_LOG_MESSAGE_QUEUE_SIZE=256
CONFIG_KERNEL_SHELL=y

CONFIG_RESET_ON_FATAL_ERROR=y
CONFIG_APP_LIVENESS_WATCHDOG=y

# 802.15.4 packet fields for the software radio, without the L2.
CONFIG_IEEE802154=y
CONFIG_NET_L2_IEEE802154=n

# Gapless receive: three dump banks, so the DRAM image ends below 0x3fcb0000.
CONFIG_ESP_SDR_RING=y
CONFIG_NET_PKT_RX_COUNT=4
CONFIG_NET_BUF_RX_COUNT=6
CONFIG_NET_BUF_TX_COUNT=1
CONFIG_NET_PKT_TX_COUNT=2
CONFIG_MAIN_STACK_SIZE=1536
CONFIG_LOG_BUFFER_SIZE=448
CONFIG_SHELL_CMD_BUFF_SIZE=96
CONFIG_SHELL_HISTORY=n
CONFIG_DEVICE_SHELL=n
CONFIG_DATE_SHELL=n


# CDC-ACM waits forever for the host to take a notification, which it only
# does while the port is open: off the system work queue, which feeds the
# liveness watchdog. The idle stacks (288 B used) pay for its stack.
CONFIG_USBD_CDC_ACM_WORKQUEUE=y
CONFIG_USBD_CDC_ACM_STACK_SIZE=1024
CONFIG_IDLE_STACK_SIZE=512
CONFIG_NET_BUF_DATA_SIZE=96
CONFIG_BASE64=y
CONFIG_HWINFO=y

# GDMA gather spike (wpan bench dma ack, esp_sdr_dma.h): off, the old `wpan bench dma sram` then
# `wpan on` reset the board (doc/dev/dma-chains.md, open crash). Build it with -DCONFIG_ESP_SDR_DMA=y;
# the other DMA benches are "probe dma" in apps/rfprobe.
# CONFIG_ESP_SDR_DMA is not set
```

## boards/esp32s3_devkitc_procpu.overlay
```dts
/*
 * SPDX-License-Identifier: GPL-3.0-or-later
 *
 * For the ESP32-S3-DevKitC with an N16R8 module (8 MB octal PSRAM). The S3 software radio
 * needs PSRAM and the board's devicetree declares none.
 */

&psram0 {
	size = <DT_SIZE_M(8)>;
};
```

## socs/esp32s3_procpu.overlay
```dts
/*
 * SPDX-License-Identifier: GPL-3.0-or-later
 */

#define APP_SHELL_LABEL "ESP-SDR 802.15.4 shell"
#include "../../common/boards/s3_cdc_shell.dtsi"
```

## src/sniffer.c
```c
/*
 * Copyright (c) 2026 Espressif Systems (Shanghai) Co., Ltd.
 *
 * SPDX-License-Identifier: Apache-2.0
 *
 * Adapted from Zephyr samples/net/ieee802154/sniffer (cf45cd71868) for apps/wpan.
 */

#include <errno.h>
#include <stdlib.h>
#include <string.h>

#include <zephyr/kernel.h>
#include <zephyr/logging/log.h>
#include <zephyr/shell/shell.h>
#include <zephyr/sys/atomic.h>

#include "sniffer.h"
#include "sniffer_line.h"
#include "wpan.h"

#if defined(CONFIG_ESP_SDR)
/* Internal RAM below the dump banks is tight on the S3: the categories' regions. */
#include <esp_sdr/esp_sdr_place.h>
#else
#define ESP_SDR_STACK_DEFINE(nm, size)                    static K_KERNEL_STACK_DEFINE(nm, size)
#define ESP_SDR_BUF_DEFINE(cat, type, nm, dims, align, f) static type nm dims __aligned(align)
#endif

LOG_MODULE_REGISTER(wpan_sniffer, LOG_LEVEL_INF);

#define PSDU_MAX      127U
#define CHAN_MIN      11U
#define CHAN_MAX      26U
/* Peak 1360 bytes on the S3 (Xtensa windows), 816 on the C6, at 200 frames/s. */
#define EMIT_STACK    1792

struct sniffer_msg {
	uint64_t time_us;
	int16_t rssi;
	uint8_t len;
	uint8_t lqi;
	uint8_t psdu[PSDU_MAX];
};

ESP_SDR_BUF_DEFINE(BULK, uint8_t, msgq_buf, [CONFIG_WPAN_SNIFFER_QUEUE * sizeof(struct sniffer_msg)],
		   4, NONE);
static struct k_msgq msgq;
ESP_SDR_STACK_DEFINE(emit_stack, EMIT_STACK);
static struct k_thread emit_thread;

/* The shell that ran `sniffer start`: the lines go out through it, so they never interleave
 * with command replies and the transport is whatever the shell sits on (CDC-ACM, USB-JTAG).
 */
static const struct shell *sniffer_sh;
static K_MUTEX_DEFINE(state_lock);
static atomic_t capturing;
/* What the extcap assumes until told otherwise, so `speed` has an answer before any set. */
static uint32_t console_speed = 115200;

static atomic_t st_enq, st_drop, st_tx_rec, st_tx_bytes, st_hwm;

static char line[SNIFFER_LINE_MAX];

bool sniffer_capturing(void)
{
	return atomic_get(&capturing) != 0;
}

void sniffer_frame(const uint8_t *psdu, size_t len, uint8_t lqi, int16_t rssi, uint64_t time_us)
{
	struct sniffer_msg msg;
	atomic_val_t used;

	if (!sniffer_capturing()) {
		return;
	}
	if (len > PSDU_MAX) {
		len = PSDU_MAX;
	}
	msg.time_us = time_us;
	msg.rssi = rssi;
	msg.len = (uint8_t)len;
	msg.lqi = lqi;
	memcpy(msg.psdu, psdu, len);

	if (k_msgq_put(&msgq, &msg, K_NO_WAIT) != 0) {
		atomic_inc(&st_drop);
		return;
	}
	atomic_inc(&st_enq);
	used = (atomic_val_t)k_msgq_num_used_get(&msgq);
	/* High-water mark: raise it only, retrying when another thread raised it meanwhile. */
	for (;;) {
		atomic_val_t hwm = atomic_get(&st_hwm);

		if (used <= hwm || atomic_cas(&st_hwm, hwm, used)) {
			break;
		}
	}
}

static void emit_fn(void *a, void *b, void *c)
{
	struct sniffer_msg msg;

	ARG_UNUSED(a);
	ARG_UNUSED(b);
	ARG_UNUSED(c);
	for (;;) {
		const struct shell *sh;
		size_t n;

		(void)k_msgq_get(&msgq, &msg, K_FOREVER);
		sh = sniffer_sh;
		if (sh == NULL || !sniffer_capturing()) {
			/* Stopped meanwhile: the queue drains without output. */
			continue;
		}
		n = sniffer_line(line, sizeof(line), msg.psdu, msg.len, msg.lqi, msg.rssi,
				 msg.time_us);
		shell_fprintf_normal(sh, "%s", line);
		atomic_inc(&st_tx_rec);
		atomic_add(&st_tx_bytes, (atomic_val_t)n);
	}
}

void sniffer_init(void)
{
	k_msgq_init(&msgq, msgq_buf, sizeof(struct sniffer_msg), CONFIG_WPAN_SNIFFER_QUEUE);
	k_thread_create(&emit_thread, emit_stack, K_KERNEL_STACK_SIZEOF(emit_stack), emit_fn, NULL,
			NULL, NULL, K_LOWEST_APPLICATION_THREAD_PRIO, 0, K_NO_WAIT);
	k_thread_name_set(&emit_thread, "wpan_sniffer");
}

/* ------------------------------------------------------------------ shell */
/* Replies as the upstream sample's shell.c, which its Wireshark extcap matches on. */

static int cmd_start(const struct shell *sh, size_t argc, char **argv)
{
	int err = 0;

	ARG_UNUSED(argc);
	ARG_UNUSED(argv);
	k_mutex_lock(&state_lock, K_FOREVER);
	if (sniffer_capturing()) {
		k_mutex_unlock(&state_lock);
		shell_print(sh, "already started");
		return 0;
	}
	err = wpan_set_promisc(true);
	if (err != 0) {
		LOG_WRN("promiscuous mode failed (%d)", err);
	}
	if (!wpan_radio_is_on()) {
		err = wpan_radio_on();
		if (err != 0) {
			k_mutex_unlock(&state_lock);
			shell_error(sh, "start failed (%d)", err);
			return err;
		}
	}
	sniffer_sh = sh;
	atomic_set(&capturing, 1);
	k_mutex_unlock(&state_lock);
	shell_print(sh, "started");
	return 0;
}

static int cmd_stop(const struct shell *sh, size_t argc, char **argv)
{
	int err;

	ARG_UNUSED(argc);
	ARG_UNUSED(argv);
	k_mutex_lock(&state_lock, K_FOREVER);
	if (!sniffer_capturing()) {
		k_mutex_unlock(&state_lock);
		shell_print(sh, "already stopped");
		return 0;
	}
	atomic_set(&capturing, 0);
	err = wpan_radio_off();
	k_mutex_unlock(&state_lock);
	if (err != 0) {
		shell_error(sh, "stop failed (%d)", err);
		return err;
	}
	shell_print(sh, "stopped");
	return 0;
}

static int cmd_channel(const struct shell *sh, size_t argc, char **argv)
{
	char *endp = NULL;
	long ch;
	int err;

	if (argc == 1) {
		shell_print(sh, "%u", (unsigned int)wpan_get_channel());
		return 0;
	}
	ch = strtol(argv[1], &endp, 0);
	if (endp == NULL || *endp != '\0') {
		shell_error(sh, "invalid channel: %s", argv[1]);
		return -EINVAL;
	}
	if (ch < (long)CHAN_MIN || ch > (long)CHAN_MAX) {
		shell_error(sh, "channel out of range: %ld", ch);
		return -ERANGE;
	}
	k_mutex_lock(&state_lock, K_FOREVER);
	err = sniffer_capturing() ? -EBUSY : wpan_set_channel((uint16_t)ch);
	k_mutex_unlock(&state_lock);
	if (err == -EBUSY) {
		shell_error(sh, "cannot change channel while running; run 'sniffer stop' first");
		return err;
	}
	if (err != 0) {
		shell_error(sh, "set channel failed (%d)", err);
		return err;
	}
	shell_print(sh, "channel %u", (unsigned int)wpan_get_channel());
	return 0;
}

/* Both transports are USB: there is no rate to set. The command only keeps the extcap's
 * handshake (`speed <baud>` echoed) working.
 */
static int cmd_speed(const struct shell *sh, size_t argc, char **argv)
{
	char *endp = NULL;
	unsigned long baud;

	if (argc == 1) {
		shell_print(sh, "speed %u", (unsigned int)console_speed);
		return 0;
	}
	baud = strtoul(argv[1], &endp, 0);
	if (endp == NULL || *endp != '\0') {
		shell_error(sh, "invalid baud rate: %s", argv[1]);
		return -EINVAL;
	}
	if (baud == 0UL || baud > UINT32_MAX) {
		shell_error(sh, "baud rate out of range: %s", argv[1]);
		return -ERANGE;
	}
	console_speed = (uint32_t)baud;
	shell_print(sh, "speed %lu", baud);
	return 0;
}

static int cmd_stats(const struct shell *sh, size_t argc, char **argv)
{
	ARG_UNUSED(argc);
	ARG_UNUSED(argv);
	shell_print(sh, "enq=%u drop=%u tx_rec=%u tx_bytes=%u q_hwm=%u q_used=%u/%u",
		    (unsigned int)atomic_get(&st_enq), (unsigned int)atomic_get(&st_drop),
		    (unsigned int)atomic_get(&st_tx_rec), (unsigned int)atomic_get(&st_tx_bytes),
		    (unsigned int)atomic_get(&st_hwm), (unsigned int)k_msgq_num_used_get(&msgq),
		    (unsigned int)CONFIG_WPAN_SNIFFER_QUEUE);
	return 0;
}

static int cmd_stats_reset(const struct shell *sh, size_t argc, char **argv)
{
	ARG_UNUSED(argc);
	ARG_UNUSED(argv);
	atomic_set(&st_enq, 0);
	atomic_set(&st_drop, 0);
	atomic_set(&st_tx_rec, 0);
	atomic_set(&st_tx_bytes, 0);
	atomic_set(&st_hwm, 0);
	shell_print(sh, "stats reset");
	return 0;
}

/* clang-format off */
SHELL_STATIC_SUBCMD_SET_CREATE(
	sub_sniffer,
	SHELL_CMD(start, NULL, "Start sniffing (enable RX).", cmd_start),
	SHELL_CMD(stop, NULL, "Stop sniffing (disable RX).", cmd_stop),
	SHELL_CMD(channel, NULL, "Get/set channel: channel [11..26].", cmd_channel),
	SHELL_CMD(speed, NULL, "Get/set console baud rate: speed [baud] (no-op, USB).", cmd_speed),
	SHELL_CMD(stats, NULL, "Show stream queue and traffic stats.", cmd_stats),
	SHELL_CMD(stats_reset, NULL, "Reset stream stats counters.", cmd_stats_reset),
	SHELL_SUBCMD_SET_END
);
/* clang-format on */

SHELL_CMD_REGISTER(sniffer, &sub_sniffer, "IEEE 802.15.4 sniffer control.", NULL);
```

## src/sniffer.h
```c
/*
 * Copyright (c) 2026 Espressif Systems (Shanghai) Co., Ltd.
 *
 * SPDX-License-Identifier: Apache-2.0
 *
 * Adapted from Zephyr samples/net/ieee802154/sniffer (cf45cd71868) for apps/wpan.
 */

#ifndef SNIFFER_H_
#define SNIFFER_H_

#include <stdbool.h>
#include <stddef.h>
#include <stdint.h>

/** Start the emitter thread; capture stays off until `sniffer start`. */
void sniffer_init(void);

/**
 * Hand one received frame (FCS already stripped) to the capture; a no-op unless capturing.
 * Only a memcpy and a queue put: it runs in the radio's receive thread.
 */
void sniffer_frame(const uint8_t *psdu, size_t len, uint8_t lqi, int16_t rssi, uint64_t time_us);

/** True while `sniffer start` is in effect. */
bool sniffer_capturing(void);

#endif /* SNIFFER_H_ */
```

## src/sniffer_line.c
```c
/*
 * Copyright (c) 2026 Espressif Systems (Shanghai) Co., Ltd.
 *
 * SPDX-License-Identifier: Apache-2.0
 *
 * Adapted from Zephyr samples/net/ieee802154/sniffer (cf45cd71868) for apps/wpan.
 */

#include <stdio.h>

#include "sniffer_line.h"

size_t sniffer_line(char *out, size_t cap, const uint8_t *psdu, size_t len, uint8_t lqi,
		    int16_t rssi_dbm, uint64_t time_us)
{
	static const char hex[] = "0123456789abcdef";
	size_t n = 0;
	char tail[64];
	int tl;

	if (cap == 0) {
		return 0;
	}

	/* Every write stops at cap - 1: the line is cut, never overrun. */
	for (const char *p = "psdu: "; *p != '\0' && n < cap - 1; p++) {
		out[n++] = *p;
	}
	for (size_t i = 0; i < len; i++) {
		if (n < cap - 1) {
			out[n++] = hex[psdu[i] >> 4];
		}
		if (n < cap - 1) {
			out[n++] = hex[psdu[i] & 0xf];
		}
	}
	tl = snprintf(tail, sizeof(tail), " power: %d lqi: %u time: %llu\r\n", (int)rssi_dbm,
		      (unsigned int)lqi, (unsigned long long)time_us);
	for (int i = 0; i < tl && n < cap - 1; i++) {
		out[n++] = tail[i];
	}
	out[n] = '\0';
	return n;
}
```

## src/sniffer_line.h
```c
/*
 * Copyright (c) 2026 Espressif Systems (Shanghai) Co., Ltd.
 *
 * SPDX-License-Identifier: Apache-2.0
 *
 * Adapted from Zephyr samples/net/ieee802154/sniffer (cf45cd71868) for apps/wpan.
 */

#ifndef SNIFFER_LINE_H_
#define SNIFFER_LINE_H_

#include <stddef.h>
#include <stdint.h>

/**
 * Format one captured frame as the sample's text line
 * `psdu: <hex> power: <dBm> lqi: <n> time: <us>\r\n`, NUL-terminated.
 *
 * @return the line's length (without the NUL); the line is cut at @p cap - 1 characters when it
 *         does not fit. 0 when @p cap is 0.
 */
size_t sniffer_line(char *out, size_t cap, const uint8_t *psdu, size_t len, uint8_t lqi,
		    int16_t rssi_dbm, uint64_t time_us);

/** Longest line: 127 PSDU bytes, the fields, CR LF, NUL. */
#define SNIFFER_LINE_MAX 320

#endif /* SNIFFER_LINE_H_ */
```

## src/wpan.h
```c
/*
 * SPDX-License-Identifier: GPL-3.0-or-later
 *
 * Radio control of the wpan app, shared by its shell commands (main.c) and the sniffer, so that
 * `wpan status` always shows the true state.
 */
#ifndef WPAN_H_
#define WPAN_H_

#include <stdbool.h>
#include <stdint.h>

/** Start receiving (api->start()); 0 or a negative errno. */
int wpan_radio_on(void);
/** Stop the radio. */
int wpan_radio_off(void);
bool wpan_radio_is_on(void);
/** Set the channel (the range is the caller's to check); restarts the radio if it is on. */
int wpan_set_channel(uint16_t ch);
uint16_t wpan_get_channel(void);
int wpan_set_promisc(bool on);

#endif /* WPAN_H_ */
```
