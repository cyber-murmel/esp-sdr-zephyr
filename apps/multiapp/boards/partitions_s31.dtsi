/*
 * SPDX-License-Identifier: GPL-3.0-or-later
 *
 * Flash layout of multiapp on a 16 MB ESP32-S31 board, for the application and its MCUboot
 * (sysbuild/mcuboot_s31.overlay), which must agree on it: MCUboot at 0x2000 and the application in
 * the lower 8 MB (Espressif's 8 MB table: two 3840 KiB slots), the upper 8 MB the FAT volume, as
 * apps/micropython has it on these chips. The crystal calibration has a partition of its own in
 * the table's free space (settings on ZMS), so that the device never writes the FAT volume, which
 * the PC may have as a USB drive.
 */

&flash0 {
	/delete-node/ partitions;
};

#include <espressif/partitions_0x2000_default_8M.dtsi>

&flash0 {
	partitions {
		/*
		 * 16 KiB, four erase sectors, right after Espressif's 192 KiB "storage" (which ends at
		 * 0x7e0000) and below the coredump at 0x7ff000: the table leaves 124 KiB there unused.
		 */
		cal_partition: partition@7e0000 {
			compatible = "zephyr,mapped-partition";
			label = "calibration";
			reg = <0x7e0000 DT_SIZE_K(16)>;
		};

		fat_partition: partition@800000 {
			compatible = "zephyr,mapped-partition";
			label = "fat";
			reg = <0x800000 DT_SIZE_M(8)>;
		};
	};
};
