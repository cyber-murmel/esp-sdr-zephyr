/*
 * SPDX-License-Identifier: GPL-3.0-or-later
 *
 * Flash layout of multiapp, for the application and its MCUboot
 * (sysbuild/mcuboot.overlay), which must agree on it: Espressif's 4 MB AMP
 * table, the XIAO ESP32S3's own, on any S3 board, and the 4 MB above it as
 * the FAT volume, where west dfu --esptool, nix/collect.py and the release
 * workflow expect it.
 */

&flash0 {
	/delete-node/ partitions;
};

#include <espressif/partitions_0x0_amp.dtsi>

&flash0 {
	partitions {
		fat_partition: partition@400000 {
			compatible = "zephyr,mapped-partition";
			label = "fat";
			reg = <0x400000 DT_SIZE_M(4)>;
		};
	};
};
