/*
 * SPDX-License-Identifier: GPL-3.0-or-later
 */

#define APP_SHELL_LABEL "ESP-SDR multiapp shell"
#include "../../common/boards/s3_cdc_shell.dtsi"

/ {
	/* The apps as files: the FAT volume, block device "FLASH". */
	fat_disk: fat_disk {
		compatible = "zephyr,flash-disk";
		partition = <&fat_partition>;
		disk-name = "FLASH";
		cache-size = <4096>;
	};

	/* stream's USB network function; the host side gets MAC 00:00:5e:00:53:01. */
	cdc_ncm_eth0: cdc_ncm_eth0 {
		compatible = "zephyr,cdc-ncm-ethernet";
		remote-mac-address = "00005E005301";
	};
};

#include "../boards/partitions.dtsi"
