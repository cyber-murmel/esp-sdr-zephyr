/*
 * SPDX-License-Identifier: GPL-3.0-or-later
 *
 * MCUboot uses the application's flash layout. This file replaces MCUboot's own
 * app.overlay, so it names the boot partition as MCUboot's code partition too
 * (else a sysbuild flash writes MCUboot to slot 0).
 */

#include "../boards/partitions.dtsi"

/ {
	chosen {
		zephyr,code-partition = &boot_partition;
	};
};
