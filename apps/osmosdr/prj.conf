## CMakeLists.txt
```
# SPDX-License-Identifier: GPL-3.0-or-later

cmake_minimum_required(VERSION 3.20.0)

find_package(Zephyr REQUIRED HINTS $ENV{ZEPHYR_BASE})
project(esp_sdr_osmosdr)

include(${CMAKE_CURRENT_LIST_DIR}/../common/common.cmake)
# The crystal calibration requests on the library (ESDR_REQ_GET_CAL here).
include(${CMAKE_CURRENT_LIST_DIR}/../common/esdr_cal.cmake)

target_sources(app PRIVATE
  src/main.c
  src/sdr.c
  src/shell.c
  src/usb_sdr.c)
set_source_files_properties(src/sdr.c PROPERTIES COMPILE_OPTIONS "-O3;-ffp-contract=fast")
```

## Kconfig
```
# SPDX-License-Identifier: GPL-3.0-or-later

mainmenu "ESP-SDR osmosdr"

config APP_FREQ_MHZ
	int "Centre frequency in MHz at boot"
	range 100 6000
	default 2450

config APP_RX_BW_MHZ
	int "Receive filter bandwidth in MHz at boot (0: widest, -1: the PHY's setting)"
	range -1 69
	default 13
	help
	  Two-sided, 13 to 69 MHz, as in apps/link (1 to 12 fail the build). The ring samples at
	  16 MS/s: the narrowest setting keeps the most of what lies beyond
	  +-8 MHz from aliasing into the stream. The host can change it
	  (SET_BANDWIDTH, where 0 selects the PHY's setting).

config APP_CBW
	int "PHY channel bandwidth mode (0: 20 MHz, 2: 40 MHz)"
	range 0 2
	default 0

config APP_RX_GAIN_MAX
	int "Largest receive gain index accepted"
	default 82

config APP_RX_BLOCKS
	int "Receive blocks of 4 KiB between the ring and USB"
	default 5
	help
	  At 250 kS/s each holds about 8 ms of 8-bit samples, 4 ms of
	  16-bit ones. USB DMA needs internal RAM. Transmit uses them as
	  its OUT buffers.

config APP_RX_HIGH_BLOCKS
	int "Of these, blocks in the SRAM above the capture bank"
	default 5
	help
	  ESP_SDR_HIGH_RAM, about 38 KiB, shared with the ring's filter
	  buffers, the DAC stream and the app's thread stacks; the rest
	  go to the DRAM image below the ring banks.

rsource "../common/Kconfig"

# USB device identity (VID, PID, strings) for the sample USB helper.
source "samples/subsys/usb/common/Kconfig.sample_usbd"

source "Kconfig.zephyr"
```

## sample.yaml
```
sample:
  name: ESP-SDR osmosdr
  description: >-
    USB SDR after HackRF's model: gapless decimated receive and transmit
    over vendor bulk endpoints, for osmosdr / GNU Radio hosts
common:
  tags: esp-sdr
  sysbuild: true
  platform_allow:
    - xiao_esp32s3/esp32s3/procpu
    - communicator_badge/esp32s3/procpu
  integration_platforms:
    - xiao_esp32s3/esp32s3/procpu
tests:
  # Needs a host and boards: run tools/esdr_usb (see README).
  sample.esp_sdr.osmosdr:
    build_only: true
```

## prj.conf
```kconfig
# The Wi-Fi driver brings the radio up at boot; nothing may scan or connect.
CONFIG_NETWORKING=y
CONFIG_WIFI=y
CONFIG_ESP32_WIFI_STA_POWER_SAVE_NONE=y
# No IP traffic: the network stack only carries the Wi-Fi driver, minimal.
CONFIG_NET_IPV6=n
CONFIG_NET_IPV4=y
CONFIG_NET_PKT_RX_COUNT=4
CONFIG_NET_PKT_TX_COUNT=4
CONFIG_NET_BUF_RX_COUNT=8
CONFIG_NET_BUF_TX_COUNT=8
CONFIG_NET_RX_STACK_SIZE=1024

CONFIG_ESP_SDR=y
# Continuous receive: three dump banks, so the DRAM image ends below 0x3fcb0000.
CONFIG_ESP_SDR_RING=y
CONFIG_ESP_SDR_RX_DECIM=n
# Transmit: the DAC stream (PSRAM input ring, gapless loop playback), its
# buffers and stacks above the capture bank.
CONFIG_ESP_SDR_TX=y
CONFIG_ESP_SDR_TX_DAC_HIGH_RAM=y

CONFIG_LOG=y
CONFIG_LOG_MODE_DEFERRED=y
# Few messages; the DRAM image is tight.
CONFIG_LOG_BUFFER_SIZE=512

# Filter design at run start, the fine tuning NCO.
CONFIG_FPU=y
CONFIG_FPU_SHARING=y
CONFIG_MAIN_STACK_SIZE=1536
# Below the default 2048 per CPU, which the DRAM image cannot spare (peak 512).
CONFIG_ISR_STACK_SIZE=1024

CONFIG_SMP=y
CONFIG_SCHED_CPU_MASK=y

# USB device on the OTG port: the SDR function, shell on CDC-ACM, DFU with
# sysbuild/MCUboot.
CONFIG_USB_DEVICE_STACK_NEXT=y
CONFIG_SAMPLE_USBD_PRODUCT="ESP-SDR osmosdr"
# Same PID as the other apps (host udev rules); told apart by the vendor interface.
CONFIG_SAMPLE_USBD_PID=0x0005
CONFIG_USBD_LOG_LEVEL_WRN=y
CONFIG_UDC_DRIVER_LOG_LEVEL_WRN=y
CONFIG_USBD_THREAD_STACK_SIZE=2048
CONFIG_UDC_DWC2_STACK_SIZE=1280
CONFIG_USBD_CDC_ACM_CLASS=y
# CDC-ACM carries the console and the shell: its own logging must stay off (it would log to
# itself), which usbd_cdc_acm.c otherwise enforces with a #warning that -Werror makes fatal.
CONFIG_USBD_CDC_ACM_LOG_LEVEL_OFF=y
CONFIG_CDC_ACM_SERIAL_INITIALIZE_AT_BOOT=n

CONFIG_SHELL=y
CONFIG_KERNEL_SHELL=y
CONFIG_LOG_BACKEND_UART=n
CONFIG_SHELL_STACK_SIZE=2560
CONFIG_SHELL_CMD_BUFF_SIZE=128
CONFIG_SHELL_HISTORY=n
CONFIG_SHELL_BACKEND_SERIAL_LOG_MESSAGE_QUEUE_SIZE=256
CONFIG_DEVICE_SHELL=n
CONFIG_DATE_SHELL=n
CONFIG_DEVMEM_SHELL=y
# Wi-Fi management commands would retune the radio under the stream.
CONFIG_NET_L2_WIFI_SHELL=n

# Internal RAM: three 64 KiB dump banks must fit. The Wi-Fi heap goes to the
# 8 MB octal PSRAM.
CONFIG_ESP_SPIRAM=y
CONFIG_SPIRAM_MODE_OCT=y
CONFIG_ESP_WIFI_HEAP_SPIRAM=y
CONFIG_ESP32_WIFI_STATIC_RX_BUFFER_NUM=4
CONFIG_ESP32_WIFI_MGMT_SBUF_NUM=8
CONFIG_ESP32_WIFI_EVENT_TASK_STACK_SIZE=1024
CONFIG_NET_MGMT_EVENT_STACK_SIZE=1024
CONFIG_HEAP_MEM_POOL_IGNORE_MIN=y
CONFIG_HEAP_MEM_POOL_SIZE=17408
CONFIG_SYS_HEAP_RUNTIME_STATS=y

CONFIG_RESET_ON_FATAL_ERROR=y
CONFIG_APP_LIVENESS_WATCHDOG=y
```

## socs/esp32s3_procpu.overlay
```dts
/*
 * SPDX-License-Identifier: GPL-3.0-or-later
 */

#define APP_SHELL_LABEL "ESP-SDR osmosdr shell"
#include "../../common/boards/s3_cdc_shell.dtsi"
```

## src/main.c
```c
/*
 * SPDX-License-Identifier: GPL-3.0-or-later
 *
 * USB SDR after HackRF's model, for osmosdr / GNU Radio hosts: a vendor
 * interface with control requests and bulk sample endpoints (esdr_proto.h),
 * next to the CDC-ACM shell and DFU. The receive ring owns CPU 1; the system
 * threads and USB stay on CPU 0.
 */

#include <zephyr/kernel.h>
#include <zephyr/logging/log.h>

#include "app_cpu.h"
#include "app_usb.h"
#include "sdr.h"

LOG_MODULE_REGISTER(osmosdr, LOG_LEVEL_INF);

int main(void)
{
	/* Before USB starts: its controller interrupt lands on the CPU that allocates it. */
	app_cpu_pin_system_threads(0);
	if (app_usb_init() != 0) {
		LOG_ERR("usb init failed");
	}
	if (sdr_init() != 0) {
		LOG_ERR("sdr init failed");
		return 0;
	}
	/* Again for the threads started since (usbd, UDC). */
	k_sleep(K_MSEC(500));
	app_cpu_pin_system_threads(0);
	return 0;
}
```

## src/esdr_dev.h
```c
/*
 * SPDX-License-Identifier: GPL-3.0-or-later
 *
 * Device side of the osmosdr protocol (esdr_proto.h): the request checks and reply fields
 * every device shares, the osmosdr app on the S3 and osmosdr_serial. Stateless: each device
 * keeps its own request switch, settings, locking and change tracking. Header-only.
 */

#ifndef ESDR_DEV_H_
#define ESDR_DEV_H_

#include <stdbool.h>
#include <stdint.h>
#include <string.h>

#include <esp_sdr/esp_sdr.h>

#include "esdr_proto.h"

/* Nearest of the rates max_hz >> k, k = 0 .. count - 1, on a log scale. */
static inline uint32_t esdr_rate_round(uint32_t max_hz, uint32_t count, uint32_t hz)
{
	uint32_t min_hz = max_hz >> (count - 1U);

	/* Also keeps 2 hz^2 below 2^64. */
	if (hz >= max_hz) {
		return max_hz;
	}
	for (uint32_t r = max_hz; r > min_hz; r /= 2U) {
		/* Above the geometric mean of r and r / 2. */
		if (2U * (uint64_t)hz * hz >= (uint64_t)r * r) {
			return r;
		}
	}
	return min_hz;
}

/* ESDR_REQ_SET_FREQ: within the software tuning limits. */
static inline bool esdr_freq_ok(uint64_t hz)
{
	return hz >= (uint64_t)ESP_SDR_FREQ_MIN_MHZ * 1000000U &&
	       hz <= (uint64_t)ESP_SDR_FREQ_MAX_MHZ * 1000000U;
}

/* ESDR_REQ_SET_DIGITAL_GAIN: the default, or whole 6 dB steps up to the maximum. */
static inline bool esdr_dgain_ok(uint16_t value)
{
	return value == ESDR_DGAIN_DEFAULT || (value <= ESDR_DGAIN_MAX_DB && value % 6U == 0U);
}

/* ESDR_REQ_GET_INFO: the reply, receive rates as for esdr_rate_round(). */
static inline void esdr_info_init(struct esdr_info *info, uint32_t rate_max_hz,
				  uint16_t rate_count, uint16_t rx_gain_max, uint16_t tx_gain_max,
				  const char *firmware)
{
	size_t n;

	memset(info, 0, sizeof(*info));
	info->magic = ESDR_INFO_MAGIC;
	info->proto_version = ESDR_PROTO_VERSION;
	info->info_size = sizeof(*info);
	info->freq_min_hz = (uint64_t)ESP_SDR_FREQ_MIN_MHZ * 1000000U;
	info->freq_max_hz = (uint64_t)ESP_SDR_FREQ_MAX_MHZ * 1000000U;
	info->rx_rate_max_hz = rate_max_hz;
	info->rx_rate_count = rate_count;
	info->rx_gain_max = rx_gain_max;
	info->tx_gain_max = tx_gain_max;
	info->block_bytes = ESDR_BLOCK_BYTES;
	info->full_scale16 = 32767;
	/* Cut to the field, which keeps a terminating zero. */
	n = strlen(firmware);
	memcpy(info->firmware, firmware, n < sizeof(info->firmware) ? n : sizeof(info->firmware) - 1U);
}

#endif /* ESDR_DEV_H_ */
```

## src/esdr_seg.h
```c
/*
 * SPDX-License-Identifier: GPL-3.0-or-later
 *
 * Segment codec of the gapless blocks (ESDR_BLK_SEG in esdr_proto.h): the ESP32-C6 writes
 * them, the P4 bridge, the MicroPython egg and the host tools read them. Plain C99,
 * header-only, no Zephyr headers.
 *
 * A block is ESDR_BLOCK_BYTES long: a struct esdr_block_hdr, then segments back to back, each
 * a struct esdr_seg_hdr at a 4-byte aligned offset and its pairs (I then Q, int8), padded
 * with zeros to 4 bytes. A zero header (no pairs) ends the payload, or the payload's end does
 * when less than a header remains; zeros follow. The block header's index is the first
 * segment's, its samples the pairs of all segments. A segment's delta counts from that index,
 * so the segments of one block start within 2^32 pairs (53 s at 80 MS/s) of the first; they
 * are in order and do not overlap. Between blocks the index may jump either way (a restart).
 *
 * A pair's items are its raw I and Q (10 bits, the receiver's DC in them) shifted right by the
 * segment's shift and saturated to int8: shifted back left, less the segment's DC (dc_i, dc_q,
 * raw units), they are the sample. The segment's gain is the receive gain index the pairs were
 * taken at. The header's reserved bytes are written as zeros and not looked at.
 *
 * The writer runs on the C6 (RV32IMAC without FPU): no divisions, no 64-bit multiplies; it
 * writes the headers and leaves the pairs to the caller, who quantizes them in place. The
 * reader checks every header and payload against the buffer before it hands out any segment
 * (the bytes come from a link) and takes the buffer at any alignment.
 */

#ifndef ESDR_SEG_H_
#define ESDR_SEG_H_

#include <errno.h>
#include <stdbool.h>
#include <stddef.h>
#include <stdint.h>
#include <string.h>

#include "esdr_proto.h"

#if defined(__BYTE_ORDER__) && __BYTE_ORDER__ != __ORDER_LITTLE_ENDIAN__
#error "esdr_seg.h copies the little endian wire headers as they are"
#endif

/*
 * Attributes of every function here, none by default. The C6 sink writes with interrupts off:
 * it defines this as ESP_SDR_GAPLESS_HOT (IRAM, optimized as hot) before the include, so that
 * a function the compiler keeps out of line does not run from flash.
 */
#ifndef ESDR_SEG_HOT
#define ESDR_SEG_HOT
#endif

#define ESDR_SEG_BLK_HDR_BYTES ((uint32_t)sizeof(struct esdr_block_hdr))
#define ESDR_SEG_HDR_BYTES     ((uint32_t)sizeof(struct esdr_seg_hdr))
/*
 * Largest shift the reader takes (the proto uses 0 to 2). At 7 an item shifted left stays in
 * [-16384, 16256], so it, its negation and the sum or difference of two still fit an int16
 * (8 would fit only the item itself).
 */
#define ESDR_SEG_SHIFT_MAX     7U
/* Block flags of other kinds of blocks, which a segment block never carries. */
#define ESDR_SEG_BLK_OTHER     (ESDR_BLK_KNOWN & ~(ESDR_BLK_SEG | ESDR_BLK_GAP | ESDR_BLK_OVERFLOW))

/* Offsets stay 4-byte aligned only if both headers are whole words; a full block's pairs fit. */
typedef char esdr_seg_check_hdrs
	[ESDR_SEG_BLK_HDR_BYTES == 16U && ESDR_SEG_HDR_BYTES == 16U ? 1 : -1];
typedef char esdr_seg_check_max
	[ESDR_SEG_PAIRS_MAX <= UINT16_MAX && ESDR_SEG_PAIRS_MAX % 2U == 0U ? 1 : -1];

/* ---- writer ---- */

/*
 * A segment's header besides where it is (struct esdr_seg_hdr): the shift, the flags and power
 * of its first window, the receiver's DC left in the items, the receive gain index.
 */
struct esdr_seg_meta {
	uint8_t shift, flags, gain;
	int8_t dc_i, dc_q;
	int16_t power_dbfs_x10;
};

struct esdr_seg_writer {
	uint8_t *buf;
	/* The first segment's index (the block header's), and the index after the last segment. */
	uint64_t index, end;
	/* Bytes in use (where the last segment's pairs end, unpadded); the last header, 0: none. */
	uint32_t pos, last;
	/* Pairs of all segments; the last segment's shift and gain. */
	uint32_t samples;
	uint8_t shift, gain;
};

/* Starts a block in @p buf, ESDR_BLOCK_BYTES long. */
static inline ESDR_SEG_HOT void esdr_seg_writer_begin(struct esdr_seg_writer *w, void *buf)
{
	w->buf = (uint8_t *)buf;
	w->index = 0U;
	w->end = 0U;
	w->pos = ESDR_SEG_BLK_HDR_BYTES;
	w->last = 0U;
	w->samples = 0U;
	w->shift = 0U;
	w->gain = 0U;
}

/* Pairs a new segment could take, 0 when the block is full. Always even. */
static inline ESDR_SEG_HOT uint32_t esdr_seg_writer_room(const struct esdr_seg_writer *w)
{
	uint32_t at = (w->pos + 3U) & ~3U;

	return at + ESDR_SEG_HDR_BYTES < ESDR_BLOCK_BYTES ?
		       (ESDR_BLOCK_BYTES - at - ESDR_SEG_HDR_BYTES) >> 1 : 0U;
}

/*
 * Starts a segment of up to @p pairs pairs at pair @p index (the run's axis), its header from
 * @p m, and points @p dst at its items; returns how many pairs fit, and the caller writes twice
 * that many int8 items there. 0 when the block cannot take the segment: no room for a header
 * and a pair, an index before the last segment's end, or one 2^32 pairs or more past the
 * block's first; the caller then finishes the block and adds to the next. An empty block takes
 * any index, so a fresh block always takes at least one pair.
 */
static inline ESDR_SEG_HOT uint32_t
esdr_seg_writer_add(struct esdr_seg_writer *w, uint64_t index, uint32_t pairs,
		    const struct esdr_seg_meta *m, int8_t **dst)
{
	/* Locals, as the byte stores below may alias the writer and @p m. */
	uint8_t *buf = w->buf;
	uint32_t pos = w->pos, at = (pos + 3U) & ~3U;
	uint32_t n = esdr_seg_writer_room(w);
	struct esdr_seg_hdr h;

	if (pairs < n) {
		n = pairs;
	}
	if (n == 0U) {
		return 0U;
	}
	if (w->last == 0U) {
		w->index = index;
	} else if (index < w->end || index - w->index > UINT32_MAX) {
		return 0U;
	}
	h.delta = (uint32_t)(index - w->index);
	h.pairs = (uint16_t)n;
	h.shift = m->shift;
	h.flags = m->flags;
	h.power_dbfs_x10 = m->power_dbfs_x10;
	h.dc_i = m->dc_i;
	h.dc_q = m->dc_q;
	h.gain = m->gain;
	memset(h.reserved, 0, sizeof(h.reserved));
	/* The last segment's padding: pos is even, so 0 or 2 bytes. */
	if (at != pos) {
		buf[pos] = 0U;
		buf[pos + 1U] = 0U;
	}
	memcpy(buf + at, &h, sizeof(h));
	*dst = (int8_t *)(buf + at + ESDR_SEG_HDR_BYTES);
	w->last = at;
	w->pos = at + ESDR_SEG_HDR_BYTES + 2U * n;
	w->end = index + n;
	w->samples += n;
	w->shift = h.shift;
	w->gain = h.gain;
	return n;
}

/*
 * Appends up to @p pairs pairs at @p index to the last segment when they follow it without a
 * gap at the same shift and gain (@p m's); returns how many fit and points @p dst at their
 * items as esdr_seg_writer_add() does. 0 when they do not follow or the block is full. The
 * segment's flags, power and DC stay those of its first window.
 */
static inline ESDR_SEG_HOT uint32_t
esdr_seg_writer_extend(struct esdr_seg_writer *w, uint64_t index, uint32_t pairs,
		       const struct esdr_seg_meta *m, int8_t **dst)
{
	/* The segment may grow to the block's end: from a word boundary, an even pair count. */
	uint32_t n = (ESDR_BLOCK_BYTES - w->pos) >> 1;
	uint16_t total;

	if (w->last == 0U || index != w->end || m->shift != w->shift || m->gain != w->gain) {
		return 0U;
	}
	if (pairs < n) {
		n = pairs;
	}
	if (n == 0U) {
		return 0U;
	}
	total = (uint16_t)(((w->pos - w->last - ESDR_SEG_HDR_BYTES) >> 1) + n);
	memcpy(w->buf + w->last + offsetof(struct esdr_seg_hdr, pairs), &total, sizeof(total));
	*dst = (int8_t *)(w->buf + w->pos);
	w->pos += 2U * n;
	w->end += n;
	w->samples += n;
	return n;
}

/*
 * A kept window: extends the last segment when the window follows it at the same shift and
 * gain and has no ESDR_SEG_DROPPED or ESDR_SEG_RESTART to report, else starts a segment.
 * Returns what fits as esdr_seg_writer_add() does; a window that fits only in part goes on in
 * the next block.
 */
static inline ESDR_SEG_HOT uint32_t
esdr_seg_writer_put(struct esdr_seg_writer *w, uint64_t index, uint32_t pairs,
		    const struct esdr_seg_meta *m, int8_t **dst)
{
	if ((m->flags & (ESDR_SEG_DROPPED | ESDR_SEG_RESTART)) == 0U) {
		uint32_t n = esdr_seg_writer_extend(w, index, pairs, m, dst);

		/* A following window that found no room would not fit a new segment either. */
		if (n != 0U) {
			return n;
		}
	}
	return esdr_seg_writer_add(w, index, pairs, m, dst);
}

/*
 * Closes the block: its header (ESDR_BLK_SEG and @p flags, such as ESDR_BLK_GAP), the last
 * segment's padding, the zero header if it fits and zeros to the end. Returns the block's
 * length, always ESDR_BLOCK_BYTES (blocks are fixed size on the link). An empty block is
 * valid: no samples, index 0.
 */
static inline ESDR_SEG_HOT size_t esdr_seg_writer_finish(struct esdr_seg_writer *w, uint16_t flags)
{
	struct esdr_block_hdr h;

	h.magic = ESDR_BLOCK_MAGIC;
	h.flags = (uint16_t)(flags | ESDR_BLK_SEG);
	h.samples = (uint16_t)w->samples;
	h.index = w->index;
	memset(w->buf + w->pos, 0, ESDR_BLOCK_BYTES - w->pos);
	memcpy(w->buf, &h, sizeof(h));
	return ESDR_BLOCK_BYTES;
}

/* ---- reader ---- */

struct esdr_seg {
	/* The first pair's index on the run's axis (80 MS/s, 40 with ESDR_GAPLESS_F_HALF). */
	uint64_t index;
	uint16_t pairs;
	uint8_t shift, flags;
	int16_t power_dbfs_x10;
	/* The receiver's DC left in the items (raw units), the receive gain index. */
	int8_t dc_i, dc_q;
	uint8_t gain;
	/* 2 * pairs items, I then Q, inside the block. */
	const int8_t *iq;
};

/* Takes each segment of a block in turn; a negative return stops the walk and is returned. */
typedef int (*esdr_seg_cb)(const struct esdr_seg *seg, void *user);

/*
 * Copies the header of the block at @p block, @p len bytes there, to @p hdr if it is a
 * segment block. 0, -EINVAL when shorter than a header, -EBADMSG when not a segment block
 * (magic, or the flags of another kind).
 */
static inline ESDR_SEG_HOT int esdr_seg_block_hdr(const void *block, size_t len,
						  struct esdr_block_hdr *hdr)
{
	if (block == NULL || len < sizeof(*hdr)) {
		return -EINVAL;
	}
	memcpy(hdr, block, sizeof(*hdr));
	if (hdr->magic != ESDR_BLOCK_MAGIC || (hdr->flags & ESDR_BLK_SEG) == 0U ||
	    (hdr->flags & ESDR_SEG_BLK_OTHER) != 0U) {
		return -EBADMSG;
	}
	return 0;
}

/*
 * The walk behind esdr_seg_parse() over a block of @p len bytes (at most ESDR_BLOCK_BYTES)
 * whose header @p bh passed esdr_seg_block_hdr(): checks each segment, then hands it to @p cb
 * if there is one. The segment count, or -EPROTO for a malformed payload.
 */
static inline ESDR_SEG_HOT int esdr_seg_walk(const uint8_t *b, size_t len,
					     const struct esdr_block_hdr *bh,
					     esdr_seg_cb cb, void *user)
{
	size_t pos = sizeof(*bh);
	/* Delta of the pair after the last segment. */
	uint64_t end = 0U;
	uint32_t total = 0U;
	int count = 0;

	while (len - pos >= sizeof(struct esdr_seg_hdr)) {
		struct esdr_seg_hdr h;
		size_t bytes;

		memcpy(&h, b + pos, sizeof(h));
		if (h.pairs == 0U) {
			break;
		}
		pos += sizeof(h);
		bytes = 2U * (size_t)h.pairs;
		/* Pairs past the end; the first segment not at the block's index; an overlap. */
		if (bytes > len - pos || (count == 0 ? h.delta != 0U : h.delta < end)) {
			return -EPROTO;
		}
		end = (uint64_t)h.delta + h.pairs;
		/* An index past the axis's end; a shift above ESDR_SEG_SHIFT_MAX. */
		if (bh->index > UINT64_MAX - end || h.shift > ESDR_SEG_SHIFT_MAX) {
			return -EPROTO;
		}
		if (cb != NULL) {
			struct esdr_seg s;
			int ret;

			s.index = bh->index + h.delta;
			s.pairs = h.pairs;
			s.shift = h.shift;
			s.flags = h.flags;
			s.power_dbfs_x10 = h.power_dbfs_x10;
			s.dc_i = h.dc_i;
			s.dc_q = h.dc_q;
			s.gain = h.gain;
			s.iq = (const int8_t *)(b + pos);
			ret = cb(&s, user);
			if (ret < 0) {
				return ret;
			}
		}
		total += h.pairs;
		count++;
		/* The padding, which a block cut short right after the pairs may lack. */
		pos += (bytes + 3U) & ~(size_t)3U;
		if (pos > len) {
			pos = len;
		}
	}
	return total == bh->samples ? count : -EPROTO;
}

/*
 * Walks the segment block at @p block (any alignment), @p len bytes there of which the first
 * ESDR_BLOCK_BYTES are looked at; a block cut short after its last segment is still whole.
 * Hands each segment to @p cb (may be NULL: only checks) with @p user, after the whole block
 * passed the checks, so a malformed block yields none. Returns the segment count, a negative
 * error (esdr_seg_block_hdr(), -EPROTO for a malformed payload), or what @p cb returned to
 * stop.
 */
static inline ESDR_SEG_HOT int esdr_seg_parse(const void *block, size_t len,
					      esdr_seg_cb cb, void *user)
{
	struct esdr_block_hdr bh;
	int ret = esdr_seg_block_hdr(block, len, &bh);

	if (ret < 0) {
		return ret;
	}
	if (len > ESDR_BLOCK_BYTES) {
		len = ESDR_BLOCK_BYTES;
	}
	ret = esdr_seg_walk((const uint8_t *)block, len, &bh, NULL, NULL);
	if (ret <= 0 || cb == NULL) {
		return ret;
	}
	return esdr_seg_walk((const uint8_t *)block, len, &bh, cb, user);
}

/* ---- continuity ---- */

/* esdr_seg_track_gap(): the first segment tracked, nothing before it to compare with. */
#define ESDR_SEG_GAP_START (UINT64_MAX - 1U)
/* esdr_seg_track_gap(): the segment starts before the previous one ended (a restart). */
#define ESDR_SEG_GAP_BACK  UINT64_MAX
/* Real gaps are clamped below the two markers. */
#define ESDR_SEG_GAP_MAX   (UINT64_MAX - 2U)

struct esdr_seg_track {
	/* The index after the last segment. */
	uint64_t next;
	bool valid;
};

static inline ESDR_SEG_HOT void esdr_seg_track_reset(struct esdr_seg_track *t)
{
	t->next = 0U;
	t->valid = false;
}

/*
 * Pairs missing before @p seg since the last segment tracked: 0 when it follows without a gap,
 * or ESDR_SEG_GAP_START / ESDR_SEG_GAP_BACK. Any other value than 0 is a discontinuity.
 */
static inline ESDR_SEG_HOT uint64_t esdr_seg_track_gap(struct esdr_seg_track *t,
						       const struct esdr_seg *seg)
{
	uint64_t gap;

	if (!t->valid) {
		gap = ESDR_SEG_GAP_START;
	} else if (seg->index < t->next) {
		gap = ESDR_SEG_GAP_BACK;
	} else {
		gap = seg->index - t->next;
		if (gap > ESDR_SEG_GAP_MAX) {
			gap = ESDR_SEG_GAP_MAX;
		}
	}
	t->next = seg->index + seg->pairs;
	t->valid = true;
	return gap;
}

#endif /* ESDR_SEG_H_ */
```

## src/shell.c
```c
/*
 * SPDX-License-Identifier: GPL-3.0-or-later
 *
 * "sdr" shell commands: settings and counters.
 */

#include <stdlib.h>

#include <zephyr/shell/shell.h>

#include <esp_sdr/esp_sdr.h>

#include "sdr.h"

static int cmd_status(const struct shell *sh, size_t argc, char **argv)
{
	struct sdr_settings s;
	struct esdr_stats st;
	struct esp_sdr_debug d;

	ARG_UNUSED(argc);
	ARG_UNUSED(argv);
	sdr_get_settings(&s);
	sdr_get_stats(&st);
	esp_sdr_debug_get(&d);
	shell_print(sh, "mode %u, %u bit, %u Hz at %llu Hz, gain %u, digital %u dB, bw %u Hz, "
		    "corr %d ppb, opt 0x%x",
		    s.mode, s.bits, s.rate_hz, (unsigned long long)s.freq_hz, s.rx_gain,
		    sdr_dgain_db(&s), s.bandwidth_hz, s.corr_ppb, s.options);
	shell_print(sh, "rx: %llu samples, %u blocks, %llu overflowed (%u times), %llu restart gap",
		    (unsigned long long)st.rx_samples, st.rx_blocks,
		    (unsigned long long)st.rx_overflow_samples, st.rx_overflows,
		    (unsigned long long)st.rx_restart_samples);
	shell_print(sh, "ring: %u runs, %u errors (last %u/0x%08x), %u abandoned, %llu pairs lost, "
		    "late max %u, %u.%02u cycles/pair, gain re-forced %u",
		    st.ring_runs, st.ring_errors, st.ring_last_status, st.ring_last_detail,
		    st.ring_abandoned, (unsigned long long)st.rx_ring_lost_pairs, st.ring_late_max,
		    st.ring_cycles_x100 / 100U, st.ring_cycles_x100 % 100U, st.ring_gain_refreshed);
	shell_print(sh, "usb: %llu bytes in, %llu bytes out", (unsigned long long)st.usb_in_bytes,
		    (unsigned long long)st.usb_out_bytes);
	return 0;
}

static int cmd_bench(const struct shell *sh, size_t argc, char **argv)
{
	unsigned int decim = argc > 1 ? strtoul(argv[1], NULL, 0) : 64U;
	struct esp_sdr_ring_bench_result r;

	for (int v = 0; v < 3; v++) {
		int ret = sdr_bench(decim, v == 1, v == 2, &r);

		if (ret != 0) {
			shell_error(sh, "bench: %d", ret);
			return ret;
		}
		shell_print(sh, "%-10s %u.%02u cycles/pair: unpack %u.%02u, stage 1 %u.%02u, "
			    "stage 2 %u.%02u, sink %u.%02u (%u samples)",
			    v == 0 ? "null sink" : v == 1 ? "real sink" : "fs/4 mix",
			    r.cycles_x100 / 100U, r.cycles_x100 % 100U, r.stage_x100[0] / 100U,
			    r.stage_x100[0] % 100U, r.stage_x100[1] / 100U, r.stage_x100[1] % 100U,
			    r.stage_x100[2] / 100U, r.stage_x100[2] % 100U, r.stage_x100[3] / 100U,
			    r.stage_x100[3] % 100U, r.samples);
	}
	return 0;
}

SHELL_STATIC_SUBCMD_SET_CREATE(sdr_cmds,
	SHELL_CMD_ARG(bench, NULL, "[decimation]: filter cycles per input pair", cmd_bench, 1, 1),
	SHELL_CMD(status, NULL, "Settings and counters", cmd_status),
	SHELL_SUBCMD_SET_END);
SHELL_CMD_REGISTER(sdr, &sdr_cmds, "USB SDR", NULL);
```

## src/usb_sdr.c
```c
/*
 * SPDX-License-Identifier: GPL-3.0-or-later
 *
 * Vendor USB function of the SDR (usb_sdr.h): one interface, bulk IN for
 * receive blocks, bulk OUT for transmit samples. Transfers point at the
 * app's own buffers (net_buf_alloc_with_data), so no data is copied here.
 * Control requests to the device are claimed by bRequest and passed to the
 * app.
 */

#include <errno.h>
#include <string.h>

#include <zephyr/drivers/usb/udc.h>
#include <zephyr/kernel.h>
#include <zephyr/logging/log.h>
#include <zephyr/sys/atomic.h>
#include <zephyr/usb/usbd.h>

#include "esdr_proto.h"
#include "usb_sdr.h"

LOG_MODULE_REGISTER(usb_sdr, LOG_LEVEL_INF);

/* Bulk transfers in flight on both endpoints together. */
#define SDR_XFERS 16

UDC_BUF_POOL_DEFINE(sdr_ep_pool, SDR_XFERS, 0, sizeof(struct udc_buf_info), NULL);

static const struct usbd_cctx_vendor_req sdr_vregs = USBD_VENDOR_REQ(
	ESDR_REQ_GET_INFO, ESDR_REQ_SET_MODE, ESDR_REQ_SET_FREQ, ESDR_REQ_SET_SAMPLE_RATE,
	ESDR_REQ_SET_RX_GAIN, ESDR_REQ_SET_TX_GAIN, ESDR_REQ_SET_BANDWIDTH, ESDR_REQ_SET_FORMAT,
	ESDR_REQ_SET_FREQ_CORR, ESDR_REQ_GET_STATE, ESDR_REQ_GET_STATS, ESDR_REQ_SET_OPTIONS,
	ESDR_REQ_SET_DIGITAL_GAIN, ESDR_REQ_SET_TRIGGER, ESDR_REQ_RESET, ESDR_REQ_SET_GAPLESS,
	ESDR_REQ_GET_GAPLESS_STATS, ESDR_REQ_SET_CHANNELIZER, ESDR_REQ_USB_TO_C6, ESDR_REQ_GET_TEMP,
	ESDR_REQ_GET_CAL, ESDR_REQ_SET_CAL);

struct sdr_desc {
	struct usb_if_descriptor if0;
	struct usb_ep_descriptor in_ep;
	struct usb_ep_descriptor out_ep;
	/* High speed (the ESP32-P4's OTG HS port): 512-byte bulk packets. */
	struct usb_ep_descriptor hs_in_ep;
	struct usb_ep_descriptor hs_out_ep;
	struct usb_desc_header nil_desc;
};

static struct sdr_desc sdr_desc = {
	.if0 = {
		.bLength = sizeof(struct usb_if_descriptor),
		.bDescriptorType = USB_DESC_INTERFACE,
		.bInterfaceNumber = 0,
		.bAlternateSetting = 0,
		.bNumEndpoints = 2,
		.bInterfaceClass = USB_BCC_VENDOR,
		.bInterfaceSubClass = 0,
		.bInterfaceProtocol = 0,
		.iInterface = 0,
	},
	.in_ep = {
		.bLength = sizeof(struct usb_ep_descriptor),
		.bDescriptorType = USB_DESC_ENDPOINT,
		.bEndpointAddress = 0x81,
		.bmAttributes = USB_EP_TYPE_BULK,
		.wMaxPacketSize = sys_cpu_to_le16(64U),
		.bInterval = 0,
	},
	.out_ep = {
		.bLength = sizeof(struct usb_ep_descriptor),
		.bDescriptorType = USB_DESC_ENDPOINT,
		.bEndpointAddress = 0x01,
		.bmAttributes = USB_EP_TYPE_BULK,
		.wMaxPacketSize = sys_cpu_to_le16(64U),
		.bInterval = 0,
	},
	.hs_in_ep = {
		.bLength = sizeof(struct usb_ep_descriptor),
		.bDescriptorType = USB_DESC_ENDPOINT,
		.bEndpointAddress = 0x81,
		.bmAttributes = USB_EP_TYPE_BULK,
		.wMaxPacketSize = sys_cpu_to_le16(512U),
		.bInterval = 0,
	},
	.hs_out_ep = {
		.bLength = sizeof(struct usb_ep_descriptor),
		.bDescriptorType = USB_DESC_ENDPOINT,
		.bEndpointAddress = 0x01,
		.bmAttributes = USB_EP_TYPE_BULK,
		.wMaxPacketSize = sys_cpu_to_le16(512U),
		.bInterval = 0,
	},
	.nil_desc = {
		.bLength = 0,
		.bDescriptorType = 0,
	},
};

static const struct usb_desc_header *const sdr_fs_desc[] = {
	(struct usb_desc_header *)&sdr_desc.if0,
	(struct usb_desc_header *)&sdr_desc.in_ep,
	(struct usb_desc_header *)&sdr_desc.out_ep,
	(struct usb_desc_header *)&sdr_desc.nil_desc,
};

static const struct usb_desc_header *const sdr_hs_desc[] = {
	(struct usb_desc_header *)&sdr_desc.if0,
	(struct usb_desc_header *)&sdr_desc.hs_in_ep,
	(struct usb_desc_header *)&sdr_desc.hs_out_ep,
	(struct usb_desc_header *)&sdr_desc.nil_desc,
};

static struct usbd_class_data *sdr_c_data;
static atomic_t sdr_up;

bool usb_sdr_enabled(void)
{
	return atomic_get(&sdr_up) != 0;
}

static int submit(uint8_t ep, uint8_t *data, size_t len, bool in)
{
	struct net_buf *buf;
	struct udc_buf_info *bi;
	int err;

	if (!usb_sdr_enabled()) {
		return -ENOTCONN;
	}
	buf = net_buf_alloc_with_data(&sdr_ep_pool, data, len, K_NO_WAIT);
	if (buf == NULL) {
		return -ENOMEM;
	}
	if (!in) {
		/* Empty: the controller writes what the host sends. */
		buf->len = 0;
	}
	bi = udc_get_buf_info(buf);
	memset(bi, 0, sizeof(*bi));
	bi->ep = ep;
	err = usbd_ep_enqueue(sdr_c_data, buf);
	if (err != 0) {
		net_buf_unref(buf);
	}
	return err;
}

int usb_sdr_submit_in(uint8_t *data, size_t len)
{
	return submit(sdr_desc.in_ep.bEndpointAddress, data, len, true);
}

int usb_sdr_submit_out(uint8_t *data, size_t cap)
{
	return submit(sdr_desc.out_ep.bEndpointAddress, data, cap, false);
}

void usb_sdr_cancel(void)
{
	if (sdr_c_data == NULL) {
		return;
	}
	(void)usbd_ep_dequeue(usbd_class_get_ctx(sdr_c_data), sdr_desc.in_ep.bEndpointAddress);
	(void)usbd_ep_dequeue(usbd_class_get_ctx(sdr_c_data), sdr_desc.out_ep.bEndpointAddress);
}

static int sdr_request(struct usbd_class_data *const c_data, struct net_buf *buf, int err)
{
	struct udc_buf_info *bi = udc_get_buf_info(buf);
	uint8_t *data = buf->__buf;
	size_t len = buf->len;
	uint8_t ep = bi->ep;

	ARG_UNUSED(c_data);
	net_buf_unref(buf);
	if (ep == sdr_desc.in_ep.bEndpointAddress) {
		usb_sdr_in_done(data, len, err);
	} else if (ep == sdr_desc.out_ep.bEndpointAddress) {
		usb_sdr_out_done(data, len, err);
	}
	return 0;
}

static struct net_buf *sdr_control_to_host(struct usbd_class_data *c_data,
					   const struct usb_setup_packet *const setup)
{
	struct net_buf *buf;
	int len;

	if (setup->RequestType.recipient != USB_REQTYPE_RECIPIENT_DEVICE) {
		return NULL;
	}
	buf = usbd_ep_ctrl_data_in_alloc(usbd_class_get_ctx(c_data), setup->wLength);
	if (buf == NULL) {
		return NULL;
	}
	len = usb_sdr_control_in(setup->bRequest, setup->wValue, buf->data,
				 MIN(setup->wLength, net_buf_tailroom(buf)));
	if (len < 0) {
		net_buf_unref(buf);
		return NULL;
	}
	net_buf_add(buf, len);
	return buf;
}

static int sdr_control_to_dev(struct usbd_class_data *c_data,
			      const struct usb_setup_packet *const setup,
			      const struct net_buf *const buf)
{
	ARG_UNUSED(c_data);

	if (setup->RequestType.recipient != USB_REQTYPE_RECIPIENT_DEVICE) {
		return -ENOTSUP;
	}
	if (setup->wLength == 0U) {
		return usb_sdr_control_out(setup->bRequest, setup->wValue, NULL, 0);
	}
	if (buf == NULL) {
		/* Setup stage: accept the data stage, handled when it arrives. */
		return 0;
	}
	return usb_sdr_control_out(setup->bRequest, setup->wValue, buf->data, buf->len);
}

static const void *sdr_get_desc(struct usbd_class_data *const c_data, const enum usbd_speed speed)
{
	ARG_UNUSED(c_data);
	return speed == USBD_SPEED_HS ? sdr_hs_desc : sdr_fs_desc;
}

static void sdr_enable(struct usbd_class_data *const c_data)
{
	sdr_c_data = c_data;
	atomic_set(&sdr_up, 1);
	LOG_INF("interface enabled (in 0x%02x, out 0x%02x)", sdr_desc.in_ep.bEndpointAddress,
		sdr_desc.out_ep.bEndpointAddress);
	usb_sdr_link(true);
}

static void sdr_disable(struct usbd_class_data *const c_data)
{
	ARG_UNUSED(c_data);
	atomic_set(&sdr_up, 0);
	LOG_INF("interface disabled");
	usb_sdr_link(false);
}

static int sdr_init(struct usbd_class_data *c_data)
{
	sdr_c_data = c_data;
	return 0;
}

static const struct usbd_class_api sdr_api = {
	.request = sdr_request,
	.control_to_host = sdr_control_to_host,
	.control_to_dev = sdr_control_to_dev,
	.get_desc = sdr_get_desc,
	.enable = sdr_enable,
	.disable = sdr_disable,
	.init = sdr_init,
};

USBD_DEFINE_CLASS(esp_sdr_usb, &sdr_api, NULL, &sdr_vregs);
```
