## lib/ieee802154/Kconfig
```kconfig
# SPDX-License-Identifier: GPL-3.0-or-later

config ESP_SDR_IEEE802154
	bool "IEEE 802.15.4 radio on esp_sdr"
	depends on ESP_SDR_TX && NETWORKING && IEEE802154 && HWINFO
	depends on ESP_SDR_RING && SMP
	select ESP_SDR_RING_BOX4
	help
	  Software 2.4 GHz O-QPSK PHY and an ieee802154_radio_api driver
	  (device "esp_sdr_154"): receive gapless through the 16 MS/s ring
	  decimated by 4 (ESP_SDR_RING_DECIM_BOX4) on CPU 1, the PHY on CPU 0
	  through a sample ring in internal RAM; transmit through the DAC
	  stream. With CONFIG_NET_L2_IEEE802154 it is a network interface;
	  without, a plain device whose frames go to
	  ieee154_esp_sdr_set_rx_cb() (raw 802.15.4 mode would compile out
	  the interface layer the Wi-Fi driver needs). Waits for ACKs, sends
	  them with ESP_SDR_IEEE802154_AUTO_ACK; no CCA: see
	  doc/ieee802154.md. Needs CONFIG_IEEE802154 (packet fields) and
	  CONFIG_HWINFO (the extended address comes from the chip's id).

if ESP_SDR_IEEE802154

config ESP_SDR_IEEE802154_RX_SUMS
	bool "Receive through the ring's sums of four"
	depends on !ESP_SDR_IEEE802154_AUTO_ACK
	help
	  The ring decimates by summing each four pairs (the boxcar) instead
	  of taking every fourth one: the noise of the 12 MHz outside the
	  channel no longer folds into it. On the XIAO S3 against the C6
	  half the frames came through at about 8 dB less signal (6 dB in
	  the simulation, scripts/unit-tables.sh dsp). The sums cost the
	  ring's CPU some 4 cycles a pair more, which it keeps up with in
	  units of 2048 pairs, not 1024: the receiver takes 2048, and its
	  verdict on a frame comes too late for an ACK (doc/ieee802154.md).

config ESP_SDR_IEEE802154_AUTO_ACK
	bool "Send ACKs"
	default y
	help
	  Acknowledge frames to this node that ask for it, from inside the
	  ring run (doc/ieee802154-ack.md): the ring rotates through two banks,
	  the third holds the ACK waveform, and the run stops at the end of
	  such a frame, plays the ACK 192 us after it once the PHY has checked
	  the FCS, and restarts. Not in promiscuous mode.

config ESP_SDR_IEEE802154_ACK_PRIORITY
	int "PHY thread priority while an ACK is armed"
	default 0
	depends on ESP_SDR_IEEE802154_AUTO_ACK
	help
	  From the frame's header to the verdict on its FCS (about 100 us
	  after its end) the PHY thread runs at this priority, so that no
	  other thread on CPU 0 delays the ACK.

config ESP_SDR_IEEE802154_HIGH_RAM_APP
	bool "Internal RAM from the application"
	help
	  The driver's buffers and thread stacks (about 22 KiB, otherwise in
	  the high region) come from ieee154_esp_sdr_high_ram(), which the
	  application defines, so it can use that RAM otherwise in boots
	  without the radio (apps/multiapp).

config ESP_SDR_IEEE802154_PHY_PRIORITY
	int "PHY thread priority"
	default 13
	help
	  The PHY drains the sample ring whenever samples wait. Keep it below
	  the USB, network and application threads: if it falls behind it
	  drops samples instead of starving them. It is above the shell and the
	  log thread (14): it takes some 70 % of CPU 0 on the S3 (40 cycles a
	  sample), they keep the rest, and printing to the console does not
	  hold it off for a ring's length.

module = ESP_SDR_IEEE802154
module-str = esp_sdr_ieee802154
source "subsys/logging/Kconfig.template.log_config"

endif # ESP_SDR_IEEE802154
```

## tests/unit/arb_pred/testcase.yaml
```yaml
tests:
  unit.esp_sdr.arb_pred:
    tags:
      - esp-sdr
      - coexistence
    platform_allow:
      - native_sim
      - native_sim/native/64
    integration_platforms:
      - native_sim
```

## tests/unit/dma_ring/testcase.yaml
```yaml
tests:
  unit.esp_sdr.dma_ring:
    tags:
      - esp-sdr
      - dma
    platform_allow:
      - native_sim
      - native_sim/native/64
    integration_platforms:
      - native_sim
```

## tests/unit/ptp_chain/testcase.yaml
```yaml
tests:
  unit.esp_sdr.ptp_chain:
    tags:
      - esp-sdr
    platform_allow:
      - native_sim
      - native_sim/native/64
    integration_platforms:
      - native_sim/native/64
```

## tests/unit/ring_geom/testcase.yaml
```yaml
tests:
  unit.esp_sdr.ring_geom:
    tags:
      - esp-sdr
    platform_allow:
      - native_sim
      - native_sim/native/64
    integration_platforms:
      - native_sim
```

## tests/unit/rxbench/testcase.yaml
```yaml
tests:
  unit.esp_sdr.rxbench:
    tags:
      - esp-sdr
    platform_allow:
      - native_sim
      - native_sim/native/64
    integration_platforms:
      - native_sim
```

## tests/unit/vrt_eth/testcase.yaml
```yaml
common:
  tags:
    - esp-sdr
    - stream
  platform_allow:
    - native_sim
    - native_sim/native/64
tests:
  unit.esp_sdr.vrt_eth:
    integration_platforms:
      - native_sim
```

## tests/unit/wpan_sniffer/testcase.yaml
```yaml
tests:
  unit.esp_sdr.wpan_sniffer:
    tags:
      - esp-sdr
      - wpan
    platform_allow:
      - native_sim
      - native_sim/native/64
    integration_platforms:
      - native_sim
```
