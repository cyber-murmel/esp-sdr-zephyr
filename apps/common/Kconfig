## lib/esp_sdr/Kconfig
```kconfig
# SPDX-License-Identifier: GPL-3.0-or-later

config ESP_SDR_PHY_ONLY
	bool "Radio without the Wi-Fi driver (ESP32-C6, ESP32-S3, ESP32-S31)"
	depends on (SOC_SERIES_ESP32C6 || SOC_SERIES_ESP32S3 || SOC_SERIES_ESP32S31) && !WIFI_ESP32
	help
	  Brings the PHY up through the HAL's esp_phy_enable() instead of the
	  Wi-Fi driver, and links only the PHY and RF test libraries. Frees
	  the Wi-Fi driver's code and its heap (on the C6 its share of SRAM
	  blocks 0 and 1, the gapless ring takes block 1), and drops the
	  blob's periodic receive glitch.

config ESP_SDR_AS_EXTENSION
	bool "The library and its PHY built as extensions"
	help
	  Leaves only the dump banks' linker snippet in the image: the
	  application builds the library, the 802.15.4 driver and the PHY's
	  blobs as loadable modules (apps/multiapp, sources.cmake).

config ESP_SDR_S31_GROUP1
	bool "Image entirely in TCM group 0 (group 1 left to the engine)"
	depends on SOC_SERIES_ESP32S31
	select ESP_SDR_S31_GROUP2 if ESP_SDR
	help
	  The image and its libc heap end below 0x2F020000 (the linker asserts it, with or without
	  CONFIG_ESP_SDR: esp_sdr_bank_s31.ld, esp_sdr_group1_s31.ld), so that TCM group 1 (0x2F020000,
	  128 KiB, ownership bits 15:8) is free for the DAC reader or the dump engine as group 2 is.
	  Where the image's .noinit data (stacks, buffer pools) goes is left to the SoC's script: it
	  follows the rest of the image, so only a small image fits. ESP_SDR_S31_TXMEM puts it in
	  group 3.

config ESP_SDR_S31_TXMEM
	bool "Transmit memory layout: group 0 the image, group 3 the buffers"
	depends on SOC_SERIES_ESP32S31 && ESP_SIMPLE_BOOT
	depends on !ESP_SDR_DUMPRING && !ESP_SDR_DIAG16 && \
		   !ESP_SDR_AS_EXTENSION
	depends on !USERSPACE && !LLEXT && !ESP32_WIFI_NET_ALLOC_SPIRAM
	select ESP_SDR_S31_GROUP1
	help
	  TCM groups 1 and 2 (0x2F020000 to 0x2F060000) are left entirely to the DAC banks. Text,
	  data, bss and the libc heap stay in group 0 (128 KiB); everything .noinit (network buffer
	  pools, thread and interrupt stacks, kernel heaps, ESP_SDR_NOINIT buffers) goes to group 3
	  from 0x2F060000 up to the ROM boot stack at 0x2F07AFB0 (110 KiB), so group 3 stays the
	  CPU's: nothing may hand it to the dump engine.
	  With CONFIG_ESP_SDR the capture bank is off: esp_sdr_bank_usage() refuses, so the esp_sdr_rx
	  captures return an error, and so does esp_sdr_s31_capture() (its bursts would land in the
	  DAC bank, group 2). The dump engine's one-time setup in the first tune takes group 2
	  instead of group 3. Features that give group 3 to the engine or build on the bank
	  (DUMPRING and with it RING_STAGE, DIAG16, extensions) are excluded. Without
	  CONFIG_ESP_SDR it works as well (apps/rxbench txmem.conf). The linker asserts that group 0
	  ends below group 1 and group 3 below the ROM stack.

config ESP_SDR_S31_TXMEM_PSRAM
	bool "Transmit layout: the stacks of the threads with slack in PSRAM"
	depends on ESP_SDR_S31_TXMEM && ESP_SPIRAM
	default y
	help
	  The stacks Zephyr defines for the threads that run network management, the shell, the log,
	  the work queue and the main thread (esp_sdr_txmem_s31.ld names them by their input sections:
	  .noinit.<file>.<n>) go to PSRAM (only for images whose threads never touch the flash after boot:
	  with a flash operation the cache is off and such a stack stalls, doc/dev/code-placement.md;
	  apps/txstream_eth has none), and so do the network management event queue's ring, which
	  frees group 3 for receive buffers. Nothing that a kernel init hook sets up before PRE_KERNEL_1
	  priority 40 (PSRAM becomes accessible there) may go: k_heap and k_mem_slab backing stores, so
	  the shell's history heap stays internal. Never moved: the interrupt and idle stacks, the
	  receive buffers and descriptors, the system heap (the interrupt allocator's vector descriptors
	  are read in interrupts), the flip thread's stack and whatever CPU 1 runs on. An app's own
	  stacks and cold data use ESP_SDR_STACK_DEFINE() and its category rules (apps/txstream_eth/place.h).
	  scripts/tcm_groups.py --tx checks, after the link, that each stack is where it should be (the
	  counter in the section name changes with the configuration).

config ESP_SDR_S31_TXMEM_NETTX_PSRAM
	bool "Transmit layout: the network stack's transmit buffers in PSRAM (does not work on the board)"
	depends on ESP_SDR_S31_TXMEM_PSRAM
	help
	  The 4 transmit data buffers (and their net_buf records) of the network stack. The net_pkt slab stays
	  internal: slab free lists are built before PSRAM is accessible. The
	  DWC MAC's driver writes them back before it hands them to the DMA (sys_cache_data_flush_range()
	  in eth_dwc_ether_1000_core.c), but the EMAC's DMA does not reach PSRAM on the S31: shown not to work
	  on the board 2026-11-26 (every send fails, and receive buffers in PSRAM lose frames of 500
	  bytes and more). Keep off.

config ESP_SDR
	bool "ESP-SDR raw I/Q receiver"
	# Its radio comes up through esp_phy_rftest_config(), which lives in that library.
	select ESP_SDR_RFTEST if SOC_SERIES_ESP32S31
	depends on SOC_SERIES_ESP32S3 || SOC_SERIES_ESP32C6 || SOC_SERIES_ESP32C5 || \
		   SOC_SERIES_ESP32 || SOC_SERIES_ESP32S31
	depends on WIFI_ESP32 || ESP_SDR_PHY_ONLY
	# The bank and heap limits assume no APPCPU image in SRAM.
	depends on !SOC_ENABLE_APPCPU
	help
	  Burst capture of raw baseband I/Q samples from the Wi-Fi receiver,
	  ported from ESPARGOS esp-sdr. Reserves an SRAM bank for the capture
	  engine (64 KiB on the S3, the 128 KiB block 2 on the C6). The
	  ESP32-C6 captures at 80 MS/s only, and streams continuously,
	  CPU-paced (ESP_SDR_PACED). The ESP32-C5 receives at 80 to 4 MS/s
	  into its 128 KiB block 1, which splits the image around it, streams
	  like the C6 or gapless through the diagnostic bus (ESP_SDR_DIAG),
	  and loops waveforms through its DAC engine (ESP_SDR_REPLAY). The
	  ESP32 receives bursts at 80, 40 and 16 MS/s into 64 KiB of SRAM1,
	  which needs ESP32_REGION_1_NOINIT off. The ESP32-S31 receives bursts
	  at 80 to 4 MS/s into the TCM's upper group, without the Wi-Fi driver.

if ESP_SDR

config ESP_SDR_WIFI_SHARED
	bool "Leave the Wi-Fi driver alone at init (Wi-Fi associates and sleeps normally)"
	depends on WIFI_ESP32
	help
	  esp_sdr_init() then neither disables power save, nor enters promiscuous mode, nor sets
	  channel 1. Captures sample what the MAC and AGC have set up: pair it with
	  esp_sdr_rx_set_passive().

config ESP_SDR_ARB
	bool "Radio arbiter: the SDR takes the radio in Wi-Fi's sleep windows"
	depends on SOC_SERIES_ESP32S3 && (ESP_SDR_WIFI_SHARED || ESP_SDR_AS_EXTENSION)
	help
	  Wraps the Wi-Fi blob's esp_phy_enable() and esp_phy_disable() (linker --wrap) and owns
	  the real calls: the PHY is powered while Wi-Fi or the SDR needs it. The SDR takes the
	  radio with esp_sdr_arb_claim() while Wi-Fi sleeps (station modem sleep, ESP-NOW wake
	  windows), runs until the predicted next Wi-Fi wake less a margin, and gives it back with
	  esp_sdr_arb_release(), which restores Wi-Fi's gain, filter codes and channel. Wi-Fi's
	  wake preempts a late SDR. Captures and ring runs need a claim (-EBUSY), except passive
	  captures, which need Wi-Fi's PHY on (-EAGAIN). Without this option nothing changes.

	  As extensions (ESP_SDR_AS_EXTENSION, apps/multiapp) the arbiter is in the phy module, which
	  the wifi module shares with the SDR (the wifi module's calls are wrapped there too). esp_sdr_init()
	  then takes a standing claim with no deadline when no Wi-Fi driver is attached
	  (esp_sdr_arb_wifi_attach()), so the apps of a boot without Wi-Fi need no claims.

config ESP_SDR_ARB_MARGIN_US
	int "Window margin before the predicted Wi-Fi wake (us)"
	default 3000
	depends on ESP_SDR_ARB
	help
	  A window ends this long before the next predicted enable: the ring ends within one to
	  one and a half units (about 1.2 ms at the default unit), a restore takes about a
	  millisecond, and the beacon jitters.

config ESP_SDR_ARB_MIN_WINDOW_US
	int "Shortest window a claim accepts (us)"
	default 8000
	depends on ESP_SDR_ARB
	help
	  A claim waits for the next Wi-Fi sleep when less than this is left before the deadline:
	  the PHY power-up and the retune (about 3.5 ms) come out of it.

config ESP_SDR_ARB_PREEMPT_WAIT_US
	int "Longest wait of Wi-Fi's wake for the SDR to let go (us)"
	default 5000
	depends on ESP_SDR_ARB
	help
	  Wi-Fi's esp_phy_enable() calls the SDR's stop hook and waits this long for its release;
	  it then goes on, the SDR's state unrestored, and counts a timeout.

config ESP_SDR_ARB_MIN_WAKE_US
	int "Shortest Wi-Fi wake the predictor learns from (us)"
	default 1000
	depends on ESP_SDR_ARB
	help
	  An enable counts as a beacon wake only when its disable follows at least this late; the
	  blob's short enable and disable pair after the SDR's release is not one.

config ESP_SDR_ARB_WIFI_FLAG
	bool "The SDR's PHY power-up and power-down also set the PHY's Wi-Fi flag"
	default y
	depends on ESP_SDR_ARB
	help
	  Calls phy_wifi_enable_set(1) and (0) around the SDR's real esp_phy_enable() and
	  esp_phy_disable(), as Wi-Fi's adapter does. An A/B switch for the blob's spurious enable
	  after a release.

config ESP_SDR_ARB_PHY_CYCLE
	bool "Power-cycle the PHY when a preempted SDR lets go"
	depends on ESP_SDR_ARB
	help
	  After the restore, when Wi-Fi is awake, the arbiter powers the PHY down and up once, so
	  it resets everything it owns, at the cost of its power-up time in Wi-Fi's wake. An
	  experiment: the explicit restore is the default.

config ESP_SDR_RFTEST
	bool "Espressif RF test library (fixed RX gain, TX power steps)"
	default y
	# No blob for the ESP32, which forces its gain without it.
	depends on !SOC_SERIES_ESP32
	help
	  Links force_rx_gain(), force_tx_gain() and force_txon_mode() from
	  Espressif's librftest.a, fetched with "west blobs fetch
	  esp-sdr-zephyr". Without it the receiver runs on the hardware AGC
	  only and transmit keeps the PHY's own power setting.

config ESP_SDR_RX_DC_REMOVE
	bool "Receive DC taken off paced streams"
	depends on SOC_SERIES_ESP32C6 || SOC_SERIES_ESP32C5
	default y
	help
	  esp_sdr_rx_paced_start() measures the receive chain's DC with the
	  IQ estimator (32768 inputs, 2.5 ms with the settling) and every
	  sample has it taken off: without it the DC stands some 45 dB over
	  the noise floor at the stream's centre.

config ESP_SDR_RX_DECIM
	bool "Decimated capture"
	default y
	help
	  esp_sdr_rx_capture_decimated(): a full capture filtered and
	  decimated by a third order CIC, for narrow band streams.
	  esp_sdr_rx_capture_folded(): the same capture folded (decimated in
	  frequency, aliasing the whole band down) instead of filtered, for a
	  wideband power/occupancy survey. Apps that work at the native rate
	  can leave it out.

config ESP_SDR_PACED
	bool "CPU-paced streaming (ESP32-C6, ESP32-C5, ESP32-S31)"
	default y
	depends on (SOC_SERIES_ESP32C6 || SOC_SERIES_ESP32C5 || SOC_SERIES_ESP32S31) && \
		   ESP_SDR_RFTEST
	help
	  esp_sdr_rx_paced_*() and esp_sdr_tx_paced_*(): continuous receive
	  through the modem's IQ estimator and continuous transmit through the
	  TX DC value register, paced by the CPU from the caller's loop. The
	  ESP32-S31 has no IQ estimator: transmit only.

config ESP_SDR_PACED_TX_BLOCK
	bool "Paced transmit: DAC words computed a block ahead by the other core"
	default n
	depends on ESP_SDR_PACED && SMP && SOC_SERIES_ESP32S31
	select SCHED_CPU_MASK
	help
	  esp_sdr_tx_paced_poll() only stores a precomputed DAC word; the FIR
	  and the input callback run in a thread pinned to the core the caller
	  of esp_sdr_tx_paced_start() is not on, which fills blocks of DAC words
	  ahead. That core spins for the length of a stream. The input callback
	  runs on that core, up to CONFIG_ESP_SDR_PACED_BLOCKS blocks ahead of
	  the DAC, and must not take irq_lock() (doc/samples/paced.md). Off:
	  the per-word path, up to 1 MHz of DAC writes. On one core the
	  block fill measured no better than it (doc/dev/hot-loops.md).

config ESP_SDR_PACED_BLOCK_WORDS
	int "Paced transmit block size in DAC words"
	default 128
	range 16 512
	depends on ESP_SDR_PACED_TX_BLOCK
	help
	  Blocks of this many 32-bit words, and the input history of one
	  (2 bytes a word for I and Q each), in internal RAM. A multiple of 8.

config ESP_SDR_PACED_BLOCKS
	int "Paced transmit blocks in the ring"
	default 4
	range 2 8
	depends on ESP_SDR_PACED_TX_BLOCK
	help
	  Blocks of DAC words between the fill thread and the poll. One
	  plays, the others are filled: a stall of the fill core as long as
	  (blocks - 1) blocks of playing time is absorbed without a replay.

config ESP_SDR_PACED_FILL_STACK_SIZE
	int "Paced transmit fill thread stack size"
	default 1024
	depends on ESP_SDR_PACED_TX_BLOCK
	help
	  The fill loop and the FIR need little; the input callback's own
	  needs come on top. Internal RAM is tight.

config ESP_SDR_TRIG
	bool "Triggered 80 MS/s snapshots (ESP32-C6)"
	default y
	depends on SOC_SERIES_ESP32C6 && ESP_SDR_PACED
	help
	  esp_sdr_trig_*(): the dump engine as a 205 us ring in SRAM block 2,
	  frozen once the power the IQ estimator sums over the 80 MHz input
	  rises past a threshold, so a snapshot holds a burst and what came
	  before it.

config ESP_SDR_GAPLESS
	bool "Gapless 80 MS/s ring over two SRAM blocks (ESP32-C6)"
	depends on SOC_SERIES_ESP32C6 && ESP_SDR_PHY_ONLY && ESP_SDR_PACED
	help
	  esp_sdr_gapless_*(): the dump engine runs without a stop while the
	  CPU switches it between SRAM blocks 1 and 2 (upstream's ring, after
	  h0m3us3r/eSpDR), with marker words proving every unit boundary;
	  the CPU reads the block the engine is not writing. The image must
	  fit SRAM block 0, which in practice needs ESP_SDR_PHY_ONLY.

config ESP_SDR_GAPLESS_STAGE_KB
	int "Gapless staging ring, KiB"
	depends on ESP_SDR_GAPLESS
	default 48
	range 8 96
	help
	  Kept windows are copied raw from the ring's blocks into this ring
	  in SRAM block 3 before they are packed: a block is readable for one
	  unit (154 us) only, the copy is cheap, and the packing then has no
	  deadline. The upper halves of blocks 1 and 2 (the ring takes the
	  lower ones) add 2 x 64 KiB once their canaries hold. What the CPU
	  can copy per unit, not this size, bounds a whole burst.

config ESP_SDR_GAPLESS_THR_LINK_PCT
	int "Threshold servo: how full the link may get, percent"
	depends on ESP_SDR_GAPLESS
	default 95
	range 50 100
	help
	  What is kept past this share of the link's budget raises the
	  threshold by 1 dB a period, and less than 5 points below it lowers
	  the threshold by 0.5 dB. The gain servo keeps its own headroom. A
	  host's headroom in ESDR_REQ_SET_GAPLESS replaces this for the run.

config ESP_SDR_GAPLESS_THR_LOST_PCT
	int "Threshold servo: samples it lets the CPU lose, percent"
	depends on ESP_SDR_GAPLESS
	default 5
	range 0 50
	help
	  A period in which the CPU abandoned more than this share of the
	  samples kept raises the threshold by 2 dB. 0: any lost sample does,
	  which keeps some 40 % fewer samples at 80 MS/s (doc/samples/rings.md). Past
	  the link's budget it rises by 2 dB whatever this says.

config ESP_SDR_DIAG
	bool "Gapless receive through the modem diagnostic bus (ESP32-C5)"
	depends on SOC_SERIES_ESP32C5 && ESP_SDR_PACED
	help
	  esp_sdr_diag_run(): the dump engine runs free, the GPIO matrix loops
	  the modem diagnostic bus back into the PARLIO receiver, and a GDMA
	  ring in SRAM bank 1 collects 4 bits of I and 4 bits of Q at 40 MS/s
	  without the CPU. Drives 8 pads as outputs while it runs. Takes the
	  bank of the capture engine and the radio for the whole run.

config ESP_SDR_DIAG16
	bool "Gapless receive through the diagnostic bus (ESP32-S31)"
	depends on SOC_SERIES_ESP32S31
	help
	  esp_sdr_diag16_run(): continuous 8+8 bit I/Q up to 40 MS/s, the bus
	  looped through 16 pads into PARLIO, a GDMA ring collecting it without
	  the CPU. Takes 16 pads, which nothing else may drive, and the ring below
	  the capture bank. Not with the LCD-CAM panel driver in the image: every
	  run resets the whole AXI GDMA group.

config ESP_SDR_DIAG16_RING_KB
	int "Ring size in KiB"
	default 128
	range 64 192
	depends on ESP_SDR_DIAG16
	help
	  A multiple of 64: the ring's 4 KiB nodes make frames of 16, the most
	  a PARLIO frame's length holds. 128 KiB hold 3.3 ms at 20 MS/s. It takes
	  this much from the top of the image's memory.

config ESP_SDR_DIAG16_SLAB_NODES
	int "Nodes in a slab"
	default 8
	range 1 16
	depends on ESP_SDR_DIAG16
	help
	  The ring is cut into slabs of this many consecutive nodes (the ring's
	  node count must be a multiple). A slab is what
	  esp_sdr_diag16_slab_detach() hands to a consumer in one piece.

config ESP_SDR_DIAG16_ZEROCOPY
	bool "Hand ring slabs to a consumer by re-linking the descriptors"
	depends on ESP_SDR_DIAG16
	help
	  esp_sdr_diag16_slab_detach(): a slab of the ring goes to a consumer
	  as it is, with no copy, and the ring's descriptors take a spare slab in
	  its place. The spares are memory of the library (one slab each, in
	  the image's RAM), which a consumer that copies out of the ring would
	  have had to provide itself. Without this option there are no spares and
	  detach returns -ENOMEM.

config ESP_SDR_DIAG16_SPARE_SLABS
	int "Spare slabs"
	default 3
	range 1 8
	depends on ESP_SDR_DIAG16_ZEROCOPY
	help
	  Slabs a consumer can hold at once: more than this many outstanding
	  and the next detach fails with -ENOMEM (nothing is swapped).

config ESP_SDR_REPLAY
	bool "Loop replay through the DAC engine (ESP32-C5, ESP32-S31)"
	depends on (SOC_SERIES_ESP32C5 && ESP_SDR_PACED) || SOC_SERIES_ESP32S31
	help
	  esp_sdr_replay_*(): the modem DAC engine plays words out of memory,
	  once, a number of times or endlessly, without the CPU. Periodic
	  content only: the engine owns its memory while it plays. The C5:
	  up to 16383 words of the dump bank at 80 or 40 MS/s. The S31: up to
	  32768 words at 80, 40 or 20 MS/s out of the TCM's 128 KiB group at
	  0x2F040000, which the image must then end below (shared with the
	  DIAG16 ring).

config ESP_SDR_DUMPRING
	bool "Gapless receive through the dump engine alone (ESP32-S31)"
	depends on SOC_SERIES_ESP32S31
	help
	  esp_sdr_dumpring_run(): continuous 10+10 bit I/Q at 20 MS/s or a
	  lower capture rate, without pads or the diagnostic bus: the dump
	  engine writes without a stop, the CPU moves it between TCM group 2
	  and the capture bank's group and reads the one it is not writing.
	  The image must end below group 2. While group 3 (the ROM data's) is
	  the engine's, a few microseconds a unit, the other core waits.

config ESP_SDR_S31_GROUP2
	bool
	default y if ESP_SDR_REPLAY || ESP_SDR_DUMPRING
	depends on SOC_SERIES_ESP32S31
	help
	  TCM group 2 (0x2F040000, 128 KiB) reserved for the engine: the image
	  ends below it.

config ESP_SDR_TXS_PIE
	bool "PIE kernel of the transmit stream (8+8 bit to DAC words, CPU 1 only)"
	depends on SOC_SERIES_ESP32S31 && SMP
	help
	  txs_kern_pie (lib/esp_sdr/src/txs/txs_pie.S): the expansion of the 8+8 bit payload with the
	  S31's PIE vector unit, about 2 cycles a sample. Espressif's assembler (riscv32-esp-elf-as)
	  builds the one file; the PIE state is not saved by the context switch, so the kernel may
	  run in the one thread pinned to CPU 1 only.

config ESP_SDR_DMA
	bool "Memory-to-memory GDMA gathers (esp_sdr_dma.h)"
	depends on SOC_SERIES_ESP32S3 && !ESP_SDR_AS_EXTENSION && !DMA_ESP32
	help
	  Descriptor-list copies and gathers by a GDMA channel pair (the S3 backend, hal
	  gdma_ll.h), for I/Q and slot templates, refusing sources and destinations in a dump bank
	  the engine may own. The library owns the GDMA controller: Zephyr's driver (DMA_ESP32)
	  must be off, as it is when no devicetree node of the board enables the dma node.

config ESP_SDR_BANK1
	bool "Reserve a second dump bank"
	depends on SOC_SERIES_ESP32S3
	help
	  Reserves SRAM bank 1 (0x3fcc0000) next to the capture bank, for
	  two-bank loop playback (esp_sdr_tx_loop_*()) and for captures into
	  either bank (esp_sdr_rx_capture_bank()). Costs another 64 KiB of
	  internal RAM.

config ESP_SDR_RING
	bool "Continuous ring receive"
	depends on SOC_SERIES_ESP32S3
	select ESP_SDR_BANK1
	help
	  esp_sdr_ring_run(): the dump engine in circular mode, rotated
	  through SRAM banks 0 to 2, and a two-stage decimating FIR on the
	  vector unit: gapless I/Q at 16 MS/s divided by 32 to 1024. Reserves
	  SRAM bank 0 (0x3fcb0000) besides banks 1 and 2, another 64 KiB of
	  internal RAM: the whole DRAM image must end below 0x3fcb0000.

# The ring masks its CPU for a run and serves what is pending there in short windows. Without
# IPI_OPTIMIZE every thread made ready on the other CPU sends it a scheduler IPI, even one pinned
# away from it: about 1700 windows a second in wpan without the Wi-Fi driver (its PHY thread
# sleeps 100 us at a time), 32 in Ubertooth (2026-11-15). The ring's thread is cooperative, so
# with the option it draws none.
configdefault IPI_OPTIMIZE
	default y if ESP_SDR_RING && SMP

config ESP_SDR_RING_LATE_PAIRS
	int "Ring unit switch lateness allowed (pairs, 0: as much as the windows hold)"
	depends on ESP_SDR_RING
	range 0 2000
	default 0
	help
	  How many pairs after its threshold the ring may switch banks before the
	  run fails with ESP_SDR_RING_LATE (and restarts). 0 keeps the old geometry:
	  late is 896 at 1024-pair units and up to 2000, with sentinel windows of
	  late + 128 (start, up to 3072) and 2 late + 128 (end, up to 4096) pairs
	  re-marked every unit. A value from 64 caps late and shrinks both windows
	  with it (late 256: 384 + 640 words a unit instead of 1024 + 1920), which
	  frees filter cycles but fails sooner on a stall. The ring stats' lateness
	  histogram (wpan status, osmosdr sdr status) shows what is needed.

config ESP_SDR_RING_BOX4
	bool "Ring decimation by 4 (boxcar, for 2 MHz wide signals)"
	depends on ESP_SDR_RING
	help
	  ESP_SDR_RING_DECIM_BOX4: -fs/4 mix and a boxcar of 4 (or every 4th
	  pair) instead of the FIR chain, for signals such as IEEE 802.15.4 at
	  4 MS/s. About 1 KiB of IRAM, which on the S3 comes out of the same
	  SRAM as the DRAM image: leave it out where that is tight.

config ESP_SDR_RING_STAGE
	bool "The receiver's output staged in internal RAM for the other CPU"
	depends on ESP_SDR_RING || (ESP_SDR_DUMPRING && ESP_SDR_S31_GROUP2)
	default ESP_SDR_RING_BOX4
	help
	  esp_sdr_ring_stage.h: a sink that writes the output samples into
	  internal RAM, from IRAM, for a consumer on the other CPU that reads
	  them in place; the run's CPU touches no flash or PSRAM. On the S3
	  SRAM bank 2 (a ring run with spare_bank_app), optionally pairs
	  averaged (4 MS/s from the box4 path as 2 MS/s); on the S31 the
	  capture bank past the dump ring's words, written with
	  esp_sdr_stage_put(). Some 400 bytes of IRAM.

config ESP_SDR_RING_RAW
	bool "Ring without decimation (the unpacked 16 MS/s stream to the sink)"
	depends on ESP_SDR_RING
	help
	  ESP_SDR_RING_DECIM_RAW: the sink gets the whole stream as int16
	  pairs in chunks of up to 512, with 64 pairs of history in front,
	  for a consumer on the other CPU.

config ESP_SDR_RING_FIR
	bool "Ring decimation by 32 to 1024 (the two-stage FIR)"
	depends on ESP_SDR_RING
	default y
	help
	  ESP_SDR_RING_DECIM_MIN to ESP_SDR_RING_DECIM_MAX. An image that
	  runs the ring only raw or by 4 can leave the filter out: about
	  1 KiB of IRAM, which on the S3 comes out of the same SRAM as the
	  DRAM image.

config ESP_SDR_CPU_PROF
	bool "Profile of the other CPU, sampled by the ring (ESP32-S3)"
	depends on ESP_SDR_RING && SMP && ESP_SPIRAM && !ESP_SDR_AS_EXTENSION
	help
	  esp_sdr_prof.h: while esp_sdr_ring_run() runs, its CPU records the
	  other CPU's program counter (the debug assist's PC recorder), its
	  current thread and interrupt state once a period, into PSRAM, 12
	  bytes a sample. The sampled CPU takes no interrupt for it, and the
	  code that masks interrupts is sampled as well; there are no stacks,
	  and no samples while the ring is stopped. For those, Zephyr's perf
	  (PROFILING_PERF) samples stacks in a timer interrupt; its record
	  command's CPU mask can leave the ring's CPU out. Some 120 bytes of
	  IRAM; the ring checks the period in its poll loop and before every
	  sink call. The "prof" shell command of apps/common
	  (CONFIG_APP_PROF_SHELL) drives it; scripts/place/prof_map.py and
	  hot_text.py read its dumps.

config ESP_SDR_CPU_PROF_SAMPLES
	int "Profiler samples"
	depends on ESP_SDR_CPU_PROF
	range 1024 1048576
	default 131072
	help
	  The buffer in samples of 12 bytes, in PSRAM: at a 64 us period the
	  default holds 8.4 s. apps/common's "prof dump" prints 54 bytes a
	  sample: 7 MB for the default, 11 s over CDC-ACM.

config ESP_SDR_GAIN_GUARD
	bool "Clip guard for the receive gain"
	help
	  esp_sdr_gain_guard.h: steps an app's receive gain down a level when
	  packets reach full scale and up again after a quiet hold, which
	  grows when the source comes in bursts. The app keeps its levels'
	  gains and counts the packets.

config ESP_SDR_HOT_TEXT
	bool "Hot flash code as one block at a fixed instruction cache position"
	depends on SOC_SERIES_ESP32S3
	help
	  The app's hottest flash functions (its list, esp_sdr_hot_text() in
	  lib/esp_sdr/place.cmake, which scripts/place/hot_text.py writes from
	  profiles) and the code its rules place in ESP_SDR_HOTBLOCK
	  (esp_sdr_place.h) as one block of flash text aligned to the
	  instruction cache's way: its lines keep their cache sets whatever
	  code comes before or after it (doc/dev/code-placement.md). Needs the
	  TEXT_SECTIONS hook of the ESP32-S3 linker script (Zephyr commit
	  "soc: espressif: let applications place code in esp32s3 flash
	  text"); the build stops without it.

config ESP_SDR_HOT_TEXT_BUDGET
	int "Hot block size limit in bytes, text and literals"
	depends on ESP_SDR_HOT_TEXT
	default 12288
	help
	  The link stops when the block is larger, and hot_text.py fills its
	  list up to it. At 12 KB of a 16 KB cache of 8 ways the block takes
	  6 ways of each set and leaves 2 to the rest of the flash code.

config ESP_SDR_CHANCAP
	bool "Channelized burst capture"
	depends on ESP_SDR_RING && ESP_SPIRAM && SMP && SCHED_CPU_MASK
	select ESP_SDR_RING_RAW
	help
	  esp_sdr_chancap_start(): the ring without decimation into a
	  hand-over ring in SRAM bank 2, a channelizer (filter bank or
	  decimator bank) and a detector per channel on the other CPU, one
	  I/Q capture per packet per channel from a PSRAM slab to a callback
	  thread. Design: doc/modem/channelizer.md.

if ESP_SDR_CHANCAP

config ESP_SDR_CHANCAP_SIMD
	bool "Vector unit kernels for the 8-channel filter bank"
	default y
	help
	  The branch sums, twiddles and the DFT of an 8-channel bank on the
	  PIE (esp_sdr_chancap_pie.S), bit-exact with the C reference; other
	  geometries and the decimator bank run the C code.

config ESP_SDR_CHANCAP_SLAB_KB
	int "Capture slab in PSRAM, KiB"
	default 512
	help
	  Split at start into buffers of max_capture_us samples each.

config ESP_SDR_CHANCAP_QUEUE
	int "Finished captures waiting for the callback thread"
	default 32

config ESP_SDR_CHANCAP_RING_CPU
	int "CPU of the ring loop; the channelizer and callback run on the other"
	range 0 1
	default 1

config ESP_SDR_CHANCAP_DSP_PRIORITY
	int "Preemptive priority of the channelizer thread (the callback thread one below)"
	range 1 13
	default 1
	help
	  The highest preemptive priority: above the Wi-Fi driver's tasks (3
	  to 7), the USB stack's threads (8), the shell and the logging thread
	  (14). The channelizer is the real-time work of its CPU and must not
	  wait behind any of them, as the hand-over ring holds about 400 us.
	  It sleeps a tick whenever it has caught up and after an overrun, so
	  lower threads run even when the band is busier than it keeps up
	  with. The callback thread runs one priority lower: finished
	  captures leave while the channelizer sleeps. Nothing cooperative may
	  run on the channelizer's CPU: the chancap images set
	  CONFIG_SYSTEM_WORKQUEUE_PRIORITY=11 (the CDC-ACM class's work queue
	  takes it too), CONFIG_USBD_THREAD_PREEMPTIBLE and
	  CONFIG_UDC_DWC2_THREAD_PREEMPTIBLE, as each of those held the CPU
	  for hundreds of microseconds per USB transfer burst.

config ESP_SDR_CHANCAP_RING_STACK_SIZE
	int "Ring thread stack (internal RAM above the capture bank)"
	default 1536

config ESP_SDR_CHANCAP_DSP_STACK_SIZE
	int "Channelizer thread stack (internal RAM above the capture bank)"
	default 3072

config ESP_SDR_CHANCAP_OUT_STACK_SIZE
	int "Callback thread stack (internal RAM above the capture bank)"
	default 2048

endif # ESP_SDR_CHANCAP

config ESP_SDR_TX
	bool "Transmit streaming through the DAC"
	depends on SOC_SERIES_ESP32S3 && ESP_SPIRAM && ESP_SDR_RFTEST
	select ESP_SDR_BANK1
	help
	  esp_sdr_tx_start(), esp_sdr_tx_write() and esp_sdr_tx_stop():
	  input samples buffered in PSRAM and interpolated to the 40 MS/s
	  DAC rate in a player thread, played gapless from two banks; and
	  esp_sdr_tx_dac_play_gen() for generated waveforms. Needs PSRAM and
	  the RF test library, without which the MAC never turns the
	  transmitter on.

if ESP_SDR_TX

config ESP_SDR_TX_DAC_RING_SAMPLES
	int "Input ring size in samples (PSRAM, 4 bytes each, power of two)"
	default 262144

config ESP_SDR_TX_DAC_PREBUF_MS
	int "Input buffered before playback starts, in ms"
	default 20

config ESP_SDR_TX_DAC_SIMD
	bool "Interpolate with the ESP32-S3 vector unit"
	default y
	help
	  Four DAC words per instruction group (src/esp_sdr_pie.S). The
	  vector registers are not saved by Zephyr, so only the filler
	  threads may use them, with the scheduler locked meanwhile.

config ESP_SDR_TX_DAC_HIGH_RAM
	bool "DAC stream buffers and thread stacks above the capture bank"
	help
	  Puts the input staging buffer and the player and filler stacks
	  (about 7 KiB) in ESP_SDR_HIGH_RAM instead of the DRAM image, for
	  apps whose image must end below the ring banks.

config ESP_SDR_TX_DAC_STACK_SIZE
	int "Player and filler thread stack size"
	default 2048

config ESP_SDR_TX_DAC_PRIORITY
	int "Player thread priority"
	default 8
	help
	  Below the network and transmit receive threads, above the fillers:
	  it only copies ready blocks and restarts the DAC.

config ESP_SDR_TX_DAC_FILLER_PRIORITY
	int "Filler thread priority"
	default 5
	help
	  The leader fills one block per bank pass and sleeps until its switch
	  time, so it can sit above the application threads: any thread that
	  preempts it on its CPU for longer than the block tail (51 us) makes
	  the DAC restart.

config ESP_SDR_TX_DAC_LEADER_CPU
	int "CPU of the leading filler"
	range 0 1
	default 1
	help
	  The leader fills every block when the vector unit is available, the
	  other filler only helps the C fallback. Put the leader on the CPU
	  that is idle while transmitting: a transmit session holds the radio,
	  so receive capture waits and its processing CPU is free.

endif # ESP_SDR_TX

config ESP_SDR_TEMP
	bool "Die temperature for the crystal calibration"
	default y if ESP32_TEMP
	depends on SENSOR && $(dt_alias_enabled,die-temp0)
	help
	  esp_sdr_get_temp_dc() reads the chip's temperature sensor (the
	  devicetree alias die-temp0: apps/common/dietemp.overlay enables
	  it). The calibration records the temperature with each
	  measurement, and a correction fitted over several temperatures
	  follows it whenever the radio tunes.

config ESP_SDR_CALSTORE
	bool "Crystal calibration in Zephyr settings"
	depends on SETTINGS
	help
	  esp_sdr_cal_load(), esp_sdr_cal_save() and esp_sdr_cal_clear() keep
	  the crystal correction under the settings key "esp_sdr/cal", and
	  esp_sdr_init() applies the stored one before it first tunes. The
	  app chooses the settings backend: apps/common/calstore.conf and
	  calstore.overlay set up the file backend on a FAT volume in
	  the storage partition.

config ESP_SDR_LTE_CAL
	bool "Crystal calibration against an LTE cell"
	depends on ESP_SDR_RX_DECIM
	help
	  esp_sdr_lte_calibrate(): finds an LTE downlink, decodes its cell
	  from the synchronization signals and measures the crystal's error
	  from the carrier (include/esp_sdr/esp_sdr_lte.h). Takes heap for
	  its work memory while it runs (ESP_SDR_LTE_CAL_FFT); on the C6,
	  whose captures are 0.2 ms, 34 KiB of the SRAM above the capture
	  bank, statically, and a few KiB of heap.

if ESP_SDR_LTE_CAL

config ESP_SDR_LTE_CAL_FFT
	int "Largest transform of the estimator"
	default 2048
	range 1024 4096
	help
	  Points of the correlation transform, a power of two: a capture at
	  2 MS/s may be this long less a symbol (2048: 0.95 ms, holding one
	  synchronization signal pair). The work memory is 36 bytes a point
	  (2048: 72 KiB); 4096 doubles the capture where the chip captures
	  that long (S3 1 ms at most, C5 up to 4 ms).

config HEAP_MEM_POOL_ADD_SIZE_ESP_SDR_LTE_CAL
	int
	default 4096 if SOC_SERIES_ESP32C6
	default 81920 if ESP_SDR_LTE_CAL_FFT <= 2048
	default 155648

endif # ESP_SDR_LTE_CAL

module = ESP_SDR
module-str = esp_sdr
source "subsys/logging/Kconfig.template.log_config"

endif # ESP_SDR
```
