/*
 * SPDX-License-Identifier: GPL-3.0-or-later
 *
 * The chip's temperature sensor (alias die-temp0) for the crystal calibration's temperature
 * model (CONFIG_ESP_SDR_TEMP, with CONFIG_SENSOR from calstore.conf). Not on the ESP32.
 */

&coretemp {
	status = "okay";
};
