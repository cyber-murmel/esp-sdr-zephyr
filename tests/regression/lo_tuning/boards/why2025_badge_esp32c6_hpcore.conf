## tests/unit/esdr_dev/testcase.yaml
```yaml
common:
  tags:
    - esp-sdr
    - osmosdr
  platform_allow:
    - native_sim
    - native_sim/native/64
tests:
  unit.esp_sdr.esdr_dev:
    integration_platforms:
      - native_sim
```

## tests/unit/esdr_link_host/testcase.yaml
```yaml
common:
  tags:
    - esp-sdr
    - gapless
  platform_allow:
    - native_sim
    - native_sim/native/64
tests:
  unit.esp_sdr.esdr_link_host:
    integration_platforms:
      - native_sim
```

## tests/unit/esdr_pfb/testcase.yaml
```yaml
tests:
  unit.esp_sdr.esdr_pfb:
    tags:
      - esp-sdr
      - esdr
    platform_allow:
      - native_sim
      - native_sim/native/64
    integration_platforms:
      - native_sim
```

## tests/unit/esdr_pfbq/testcase.yaml
```yaml
tests:
  unit.esp_sdr.esdr_pfbq:
    tags:
      - esp-sdr
      - esdr
    platform_allow:
      - native_sim
      - native_sim/native/64
      - why2025_badge/esp32p4/hpcore
    integration_platforms:
      - native_sim
```

## tests/unit/gapless_sort/testcase.yaml
```yaml
tests:
  unit.esp_sdr.gapless_sort:
    tags:
      - esp-sdr
      - gapless
    platform_allow:
      - native_sim
      - native_sim/native/64
    integration_platforms:
      - native_sim
```

## tests/unit/iq_pack/testcase.yaml
```yaml
tests:
  unit.esp_sdr.iq_pack:
    tags:
      - esp-sdr
      - sdr_stream
    platform_allow:
      - native_sim
      - native_sim/native/64
    integration_platforms:
      - native_sim
```

## tests/unit/mch2022_coproc/testcase.yaml
```yaml
tests:
  unit.esp_sdr.mch2022_coproc:
    tags:
      - esp-sdr
    platform_allow:
      - native_sim
      - native_sim/native/64
    integration_platforms:
      - native_sim
```

## tests/unit/pcap_ble/testcase.yaml
```yaml
tests:
  unit.esp_sdr.pcap_ble:
    tags:
      - esp-sdr
      - pcap
    platform_allow:
      - native_sim
      - native_sim/native/64
    integration_platforms:
      - native_sim
```

## tests/unit/pcapng/testcase.yaml
```yaml
tests:
  unit.esp_sdr.pcapng:
    tags:
      - esp-sdr
      - pcap
    platform_allow:
      - native_sim
      - native_sim/native/64
    integration_platforms:
      - native_sim
```

## tests/unit/ubertooth_core/testcase.yaml
```yaml
tests:
  unit.esp_sdr.ubertooth_core:
    tags:
      - esp-sdr
      - ubertooth
    platform_allow:
      - native_sim
      - native_sim/native/64
    integration_platforms:
      - native_sim
```

## tests/unit/ubertooth_specan/testcase.yaml
```yaml
tests:
  unit.esp_sdr.ubertooth_specan:
    tags:
      - esp-sdr
      - ubertooth
    platform_allow:
      - native_sim
      - native_sim/native/64
    integration_platforms:
      - native_sim
```

## tests/unit/zigbee_crypto/testcase.yaml
```yaml
tests:
  unit.esp_sdr.zigbee_crypto:
    tags:
      - esp-sdr
      - zigbee
    platform_allow:
      - native_sim
      - native_sim/native/64
    integration_platforms:
      - native_sim
```

## tests/unit/zigbee_mac/testcase.yaml
```yaml
tests:
  unit.esp_sdr.zigbee_mac:
    tags:
      - esp-sdr
      - zigbee
    platform_allow:
      - native_sim
      - native_sim/native/64
    integration_platforms:
      - native_sim
```
