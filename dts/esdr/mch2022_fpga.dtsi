/*
 * SPDX-License-Identifier: GPL-3.0-or-later
 *
 * The MCH2022 badge's iCE40 as an esp-sdr accelerator. The panel moves behind it: the board's
 * zephyr,mipi-dbi-spi node gives way to esdr,mch2022-fpga-dbi with the board's ILI9341 settings.
 */

#include <zephyr/dt-bindings/display/panel.h>
#include <zephyr/dt-bindings/mipi_dbi/mipi_dbi.h>

#include "mch2022_gateware.dtsi"

/delete-node/ &ili9341;

/ {
	/delete-node/ mipi_dbi;

	chosen {
		zephyr,display = &ili9341;
	};

	lcd: lcd {
		compatible = "esdr,mch2022-fpga-dbi";
		fpga = <&fpga>;
		spi-dev = <&spi3>;
		dc-gpios = <&gpio1 1 GPIO_ACTIVE_HIGH>;		/* GPIO33 */
		reset-gpios = <&gpio0 25 GPIO_ACTIVE_LOW>;
		lcd-mode-gpios = <&gpio0 26 GPIO_ACTIVE_HIGH>;
		#address-cells = <1>;
		#size-cells = <0>;

		ili9341: ili9341@0 {
			compatible = "ilitek,ili9341";
			reg = <0>;
			mipi-max-frequency = <DT_FREQ_M(40)>;
			te-mode = "MIPI_DBI_TE_RISING_EDGE";
			pixel-format = <PANEL_PIXEL_FORMAT_RGB_565X>;
			width = <240>;
			height = <320>;
			rotation = <90>;
			h-mirror;
			pwctrlb = [00 c1 30];
			pwseqctrl = [64 03 12 81];
			timctrla = [85 00 78];
			pumpratioctrl = [20];
			pwctrl1 = [23];
			vmctrl1 = [3e 28];
			vmctrl2 = [86];
			frmctr1 = [00 18];
			disctrl = [08 82 27 00];
			enable3g = [00];
			pgamctrl = [0f 31 2b 0c 0e 08 4e f1 37 07 10 03 0e 09 00];
			ngamctrl = [00 0e 14 03 11 07 31 c1 48 08 0f 0c 31 36 0f];
		};
	};
};
