# ESP32C6_RADIO register map
File version: 0.1.0
Undocumented ESP32-C6 radio registers as esp-sdr-zephyr knows them, additions to Espressif's SVD (github.com/espressif/svd at be20aa1): doc/registers/svdmerge.py merges them, doc/registers/svd2md.py renders doc/undocumented-registers-esp32c6.md. Peripherals in group ANALOG_I2C are analog I2C blocks, not memory-mapped: base address block << 8, one 8-bit register per offset.
Registers are 32-bit, read-write, no defined reset value unless marked. A register's access mark holds for its fields unless they carry their own. Offsets are from the block's base; lines under a group give offsets from that group; [hi:lo] are bit positions; {n}, {i} and the like mark numbered series; 'fields as' and 'values as' point back to an identical list; <NAME> marks a mode.

## Memory map
0x00006100 ULP size 0xB — Analog I2C block 0x61 (ULP) Registers 0 to 10 at 2412 MHz: `1f 02 08 49 53 40 51 2f 33 59 20` (bench 2026-10-09). The Init rows below come from this dump.
0x00006200 RFPLL size 0x13 — Analog I2C block 0x62 (RF PLL) The RF PLL's VCO and its calibration (the S3 has the same block). The library reads RFPLL_VCO_WINDOW after every tune and drives the LO 5/6 divider through RFPLL_LO_DIV. The capacitor code is `0x62:5 | 0x62:7[2] << 8` (9 bits; the vendor clamps to 0x1ff); a higher code means a lower VCO frequency. Some field meanings come from the S3 vendor code, as the fields and their evidence say. Upstream esp-sdr does a manual 512-code search on the ESP32-S2 through the same fields (RFPLL_MANUAL_CODE, RFPLL_MANUAL_CODE_B8, RFPLL_CODE_SRC, `0x62:0[7]`, and RFPLL_VCO_WINDOW as the window indication); it does not apply it to the S3 or the C6 (*upstream* `modules/lib/esp-sdr/main/targets/esp32s2/pll.h:8-36`). Registers 0 to 18 at 2412 MHz: `68 bb 8d 61 28 bb 0d 03 80 f0 a0 44 00 00 14 74 07 ff 60` (bench 2026-10-09). The Init rows below come from this dump.
0x00006300 RFPLL_SDM size 0x7 — Analog I2C block 0x63 (RF PLL fractional-N divider) Registers 0 and 3 to 6: `f_PLL = 1.5 * f_xtal * (32 + r3 + (r4 * 2^11 + r5 * 2^3 + r6[2:0]) / 2^19)` That is 60 MHz per integer step with the 40 MHz crystal. The vendor computes a word `W = r3 << 19 | r4 << 11 | r5 << 3 | r6` with `f_PLL = 3 * f_xtal * (16 + W / 2^20)`; W bit 27 is computed but not written. `write_rfpll_sdm()` clears RFPLL_SDM_R0_B3 (`0x63:0[3]`), writes registers 3 to 6 and sets the bit again. | PLL MHz | reg 3 | reg 4 | reg 5 | reg 6 | Note | |---|---|---|---|---|---| | 2412 | 0x08 | 0x33 | 0x33 | 0x01 | | | 2413 | 0x08 | 0x37 | 0x77 | 0x03 | | | 2417 | 0x08 | 0x48 | 0x88 | 0x04 | | | 2437 | 0x08 | 0x9d | 0xdd | 0x06 | | | 2438 | 0x08 | 0xa2 | 0x22 | 0x01 | | | 2280 | 0x06 | 0x00 | 0x00 | 0x00 | LO 1900 MHz through the divider | | 2404 | 0x08 | 0x11 | 0x11 | 0x00 | asked for 2412 MHz in the stale modem state | Evidence: *measured* bench 2026-10-09; *decompile* C6 ROM `write_rfpll_sdm` (0x400058ee), C6 `libphy.a` `phy_rfpll.o` (`ram_rfpll_set_freq`). The bench reading `60 MHz * (N + F / 2^20)` with N = 32 + reg 3 and `F = r4 << 12 | r5 << 4 | r6` is the same formula except that the vendor code weights reg 6 twice as much (it holds W bits 2:0), a difference below 0.2 kHz. The bench reading also took reg 3 as the low 4 bits of N; the vendor code puts 8 bits there (N - 32), which agrees for every value seen. The crystal selector of the vendor calls picks the divisor, as on the S3: 1 = 26 MHz, 2 = 32 MHz, anything else = 40 MHz (*decompile* C6 `ram_rfpll_set_freq`). The Init rows below are the values at 2412 MHz.
0x00006600 BBPLL size 0xB — Analog I2C block 0x66 (BBPLL) Documented by the HAL; esp_sdr does not touch the block. Upstream looked for other ADC rates (on the S3 through this block); for the C6 it reports that no reliable lower-rate path was found (*upstream* `modules/lib/esp-sdr/docs/rx-controls.md:59-61`). Registers 0 to 10 at 2412 MHz: `18 25 50 08 6b 80 73 00 c2 96 03` (bench 2026-10-09).
0x00006700 BBTOP size 0x39 — Analog I2C block 0x67 (BBTOP, analog baseband) The C6 libphy groups the filter codes as the S3 does (`filter_dcap_set()`: registers 4, 5, 12, 13 from one PHY parameter, 6, 7, 14, 15 from the next), so the transmit pairs are probably at the same place as on the S3 (*decompile* C6 `libphy.a` `phy_i2c.o`). `esp_sdr_tx_set_lpf()` returns -ENOTSUP on the C6. `esp_sdr_bbtop_read()` and `esp_sdr_bbtop_write()` give unchecked access (`lib/esp_sdr/src/esp_sdr_rx.c:689-708`).
0x00006A00 BIAS size 0x4 — Analog I2C block 0x6a (bias) The HAL names the block (`I2C_BIAS`). Registers 0 to 3 at 2412 MHz read `cf 7c 1a 07` (bench 2026-10-09).
0x60090000 IO_MUX blocks up to offset 0xC0 — Modem diagnostic lines
0x60095000 HP_SYS blocks up to offset 0x8 — SRAM bank ownership
0x600A0000 FE blocks up to offset 0x95C — Front end Unused by the library (it has no C6 transmit path). Evidence marked *decompile* in this section comes from C6 `libphy.a` `phy_reg.o`, `phy_pbus.o`, `phy_init.o` and `phy_tx_cal.o`, `librftest.a` `rf_test.o`, `esp_phy_api.o`, `phy_test.o` and `wifi.o`, and the C6 ROM. How the vendor functions drive the front end: - `esp_phy_wifi_tx_tone(start, chan, backoff)` (`wifiscwout()`) tunes with `chip_v7_set_chan(chan, 0)` (above 2000 the argument is MHz, truncated to a channel: 2437 to 2441 all give channel 6), forces the analog TX chain on through pbus debug mode (`ram_txcal_debuge_mode()`: `pbus_force_mode(1)`, `ram_pbus_xpd_tx_on()`, the calibrated DC offset, the TX clock), and starts tone 0 at frequency 0, attenuated by the calibrated value + backoff + 12 in quarter dB. It never calls `force_txon()`. Stopping runs ROM `txcal_work_mode()` (0x400047d6): tone off, TX clock off, pbus back to receive and to normal mode. On the bench the carrier arrives at the channel centre (*measured* bench 2026-10-11). - `ram_stop_tx_tone()` stops the tones and selects the data path, leaving the pbus forcing and the TX clock on: the C6 counterpart of the C5's `phy_stop_tx_tone(1)`. The DAC engine played with the source left at 0 (see "Dump and DAC engine"); with 3 it is untested. - `force_txon(on)` clears `0x600a70dc` bit 16 and sets FE_RX_FORCE to 2, then FE_TX_FORCE to 3; off goes in reverse. - In `force_txon_mode(on, bt, idx)` the second argument, which the ESP32-S3 page calls mode, acts as a BT flag: the function always writes the power index force (FE_PWR_INDEX_FORCE = `on`, index in FE_PWR_INDEX), then calls `force_txon(0)` and `force_txon(on)`; only with the flag it first adds 32 to the index, stops the hardware frequency engine (FE_HW_FREQ_STOP), writes `0x600af4b4` bit 0, FE_BT_FORCE and `0x600a28a0` bits 31:30 (all ones with `on`, 0 without), and restarts the engine if it ran before. - `set_dump_mode(x)` clears FE_R958_REG bits 1:0 and writes `0x600a70b8` bits 2:0 = 1 when x is 0, else 0 (C6 `librftest.a` `phy_test.o`).
0x600A2000 BTBB blocks up to offset 0x8A4 — BTBB page (0x600a2000)
0x600A4000 WIFIMAC blocks up to offset 0xE34 — Wi-Fi MAC page (0x600a4000)
0x600A7000 AGC blocks up to offset 0xE0 — AGC force
0x600A9000 DUMP blocks up to offset 0x20 — Dump and DAC engine Same RUN, TRIGGER, DONE and COUNT bits as the S3 at another address (*upstream* `modules/lib/esp-sdr/main/families/c5_c6_c61/receiver.c`, `modules/lib/esp-sdr/main/targets/esp32c6/chip.h`). Receive runs at 80 MS/s only; the transmit side is a DAC engine at 0x600a900c (DUMP_DAC_TRIG_REG, below), which no vendor code programs: the C6 `dactrig()` only writes a ramp into 0x40840000 (*decompile* C6 `librftest.a` `mac_common.o`). Base 0x600a9000 has no name in the HAL. Each capture and each playback needs the clocks in MODEM_SYSCON forced on and an SRAM block handed to the engine in HP_SYSTEM_SRAM_USAGE_CONF_REG. **Receive rate.** The C6 `adctrig()` starts only mode 0 by software; the other modes wait for a hardware event. It writes no part of DUMP_MODE_REG (0x600a9008) but the source field, DUMP_SRC, and never reads the argument that the C5 and C61 versions turn into a rate (*decompile* C6 `librftest.a` `mac_common.o`): | `adctrig()` mode | DUMP_SRC | Also | |---|---|---| | 0 | 15 | software start | | 1, 3 | 1 | | | 2 | 0 | | | 4 | 2 | | | 5 | 3 | tries to send a frame each poll, at most one per `tx_frame_delay_us` (800 by default) | | 6 | 4 | as mode 5 | | 7 | 5 | Wi-Fi MAC event selector WIFIMAC_EVENT_SEL_REG (0x600a4e30): bit 8 set, bits 7:0 the event | | 8 | 0 | BTBB_DUMP_GATE (0x600a20b4 bit 0) set, lanes 0x0e to 0x11, BLE receiver started | Upstream found no other source that gives a uniform stream, and neither `adc_rate_set()` nor candidate divider bits changed the timing (*upstream* `git show 34bb79b:docs/rx-controls.md`, "C6 sample-rate investigation"). Upstream's C6 ring is gapless at 80 MS/s, rotating SRAM blocks 1 and 2 under a circular DUMP_CTRL_REG (DUMP_CIRCULAR, bit 17, count 16384), and consumes it as FFT windows (*upstream* `modules/lib/esp-sdr/main/common/ring_capture.c:96-131, 1485-1507`): the 160 MHz CPU has 2 cycles per sample, too few to decimate the whole stream. Leads for a continuous C6 receive below 80 MS/s (the first one probed): - The modem diagnostic bus into PARL_IO. A third-party project, not re-checked here, reports for the ESP32-C5 that the dump's I/Q MSBs appear on MODEM_DIAG (Q[9:6] on lines 9:6, I[9:6] on 19:16), and that routed through the GPIO matrix into PARL_IO, a cyclic 40 MS/s capture takes every second sample of the 80 MS/s bus as 4+4-bit I/Q, bit-perfect in a bounded capture (it claims no gapless running across ring wraps; [Twotoz/C5VRX](https://github.com/Twotoz/C5VRX/blob/a165e19db47ebd49051217d7c968a1b8220c20fb/docs/continuous-iq-findings.md)). The C6 selector registers are DUMP_DIAG_SEL0_REG and DUMP_DIAG_SEL1_REG (0x600a9018 and 0x600a901c), and the diag lines are enabled in IO_MUX_MODEM_DIAG_EN_REG (0x600900bc); both below. Which selector value puts receive I/Q on the C6 bus is unknown. Sampling below 80 MHz decimates without filtering, so the analog low-pass has to be narrowed first. Probed 2026-10-19 (`tmp/scratch/c6diag`, not in the tree: the dump engine set up by a burst capture and left running circular, all lines enabled, two lanes at a time looped back through GPIO5 and GPIO11 and read by the CPU at some 20 MHz; GPIO5 is MTDI and needs its pad function set to GPIO first). With a strong tone, selector values sel0 = 4n (sel1 = 0) drive lanes 16 to 22 and 26 to 29; their toggle rates fall from lane 16 (some 350 per 4096 reads) to lane 22 (some 30, the sign rate of the 100 kHz tone), like the bits of a sampled value rather than copies of a sign (an earlier sweep read them as sign-like). Odd values 3 + 4n drive lane 19 only. The bit mapping is not resolved: two pads see only a pair at a time. A parallel capture needs a free pad per lane, which the WHY2025 badge's C6 does not have (its SDIO link takes GPIO18 to 23), and a XIAO ESP32C6 has the pads but only USB-Serial-JTAG to send the samples on. - The 802.11p clock mode: `phy_11p_set(1, m)` writes MODEM_SYSCON_WIFI_BB_CFG_REG (0x600a981c) bits 4:2 = 4 for m = 0, else 5, presumably for 10 and 5 MHz channels, and clears AGC_R30_REG (0x600a7030) bit 5 (*decompile* C6 `libphy.a` `phy_feature.o`). Whether the dump follows the slower clock is unknown. - The BLE dump (mode 8 above): rate unknown; it runs only while the BLE receiver does.
0x600A9800 MODEM_SYSCON blocks up to offset 0x20 — Modem clocks and reset Documented registers; the entries give the behaviour the HAL does not document.
0x600AF000 MODEM_LPCON blocks up to offset 0x28 — Modem LP reset Documented register; the behaviour the HAL does not document is under MODEM_SYSCON_MODEM_RST_CONF_REG.
0x600AF800 I2C_ANA_MST size 0x24 — Analog I2C master `I2C_ANA_MST` at 0x600af800 is in the HAL; the register names are the HAL's.

## Notices in the file
SPDX-License-Identifier: GPL-3.0-or-later
